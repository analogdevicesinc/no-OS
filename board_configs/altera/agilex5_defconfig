## board_configs/altera/agilex5_defconfig
```kconfig
CONFIG_PLATFORM_DRIVERS=y
CONFIG_ALTERA_PLATFORM_NIOSV=y
CONFIG_UART=y
CONFIG_SPI=y
CONFIG_SPI_ALTERA=y
CONFIG_GPIO=y
CONFIG_GPIO_ALTERA=y
```

## board_configs/linux-userspace/linux-userspace_defconfig
```kconfig
CONFIG_PLATFORM_DRIVERS=y
CONFIG_LINUX_USERSPACE=y

CONFIG_GPIO_LINUX_USERSPACE=y
CONFIG_I2C_LINUX_USERSPACE=y
CONFIG_SPI_LINUX_USERSPACE=y
CONFIG_UART_LINUX_USERSPACE=y
CONFIG_TIMER_LINUX_USERSPACE=y
```

## board_configs/linux/rpi5_defconfig
```kconfig
CONFIG_PLATFORM_DRIVERS=y
CONFIG_LINUX=y

CONFIG_SPI_LINUX=y
CONFIG_GPIO_LINUX=y
CONFIG_UART_LINUX=y
CONFIG_TIMER_LINUX=y
```

## board_configs/maxim/max32657evkit_defconfig
```kconfig
CONFIG_PLATFORM_DRIVERS=y
CONFIG_MAXIM=y

CONFIG_CAPI=y
CONFIG_CAPI_TIME=y
CONFIG_CAPI_ALLOC=y
CONFIG_CAPI_UART=y
CONFIG_CAPI_GPIO=y
CONFIG_CAPI_DMA=y
CONFIG_CAPI_TIMER=y
CONFIG_CAPI_SPI=y
CONFIG_CAPI_I2C=y
CONFIG_CAPI_IRQ=y
CONFIG_CAPI_WDT=y
# CONFIG_CAPI_RTC=y
# CONFIG_CAPI_TRNG=y
```

## board_configs/xilinx/vck190_defconfig
```kconfig
CONFIG_PLATFORM_DRIVERS=y
CONFIG_XILINX=y

CONFIG_UART_XILINX=y
CONFIG_SPI_XILINX=y
CONFIG_I2C_XILINX=y
CONFIG_GPIO_XILINX=y
CONFIG_GPIO_IRQ_XILINX=y
CONFIG_IRQ_XILINX=y
CONFIG_TIMER_XILINX=y
```

## capi/Kconfig
```kconfig
menuconfig CAPI
	bool "CAPI (Common API) abstraction layer"
	default n
	help
	  Enable the CAPI common-API abstraction layer. CAPI provides a
	  platform-neutral dispatcher layer (capi/src) with platform-specific
	  backends (capi/platform/<platform>). Each peripheral module below
	  enables its dispatcher; the matching backend is compiled from the
	  active platform's directory and selects PS vs PL hardware internally
	  via #ifdef on the BSP-provided XPAR_* macros.

if CAPI

config CAPI_UART
	bool "CAPI UART"
	default n

config CAPI_ALLOC
	bool "CAPI alloc"
	default n

config CAPI_TIME
	bool "CAPI time"
	default n

config CAPI_GPIO
	bool "CAPI GPIO"
	default n

config CAPI_IRQ
	bool "CAPI IRQ"
	default n

config CAPI_SPI
	bool "CAPI SPI"
	default n

config CAPI_TIMER
	bool "CAPI timer"
	default n

config CAPI_I2C
	bool "CAPI I2C"
	default n

config CAPI_DMA
	bool "CAPI DMA"
	default n

config CAPI_WDT
	bool "CAPI WDT"
	default n

config CAPI_PINT
	bool "CAPI PINT"
	default n

endif # CAPI
```

## drivers/accel/Kconfig
```kconfig
menuconfig ACCEL
    bool "Accelerometer Drivers"
    default n
    help
      Enable support for accelerometer drivers.

if ACCEL

config ACCEL_ADXL313
    depends on SPI
    select GPIO
    bool "Enable the ADXL313 driver"
    default n

config ACCEL_IIO_ADXL313
    depends on SPI
    select ACCEL_ADXL313
    bool "Enable the ADXL313 IIO driver"
    default n

config ACCEL_ADXL355
    depends on SPI
    select GPIO
    bool "Enable the ADXL355 driver"
    default n

config ACCEL_IIO_ADXL355
    depends on SPI
    select ACCEL_ADXL355
    bool "Enable the ADXL355 IIO driver"
    default n

config ACCEL_ADXL367
    depends on SPI
    bool "Enable the ADXL367 driver"
    default n

config ACCEL_IIO_ADXL367
    depends on SPI
    select ACCEL_ADXL367
    bool "Enable the ADXL367 IIO driver"
    default n

config ACCEL_ADXL38X
    depends on SPI
    select GPIO
    bool "Enable the ADXL38X driver"
    default n

config ACCEL_ADXL37X
    depends on SPI && I2C
    select GPIO
    bool "Enable the ADXL37X driver"
    default n
    help
      The driver picks the bus at runtime via adxl37x_init_param.comm_type,
      so both SPI and I2C back ends are always linked in.

config ACCEL_IIO_ADXL37X
    depends on SPI && I2C
    select ACCEL_ADXL37X
    bool "Enable the ADXL37X IIO driver"
    default n

endif
```

## drivers/beamformer/Kconfig
```kconfig
menuconfig BEAMFORMER
	bool "Beamformer Drivers"
	default n
	help
	  Enable support for beamformer drivers.

if BEAMFORMER

config BEAMFORMER_ADAR300X
	depends on SPI
	bool "Enable ADAR3000/ADAR3001 beamformer driver"
	default n

config BEAMFORMER_IIO_ADAR300X
	select BEAMFORMER_ADAR300X
	bool "Enable ADAR3000/ADAR3001 IIO driver"
	default n

endif # BEAMFORMER
```

## drivers/color/Kconfig
```kconfig
menuconfig COLOR
	bool "Color Drivers"
	default n
	help
	  Enable support for color drivers.

if COLOR

config COLOR_TCS34725
	depends on I2C
	bool "Enable TCS34725 color sensor driver"
	default n

endif # COLOR
```

## drivers/health/Kconfig
```kconfig
menuconfig HEALTH
	bool "Healthcare Drivers"
	default n
	help
	  Enable support for Healthcare drivers.

if HEALTH

config HEALTH_MAXM86161
    depends on I2C
    select GPIO
    select IRQ
    bool "Enable MAXM86161 driver"
    default n

config HEALTH_IIO_MAXM86161
    depends on IIO
    select HEALTH_MAXM86161
    bool "Enable MAXM86161 IIO driver"
    default n

endif
```

## drivers/motor/Kconfig
```kconfig
menuconfig MOTOR
	bool "Motor Control Drivers"
	default n
	help
	  Enable support for motor control drivers.

if MOTOR

config MOTOR_TMC5240
	depends on SPI
	bool "Enable TMC5240 motor driver"
	default n

config TMC_API_VERSION
	string "TMC-API version tag"
	default "e95877463f54345de68c6a0964b5cb2c37461a8d"
	depends on MOTOR_TMC5240
	help
	  Git tag, branch or commit for TMC-API.
	  Resolved via the NO_OS_DEP_TMC_PATH override, else cloned in-tree
	  (or into a version-keyed NO_OS_CACHE_DIR store when that is set).

config MOTOR_IIO_TMC5240
	select MOTOR_TMC5240
	bool "Enable TMC5240 IIO driver"
	default n

config MOTOR_TMC7300
	depends on UART
	select GPIO
	bool "Enable TMC7300 motor driver"
	default n

endif # MOTOR
```

## drivers/net/oa_tc6/Kconfig
```kconfig
if OA_TC6

config OA_THREAD_RX_LIMIT
    int "Max RX frames processed per thread iteration"
    default 5
    help
      Maximum number of receive frames the OA-TC6 RX thread
      processes in a single iteration before yielding.

endif
```

## drivers/platform/altera/Kconfig
```kconfig
config ALTERA_PLATFORM_NIOSV
	bool "Use Nios V / Intel FPGA BSP compatibility"
	default n
	help
	  Enable the external BSP compatibility layer for Nios V / Intel FPGA.
	  When enabled, the Altera toolchain selects the Nios V flow and expects
	  ALTERA_NIOSV_REPO_DIR(reference design with hw/, sw/), ALTERA_NIOSV_BSP(niosv-bsp path)

if ALTERA_PLATFORM_NIOSV

config GPIO_ALTERA
	bool "Enable Altera GPIO driver"
	depends on GPIO
	default n
	help
	  Enable the legacy Altera Avalon-SOPC GPIO driver implementation.
	  Requires CONFIG_GPIO=y and a hardware design with the corresponding
	  Avalon GPIO IP core.

config I2C_ALTERA
	bool "Enable Altera I2C driver"
	depends on I2C
	default n
	help
	  Enable the legacy Altera Avalon-SOPC I2C driver implementation.
	  Requires CONFIG_I2C=y and a hardware design with the corresponding
	  Avalon I2C IP core.

config SPI_ALTERA
	bool "Enable Altera SPI driver"
	depends on SPI
	default n
	help
	  Enable the legacy Altera Avalon-SOPC SPI driver implementation.
	  Requires CONFIG_SPI=y and a hardware design with the corresponding
	  Avalon SPI IP core.

config IRQ_ALTERA
	bool "Enable Altera IRQ driver"
	depends on IRQ
	default n
	help
	  Enable the Altera / Nios V core-local interrupt controller (CLIC/CLINT)
	  driver, which wraps the generated BSP HAL alt_ic_* / alt_irq_* API.
	  Requires CONFIG_IRQ=y.

config UART_ALTERA
	bool "Enable Altera UART driver"
	depends on UART
	select IRQ
	select IRQ_ALTERA
	default n
	help
	  Enable the Altera / Nios V Avalon JTAG-UART driver (polled TX, hybrid
	  interrupt + polled RX). Needed for the IIO server transport. Requires
	  CONFIG_UART=y and pulls in the Altera IRQ driver.

endif # ALTERA_PLATFORM_NIOSV
```

## drivers/platform/linux-userspace/Kconfig
```kconfig
menuconfig LINUX_USERSPACE
	bool "Linux Userspace Platform Drivers"
	default n
	help
	  Enable support for Linux userspace platform drivers.

	  These drivers communicate with hardware through Linux kernel
	  interfaces (spidev, i2c-dev, gpio-cdev, etc.), allowing no-OS
	  projects to run as native Linux userspace applications.

if LINUX_USERSPACE

config GPIO_LINUX_USERSPACE
	bool "Enable Linux userspace GPIO driver"
	depends on GPIO
	default n
	help
	  Enable GPIO driver using the Linux GPIO character device interface.

config I2C_LINUX_USERSPACE
	bool "Enable Linux userspace I2C driver"
	depends on I2C
	default n
	help
	  Enable I2C driver using the Linux i2c-dev interface.

config SPI_LINUX_USERSPACE
	bool "Enable Linux userspace SPI driver"
	depends on SPI
	default n
	help
	  Enable SPI driver using the Linux spidev interface.

config UART_LINUX_USERSPACE
	bool "Enable Linux userspace UART driver"
	depends on UART
	default n
	help
	  Enable UART driver using the Linux serial interface.

config TIMER_LINUX_USERSPACE
	bool "Enable Linux userspace timer driver"
	depends on TIMER
	default n
	help
	  Enable timer driver using Linux userspace timing interfaces.

endif # LINUX_USERSPACE
```

## drivers/platform/linux/Kconfig
```kconfig
menuconfig LINUX
	bool "Linux Platform Drivers"
	default n
	help
	  Enable support for Linux platform drivers.

	  This section contains userspace platform drivers that run on top of
	  the Linux kernel character-device interfaces (spidev, gpiochip, i2c-dev,
	  tty) rather than talking to a microcontroller's peripherals directly.
	  Useful for single-board computers such as the Raspberry Pi.

if LINUX

config SPI_LINUX
	bool "Enable Linux SPI driver"
	depends on SPI
	default n
	help
	  Enable the Linux-specific SPI driver implemented on top of the
	  spidev character device (/dev/spidevB.C).

config GPIO_LINUX
	bool "Enable Linux GPIO driver"
	depends on GPIO
	default n
	help
	  Enable the Linux-specific GPIO driver implemented on top of the
	  gpiochip character device (/dev/gpiochipN) using the GPIO v2 uAPI.

config I2C_LINUX
	bool "Enable Linux I2C driver"
	depends on I2C
	default n
	help
	  Enable the Linux-specific I2C driver implemented on top of the
	  i2c-dev character device (/dev/i2c-N).

config UART_LINUX
	bool "Enable Linux UART driver"
	depends on UART
	default n
	help
	  Enable the Linux-specific UART driver implemented on top of a tty
	  character device (/dev/ttyN).

config TIMER_LINUX
	bool "Enable Linux timer driver"
	depends on TIMER
	default n
	help
	  Enable the Linux-specific timer driver implemented on top of the
	  POSIX clock interface.

config AXI_IO_LINUX
	bool "Enable Linux AXI IO driver"
	default n
	help
	  Enable the Linux-specific AXI memory-mapped IO driver implemented on
	  top of /dev/mem.

endif # LINUX
```

## drivers/platform/mac/Kconfig
```kconfig
menuconfig MAC
	bool "macOS Platform Drivers"
	default n
	help
	  Enable support for macOS platform drivers.

	  These drivers run natively on macOS and provide hardware
	  abstraction for delay and optional UART (serial port) functionality.

	  For SPI, I2C and GPIO over a FTDI USB-to-MPSSE bridge, enable
	  the FTD2XX library option in External Libraries.

if MAC

config UART_MAC
	bool "Enable macOS UART driver"
	depends on UART
	default n
	help
	  Enable UART driver using the macOS serial-port API (open /dev/tty.*,
	  termios).  Used when communicating with a device via a native macOS
	  serial port (e.g. /dev/tty.usbserial-*).

endif # MAC
```

## drivers/platform/win/Kconfig
```kconfig
menuconfig WIN
	bool "Windows Platform Drivers"
	default n
	help
	  Enable support for Windows platform drivers.

	  These drivers run natively on Windows and provide hardware
	  abstraction for delay and optional UART (COM port) functionality.

	  For SPI, I2C and GPIO over a FTDI USB-to-MPSSE bridge, enable
	  the FTD2XX library option in External Libraries.

if WIN

config UART_WIN
	bool "Enable Windows UART driver"
	depends on UART
	default n
	help
	  Enable UART driver using the Windows COM port API (CreateFile,
	  ReadFile, WriteFile).  Used when communicating with a device via
	  a native Windows serial port (COMx).

endif # WIN
```

## libraries/Kconfig
```kconfig
menu "External Libraries"

config FREERTOS
	bool "Enable FreeRTOS"
	default n

config FREERTOS_CONF_PATH
	depends on FREERTOS
	string "Path to the FreeRTOSConfig.h file"

config FREERTOS_VERSION
	string "FreeRTOS version tag"
	default "03db672b8f45db24aa99f12051f7cf86746b9ed9"
	depends on FREERTOS
	help
	  Git tag, branch or commit for FreeRTOS-Kernel.
	  Examples: V11.2.0, V10.4.3, main
	  Resolved via the NO_OS_DEP_FREERTOS_PATH override, else cloned in-tree
	  (or into a version-keyed NO_OS_CACHE_DIR store when that is set).

config FREERTOS_HEAP_ALLOCATOR
	int "Select the FreeRTOS heap memory allocator implementation"
	default 2
	range 1 5
	depends on FREERTOS

config LWIP
	bool "Enable LWIP"
	default n

config LWIP_VERSION
	string "lwIP version tag"
	default "e29870c15e8bf28eac9c811dd236c474f3f2008f"
	depends on LWIP
	help
	  Git tag, branch or commit for lwIP.
	  Examples: STABLE-2_2_1_RELEASE, STABLE-2_1_0_RELEASE, master
	  Resolved via the NO_OS_DEP_LWIP_PATH override, else cloned in-tree
	  (or into a version-keyed NO_OS_CACHE_DIR store when that is set).

config LWIP_CONF_PATH
	string "Path to directory containing lwipopts.h"
	depends on LWIP
	help
	  Directory containing a project/board-specific lwipopts.h that
	  overrides the generic libraries/lwip/configs one. Can be absolute or
	  relative to the source dir. Leave empty to use the generic config.

config CORDIO
	bool "Enable CORDIO"
	default n

config MBEDTLS
	bool "Enable mbedTLS"
	default n

config MBEDTLS_VERSION
	string "mbedTLS version tag"
	default "bdd5ba98e809c43c509770b39b787a3b00c67b55"
	depends on MBEDTLS
	help
	  Git tag, branch or commit for mbedTLS.
	  Examples: mbedtls-2.28.0, mbedtls-3.6.0, development
	  Resolved via the NO_OS_DEP_MBEDTLS_PATH override, else cloned in-tree
	  (or into a version-keyed NO_OS_CACHE_DIR store when that is set).

config MBEDTLS_CONFIG_FILE
	string "Path to project mbedTLS config header"
	depends on MBEDTLS
	help
	  Path to a project-specific mbedTLS configuration header, wired up as
	  MBEDTLS_CONFIG_FILE so mbedTLS includes it instead of its default
	  config.h. Can be absolute or relative to CMAKE_SOURCE_DIR. Leave empty
	  to use the stock configuration.

config MQTT
	bool "Enable MQTT (Paho Embedded-C)"
	default n

config MQTT_VERSION
	string "Paho MQTT version tag"
	default "29ab2aa29c5e47794284376d7f8386cfd54c3eed"
	depends on MQTT
	help
	  Git tag, branch or commit for paho.mqtt.embedded-c.
	  Examples: master, v1.1.0
	  Resolved via the NO_OS_DEP_MQTT_PATH override, else cloned in-tree
	  (or into a version-keyed NO_OS_CACHE_DIR store when that is set).

config ESH
	bool "Enable esh (Embedded Shell)"
	default n

config ESH_VERSION
	string "esh version tag"
	default "main"
	depends on ESH
	help
	  Git tag, branch or commit for esh.
	  Examples: main
	  Resolved via the NO_OS_DEP_ESH_PATH override, else cloned in-tree
	  (or into a version-keyed NO_OS_CACHE_DIR store when that is set).

config LVGL
	bool "Enable LVGL"
	default n

config LVGL_VERSION
	string "LVGL version tag"
	default "v9.3.0"
	depends on LVGL
	help
	  Git tag, branch or commit for LVGL.
	  Examples: v9.3.0, v8.3.0, master
	  Resolved via the NO_OS_DEP_LVGL_PATH override, else cloned in-tree
	  (or into a version-keyed NO_OS_CACHE_DIR store when that is set).

config LVGL_CONF_PATH
	string "Path to directory containing lv_conf.h"
	depends on LVGL
	help
	  Directory containing the lv_conf.h configuration file.
	  Can be absolute or relative to CMAKE_SOURCE_DIR.

config AZURE
	bool "Enable Azure SDK for C"
	default n

config AZURE_VERSION
	string "Azure SDK version tag"
	default "277a0f8c51a09bcaa3c4687a9665eb293eeca188"
	depends on AZURE
	help
	  Git tag, branch or commit for azure-sdk-for-c.
	  Examples: 1.5.0, 1.4.0, main
	  Resolved via the NO_OS_DEP_AZURE_PATH override, else cloned in-tree
	  (or into a version-keyed NO_OS_CACHE_DIR store when that is set).

endmenu
```
