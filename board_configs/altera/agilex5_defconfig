## projects/ad413x/Kconfig
```kconfig
menu "ad413x Configuration"

choice AD413X_EXAMPLE
	prompt "Example variant"
	default AD413X_DEMO_EXAMPLE

config AD413X_DEMO_EXAMPLE
	bool "Demo example"
	help
	  Demo example that initializes the AD413X AFE/ADC, performs continuous
	  conversion on selected channels and prints the results.

config AD413X_IIO_EXAMPLE
	bool "IIO example"
	depends on IIO
	help
	  IIO example that exposes the AD413X ADC through the IIO framework
	  via iio_ad413x, enabling host-side data capture over UART.

endchoice

choice AD413X_CARRIER
	prompt "Carrier board"
	default AD413X_ZED_CARRIER

config AD413X_ZED_CARRIER
	bool "ZedBoard carrier"
	help
	  Select when targeting the ZedBoard carrier. The IIO console uses
	  the PS UART1 peripheral routed to the ZedBoard USB-UART.

config AD413X_CORAZ7S_CARRIER
	bool "Cora Z7-07S carrier"
	help
	  Select when targeting the Cora Z7-07S carrier. The IIO console uses
	  the PS UART0 peripheral routed to the Cora Z7S USB-UART.

endchoice

choice AD413X_DEV
	prompt "Device variant"
	default AD413X_DEV_AD4130_8
	help
	  Select the AD413x family part populated on the evaluation board.

config AD413X_DEV_AD4129_4
	bool "AD4129-4"

config AD413X_DEV_AD4129_8
	bool "AD4129-8"

config AD413X_DEV_AD4130_4
	bool "AD4130-4"

config AD413X_DEV_AD4130_8
	bool "AD4130-8"
	help
	  Default AD4130-8 device (no extra compile define needed).

config AD413X_DEV_AD4131_4
	bool "AD4131-4"

config AD413X_DEV_AD4131_8
	bool "AD4131-8"

endchoice

endmenu
```

## projects/ad9082/Kconfig
```kconfig
menu "ad9082 Configuration"

choice AD9082_EXAMPLE
	prompt "Example variant"
	default AD9082_BASIC_EXAMPLE

config AD9082_BASIC_EXAMPLE
	bool "Basic example"
	help
	  Basic bring-up example: initializes the HMC7044 clocks, the
	  AXI-JESD204 RX/TX cores and the AD9082 (ad9081 driver), runs the
	  JESD204 FSM and prints the link status. No data is moved.

config AD9082_DMA_EXAMPLE
	bool "DMA example"
	help
	  DMA-based data capture and playback example for the AD9082 over the
	  AXI ADC/DAC cores and DMACs.

config AD9082_IIO_EXAMPLE
	bool "IIO example"
	depends on IIO
	help
	  IIO example that exposes the AD9082 through the IIO framework via
	  iio_axi_adc and iio_axi_dac, for host-side capture/playback over UART.

endchoice

endmenu
```
