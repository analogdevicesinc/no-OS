## projects/adrv9104/Kconfig
```kconfig
menu "adrv9104 Configuration"

choice ADRV9104_EXAMPLE
	prompt "Example variant"
	default ADRV9104_DEMO_EXAMPLE

config ADRV9104_DEMO_EXAMPLE
	bool "Demo example"
	help
	  Basic initialization and bring-up example for the ADRV910x (Nevis)
	  transceiver via AXI ADC/DAC cores and DMA.

config ADRV9104_DMA_EXAMPLE
	bool "DMA example"
	help
	  DMA-based data capture and playback example for the ADRV910x (Nevis)
	  transceiver.

config ADRV9104_IIO_EXAMPLE
	bool "IIO example"
	depends on IIO
	help
	  IIO example that exposes the ADRV910x (Nevis) transceiver through
	  the IIO framework via iio_axi_adc and iio_axi_dac, enabling host-side
	  data capture and playback over UART.

endchoice

endmenu
```

## projects/hello_world/Kconfig
```kconfig
menu "hello_world Configuration"

config HELLO_WORLD_BASIC_EXAMPLE
	bool "Basic example"
	default y
	help
	  Minimal hello-world example: UART console, LED blink
	  and key echo.

endmenu
```

## projects/max78000/Kconfig
```kconfig
menu "max78000 Configuration"

choice MAX78000_EXAMPLE
	prompt "Example variant"
	default MAX78000_BASIC_EXAMPLE

config MAX78000_BASIC_EXAMPLE
	bool "Basic UART example"
	help
	  Simple example that prints a message over UART.

config MAX78000_DUAL_CORE_EXAMPLE
	bool "Dual-core example (ARM + RISC-V)"
	depends on CAPI_COPROCESSOR && CAPI_MAILBOX
	help
	  Demonstrates the CAPI coprocessor lifecycle API (boot, halt) and
	  inter-core communication via the CAPI mailbox API and shared memory.
	  ARM (CPU0) boots RISC-V (CPU1), publishes a callback address,
	  and waits for RISC-V to ring the doorbell periodically.
	  Requires CONFIG_CAPI_COPROCESSOR=y and CONFIG_CAPI_MAILBOX=y.

config MAX78000_IMU_SINGLE_CORE_EXAMPLE
	bool "Single-core dual-IMU example (ADIS16577 + ADXL345 on ARM)"
	depends on SPI && GPIO && SPI_MAXIM && GPIO_MAXIM && SYS_MAXIM
	depends on ACCEL_ADXL345 && IMU_ADIS1657X
	help
	  Both IMUs share SPI0, driven entirely from the ARM Cortex-M4F.
	  ADXL345 accelerometer on CS=P0.19 (GPIO); ADIS16577-2 6-axis IMU on
	  CS=P0.11 (GPIO). The ARM integrates gyro rate into roll/pitch/yaw
	  angles and logs both sensors at ~10 Hz. No RISC-V or IPC required.
	  Requires CONFIG_SPI_MAXIM=y, CONFIG_GPIO_MAXIM=y, CONFIG_SYS_MAXIM=y,
	  CONFIG_ACCEL_ADXL345=y and CONFIG_IMU_ADIS1657X=y.


endchoice

endmenu
```
