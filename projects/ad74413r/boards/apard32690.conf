## projects/ad74413r/boards/stm32f756_nucleo.conf
```kconfig
# Board configuration for stm32f756_nucleo in ad74413r project
# This file indicates that ad74413r supports the stm32f756_nucleo board

BOARD_NAME=stm32f756_nucleo
PLATFORM=stm32
TARGET=stm32f756
DESCRIPTION="STM32F756 Nucleo board support for AD74413R"

# IOC path for STM32CubeMX configuration
CONFIG_STM32_IOC_PATH="stm32f756_nucleo.ioc"
```

## projects/ad74414h/Kconfig
```kconfig
menu "AD74414H Configuration"

choice AD74414H_EXAMPLE
	prompt "Example variant"
	default AD74414H_BASIC_EXAMPLE

config AD74414H_BASIC_EXAMPLE
	bool "Basic example"
	help
	  Basic example that initializes the AD74414H ADC-DAC device
	  and performs GPIO operations over SPI interface.

config AD74414H_CURRENT_INPUT_EXT_EXAMPLE
	bool "Current input external example"
	help
	  Current input measurement in externally powered mode.

config AD74414H_CURRENT_INPUT_LOOP_EXAMPLE
	bool "Current input loop example"
	help
	  Current input measurement in loop powered mode.

config AD74414H_CURRENT_OUTPUT_EXAMPLE
	bool "Current output example"
	help
	  Configures a channel as a current output (source) DAC.

config AD74414H_DIGITAL_INPUT_LOGIC_EXAMPLE
	bool "Digital input logic example"
	help
	  Reads a channel configured as a digital (logic) input.

config AD74414H_DIGITAL_INPUT_LOOP_EXAMPLE
	bool "Digital input loop example"
	help
	  Reads a channel configured as a loop powered digital input.

config AD74414H_DIGITAL_OUTPUT_EXAMPLE
	bool "Digital output example"
	help
	  Drives a channel configured as a digital output.

endchoice

endmenu
```

## projects/ad74416h/Kconfig
```kconfig
menu "AD74416H Configuration"

choice AD74416H_EXAMPLE
	prompt "Example variant"
	default AD74416H_BASIC_EXAMPLE

config AD74416H_BASIC_EXAMPLE
	bool "Basic example"
	help
	  Basic example that initializes the AD74416H ADC-DAC device
	  and performs GPIO operations over SPI interface.

config AD74416H_CURRENT_INPUT_EXT_EXAMPLE
	bool "Current input external example"
	help
	  Current input measurement in externally powered mode.

config AD74416H_CURRENT_INPUT_LOOP_EXAMPLE
	bool "Current input loop example"
	help
	  Current input measurement in loop powered mode.

config AD74416H_CURRENT_OUTPUT_EXAMPLE
	bool "Current output example"
	help
	  Configures a channel as a current output (source) DAC.

config AD74416H_DIGITAL_INPUT_LOGIC_EXAMPLE
	bool "Digital input logic example"
	help
	  Reads a channel configured as a digital (logic) input.

config AD74416H_DIGITAL_INPUT_LOOP_EXAMPLE
	bool "Digital input loop example"
	help
	  Reads a channel configured as a loop powered digital input.

config AD74416H_DIGITAL_OUTPUT_EXAMPLE
	bool "Digital output example"
	help
	  Drives a channel configured as a digital output.

config AD74416H_MULTIPLE_DEVICES_EXAMPLE
	bool "Multiple devices example"
	help
	  Initializes and operates multiple AD74416H devices.

config AD74416H_TEMPERATURE_2WIRE_RTD_EXAMPLE
	bool "Temperature 2-wire RTD example"
	help
	  Temperature measurement using a 2-wire RTD Pt-1000 sensor.

config AD74416H_TEMPERATURE_3WIRE_RTD_EXAMPLE
	bool "Temperature 3-wire RTD example"
	help
	  Temperature measurement using a 3-wire RTD Pt-1000 sensor.

config AD74416H_VOLTAGE_INPUT_EXAMPLE
	bool "Voltage input example"
	help
	  Reads a channel configured as a voltage input (ADC).

config AD74416H_VOLTAGE_INPUT_IRQ_EXAMPLE
	bool "Voltage input IRQ example"
	help
	  Reads a voltage input using ADC ready interrupts.

config AD74416H_VOLTAGE_OUTPUT_EXAMPLE
	bool "Voltage output example"
	help
	  Configures a channel as a voltage output (source) DAC.

endchoice

endmenu
```

## projects/ad7606x-fmc/Kconfig
```kconfig
menu "ad7606x-fmc Configuration"

choice AD7606X_FMC_EXAMPLE
	prompt "Example variant"
	default AD7606X_FMC_BASIC_EXAMPLE

config AD7606X_FMC_BASIC_EXAMPLE
	bool "Basic example"
	help
	  Basic example that initializes the AD7606X ADC over the SPI Engine or
	  parallel AXI interface, captures samples via AXI DMA, and prints the
	  results over UART.

config AD7606X_FMC_IIO_EXAMPLE
	bool "IIO example"
	depends on IIO
	help
	  IIO example that exposes the AD7606X ADC through the IIO framework,
	  enabling host-side data capture via libiio over UART.

endchoice

endmenu
```

## projects/ad7616-sdz/Kconfig
```kconfig
menu "ad7616-sdz Configuration"

choice AD7616_SDZ_EXAMPLE
	prompt "Example variant"
	default AD7616_SDZ_DEMO_EXAMPLE

config AD7616_SDZ_DEMO_EXAMPLE
	bool "Demo example"
	help
	  Basic demo that initializes the AD7616 ADC, captures samples via the
	  AXI SPI Engine offload with DMA, and prints the conversion results.

endchoice

endmenu
```

## projects/ad7616-st/Kconfig
```kconfig
menu "AD7616-ST Configuration"

choice AD7616_ST_EXAMPLE
	prompt "Example variant"
	default AD7616_ST_IIO_EXAMPLE

config AD7616_ST_IIO_EXAMPLE
	bool "IIO example"
	depends on IIO
	help
	  IIO example for the AD7616 ADC.

endchoice

endmenu
```

## projects/ad7768-1fmcz/Kconfig
```kconfig
menu "ad7768-1fmcz Configuration"

choice AD7768_1FMCZ_EXAMPLE
	prompt "Example variant"
	default AD7768_1FMCZ_DEMO_EXAMPLE

config AD7768_1FMCZ_DEMO_EXAMPLE
	bool "Demo example"
	help
	  Basic demo that initializes the AD7768-1 ADC via the AXI SPI Engine
	  and AXI clock generator, then reads and prints conversion results
	  continuously using the SPI Engine in standard (non-offload) mode.

config AD7768_1FMCZ_SPI_ENGINE_OFFLOAD_EXAMPLE
	bool "SPI Engine offload example"
	help
	  Offload example that uses the AXI SPI Engine offload mode with DMA
	  to capture a burst of samples from the AD7768-1 ADC into DDR memory
	  and prints the raw results.

endchoice

endmenu
```

## projects/ad7768-evb/Kconfig
```kconfig
menu "ad7768-evb Configuration"

choice AD7768_EVB_EXAMPLE
	prompt "Example variant"
	default AD7768_EVB_DEMO_EXAMPLE

config AD7768_EVB_DEMO_EXAMPLE
	bool "Demo example"
	help
	  Demo example that initializes the AD7768 ADC via AXI ADC core and
	  AXI DMA, and captures samples to DDR.

config AD7768_EVB_IIO_EXAMPLE
	bool "IIO example"
	depends on IIO
	help
	  IIO example that exposes the AD7768 ADC through the IIO framework
	  via iio_axi_adc, enabling host-side data capture over UART.

endchoice

endmenu
```

## projects/ad796x_fmcz/Kconfig
```kconfig
menu "ad796x_fmcz Configuration"

choice AD796X_FMCZ_EXAMPLE
	prompt "Example variant"
	default AD796X_FMCZ_IIO_EXAMPLE

config AD796X_FMCZ_IIO_EXAMPLE
	bool "IIO example"
	depends on IIO
	help
	  IIO example that exposes the AD796x ADC through the IIO framework
	  via iio_axi_adc and AXI DMAC, enabling host-side data capture over
	  UART.

config AD796X_FMCZ_BASIC_EXAMPLE
	bool "Basic example"
	help
	  Basic example that initializes the AD796x ADC via AXI ADC core,
	  AXI DMAC, and AXI PWM generator and captures conversion data.

endchoice

endmenu
```

## projects/ad9081/Kconfig
```kconfig
menu "ad9081 Configuration"

choice AD9081_EXAMPLE
	prompt "Example variant"
	default AD9081_DEMO_EXAMPLE

config AD9081_DEMO_EXAMPLE
	bool "Demo example"
	help
	  Demo example that initializes the AD9081 MxFE (ADC+DAC) via JESD204
	  RX/TX, AXI ADC/DAC core, and DMAC, and captures/plays back data to DDR.

config AD9081_IIO_EXAMPLE
	bool "IIO example"
	depends on IIO
	help
	  IIO example that exposes the AD9081 MxFE through the IIO framework via
	  iio_axi_adc and iio_axi_dac, enabling host-side data capture and
	  injection over UART.

endchoice

endmenu
```

## projects/ad9083/Kconfig
```kconfig
menu "ad9083 Configuration"

choice AD9083_EXAMPLE
	prompt "Example variant"
	default AD9083_DEMO_EXAMPLE

config AD9083_DEMO_EXAMPLE
	bool "Demo example"
	help
	  Demo example that initializes the AD9083 RF ADC via JESD204 RX,
	  AXI ADC core, and DMA, and captures data to DDR.

config AD9083_IIO_EXAMPLE
	bool "IIO example"
	depends on IIO
	help
	  IIO example that exposes the AD9083 ADC through the IIO framework
	  via iio_axi_adc, enabling host-side data capture over UART.

endchoice

endmenu
```

## projects/ad9172/Kconfig
```kconfig
menu "ad9172 Configuration"

choice AD9172_EXAMPLE
	prompt "Example variant"
	default AD9172_DEMO_EXAMPLE

config AD9172_DEMO_EXAMPLE
	bool "Demo example"
	help
	  Demo example that initializes the AD9172 RF DAC via JESD204 TX,
	  AXI DAC core, and HMC7044 clock chip. Uses legacy JESD204 or FSM
	  depending on USE_JESD_FSM. No DMA, no IIO.

config AD9172_IIO_EXAMPLE
	bool "IIO example"
	depends on IIO
	help
	  IIO example that exposes the AD9172 DAC through the IIO framework
	  via iio_axi_dac, enabling host-side data write over UART.

config AD9172_DMA_EXAMPLE
	bool "DMA example"
	help
	  DMA example that loads a sine LUT into DDR and transfers it to the
	  DAC via AXI DMAC, then reads back the transfer status.

endchoice

endmenu
```

## projects/ad9208/Kconfig
```kconfig
menu "ad9208 Configuration"

choice AD9208_EXAMPLE
	prompt "Example variant"
	default AD9208_DEMO_EXAMPLE

config AD9208_DEMO_EXAMPLE
	bool "Demo example"
	help
	  Demo example that initializes dual AD9208 RF ADCs via JESD204 RX,
	  AXI ADC core, and DMA, capturing data to DDR.

config AD9208_IIO_EXAMPLE
	bool "IIO example"
	depends on IIO
	help
	  IIO example that exposes the dual AD9208 ADCs through the IIO
	  framework via iio_axi_adc, enabling host-side data capture over UART.

endchoice

endmenu
```

## projects/ad9265-fmc-125ebz/Kconfig
```kconfig
menu "ad9265-fmc-125ebz Configuration"

choice AD9265_FMC_125EBZ_EXAMPLE
	prompt "Example variant"
	default AD9265_FMC_125EBZ_DEMO_EXAMPLE

config AD9265_FMC_125EBZ_DEMO_EXAMPLE
	bool "Demo example"
	help
	  Demo example that initializes the AD9265 ADC via AXI ADC core and
	  AXI DMA, runs pattern tests, and captures data to DDR.

config AD9265_FMC_125EBZ_IIO_EXAMPLE
	bool "IIO example"
	depends on IIO
	help
	  IIO example that exposes the AD9265 ADC through the IIO framework
	  via iio_axi_adc, enabling host-side data capture over UART.

endchoice

endmenu
```

## projects/ad9361/Kconfig
```kconfig
menu "ad9361 Configuration"

choice AD9361_EXAMPLE
	prompt "Example variant"
	default AD9361_DEMO_EXAMPLE

config AD9361_DEMO_EXAMPLE
	bool "Demo example (FMComms2)"
	help
	  Basic initialization and bring-up example for the AD9361 transceiver
	  via AXI ADC/DAC cores and DMAC, targeting the FMCOMMS2/3/4 board.
	  Supports kcu105, zc702, zc706, zcu102, and zed carriers.

config AD9361_IIO_EXAMPLE
	bool "IIO example (FMComms2)"
	depends on IIO
	help
	  IIO example that exposes the AD9361 transceiver through the IIO
	  framework via iio_axi_adc and iio_axi_dac, enabling host-side data
	  capture and playback over UART (IIOD). Enables -DIIO_SUPPORT.
	  Supports kcu105, zc702, zc706, zcu102, and zed carriers.

config AD9361_DMA_EXAMPLE
	bool "DMA example (FMComms2)"
	help
	  DMA-based data capture and playback example for the AD9361 transceiver.
	  Enables -DDMA_EXAMPLE to activate the DMA transfer code paths.
	  Supports kcu105, zc702, zc706, zcu102, and zed carriers.

config AD9361_DMA_IRQ_EXAMPLE
	bool "DMA+IRQ example (FMComms2)"
	help
	  DMA-based data capture/playback example with IRQ-driven DMA completion
	  notifications. Enables -DDMA_EXAMPLE and -DDMA_IRQ_ENABLE.
	  Supports kcu105, zc702, zc706, zcu102, and zed carriers.

config AD9361_DEMO_FMCOMMS5_EXAMPLE
	bool "Demo example (FMComms5)"
	help
	  Basic initialization and bring-up example for the dual AD9361 transceiver
	  on the FMCOMMS5 board. Enables -DFMCOMMS5 for dual-chip mode.
	  Supports zc702, zc706, and zcu102 carriers.

config AD9361_IIO_FMCOMMS5_EXAMPLE
	bool "IIO example (FMComms5)"
	depends on IIO
	help
	  IIO example for the dual AD9361 transceiver on the FMCOMMS5 board.
	  Enables -DFMCOMMS5 and -DIIO_SUPPORT. Supports zc702, zc706, and
	  zcu102 carriers.

endchoice

endmenu
```

## projects/ad9371/Kconfig
```kconfig
menu "ad9371 Configuration"

choice AD9371_EXAMPLE
	prompt "Example variant"
	default AD9371_DEMO_EXAMPLE

config AD9371_DEMO_EXAMPLE
	bool "Demo example"
	help
	  Basic initialization and bring-up example for the AD9371 transceiver
	  via AXI ADC/DAC cores, JESD204 and DMAC, targeting zc706, zcu102, or
	  kcu105.

config AD9371_DMA_EXAMPLE
	bool "DMA example"
	help
	  DMA-based data capture and playback example for the AD9371 transceiver.
	  Enables -DDMA_EXAMPLE to activate the DMA transfer code paths.

config AD9371_IIO_EXAMPLE
	bool "IIO example"
	depends on IIO
	help
	  IIO example that exposes the AD9371 transceiver through the IIO
	  framework via iio_axi_adc and iio_axi_dac, enabling host-side data
	  capture and playback over UART (IIOD).  Enables -DIIO_SUPPORT.

endchoice

endmenu
```

## projects/ad9434-fmc-500ebz/Kconfig
```kconfig
menu "ad9434-fmc-500ebz Configuration"

choice AD9434_FMC_500EBZ_EXAMPLE
	prompt "Example variant"
	default AD9434_FMC_500EBZ_DEMO_EXAMPLE

config AD9434_FMC_500EBZ_DEMO_EXAMPLE
	bool "Demo example"
	help
	  Demo example that initializes the AD9434 ADC via AXI ADC core and
	  AXI DMA, runs pattern tests, and captures data to DDR.

config AD9434_FMC_500EBZ_IIO_EXAMPLE
	bool "IIO example"
	depends on IIO
	help
	  IIO example that exposes the AD9434 ADC through the IIO framework
	  via iio_axi_adc, enabling host-side data capture over UART.

endchoice

endmenu
```

## projects/ad9467/Kconfig
```kconfig
menu "ad9467 Configuration"

choice AD9467_EXAMPLE
	prompt "Example variant"
	default AD9467_DEMO_EXAMPLE

config AD9467_DEMO_EXAMPLE
	bool "Demo example"
	help
	  Demo example that initializes the AD9467 ADC via AXI ADC core and
	  AXI DMA, runs pattern tests, and captures data to DDR.

config AD9467_IIO_EXAMPLE
	bool "IIO example"
	depends on IIO
	help
	  IIO example that exposes the AD9467 ADC through the IIO framework
	  via iio_axi_adc, enabling host-side data capture over UART.

endchoice

endmenu
```

## projects/ad9656_fmc/Kconfig
```kconfig
menu "ad9656_fmc Configuration"

choice AD9656_FMC_EXAMPLE
	prompt "Example variant"
	default AD9656_FMC_DEMO_EXAMPLE

config AD9656_FMC_DEMO_EXAMPLE
	bool "Demo example"
	help
	  Demo example that initializes the AD9656 quad ADC via JESD204 RX,
	  AXI ADC core, and DMA, performs PN sequence tests and captures data
	  to DDR.

config AD9656_FMC_IIO_EXAMPLE
	bool "IIO example"
	depends on IIO
	help
	  IIO example that exposes the AD9656 ADC through the IIO framework
	  via iio_axi_adc, enabling host-side data capture over UART.

endchoice

endmenu
```

## projects/ada4250_ardz/Kconfig
```kconfig
menu "ADA4250-ARDZ Configuration"

choice ADA4250_ARDZ_EXAMPLE
	prompt "Example variant"
	default ADA4250_ARDZ_IIO_EXAMPLE

config ADA4250_ARDZ_IIO_EXAMPLE
	bool "IIO example"
	depends on IIO
	help
	  IIO example that exposes the ADA4250 programmable-gain amplifier
	  over an IIO interface on top of a UART transport.

endchoice

endmenu
```

## projects/adalm-lsmspg/Kconfig
```kconfig
menu "adalm-lsmspg Configuration"

choice ADALM_LSMSPG_EXAMPLE
	prompt "Example variant"
	default ADALM_LSMSPG_IIO_EXAMPLE

config ADALM_LSMSPG_IIO_EXAMPLE
	bool "IIO example"
	depends on IIO

config ADALM_LSMSPG_CURVETRACE_EXAMPLE
	bool "Curvetrace example"

endchoice

endmenu
```

## projects/adalm-mmsc/Kconfig
```kconfig
menu "ADALM-MMSC Configuration"

choice ADALM_MMSC_EXAMPLE
	prompt "Example variant"
	default ADALM_MMSC_IIO_EXAMPLE

config ADALM_MMSC_IIO_EXAMPLE
	bool "IIO example"
	depends on IIO

endchoice

endmenu
```
