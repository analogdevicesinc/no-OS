## projects/ad9088/Kconfig
```kconfig
menu "ad9088 Configuration"

choice AD9088_EXAMPLE
	prompt "Example variant"
	default AD9088_BASIC_EXAMPLE

config AD9088_BASIC_EXAMPLE
	bool "Basic example"
	help
	  Brings the AD9088 up over SPI, loads the device profile and core
	  firmware, and runs the JESD204 link through to LINK_RUNNING.

config AD9088_DMA_EXAMPLE
	bool "DMA example"
	help
	  Captures from the ADCs and plays back through the DACs over AXI
	  DMA, including the NCO test tone and cabled DAC-to-ADC loopback
	  coherence checks.

endchoice

config AD9088_PROFILE
	string "Use-case profile image"
	default "204C_M4_L8_NP16_20p0_4x2.bin"
	help
	  Device profile image to embed in the ELF. A bare file name is taken
	  relative to drivers/rf-transceiver/ad9088/firmware/; an absolute path
	  is used as given, so a profile generated outside the tree works too.

	  The image describes the datapath (JESD204 mode, converter counts,
	  sample rates) and must match the HDL design on the board. Whichever
	  one is picked, it is embedded under the name usecase.bin so the
	  symbols the driver looks for never change.

endmenu
```

## projects/ad9545/Kconfig
```kconfig
menu "ad9545 Configuration"

choice AD9545_EXAMPLE
	prompt "Example variant"
	default AD9545_BASIC_EXAMPLE

config AD9545_BASIC_EXAMPLE
	bool "Basic example"
	help
	  Basic example demonstrating AD9545 clock synthesizer initialization,
	  PLL configuration, and output clock generation.

endchoice

endmenu
```

## projects/adar300x/Kconfig
```kconfig
menu "adar300x Configuration"

choice ADAR300X_EXAMPLE
	prompt "Example variant"
	default ADAR300X_BASIC_EXAMPLE

config ADAR300X_BASIC_EXAMPLE
	bool "Basic example"
	help
	  SPI and power validation: soft reset, scratchpad loopback and
	  chip ID readback for the ADAR3000/ADAR3001 beamformer.

config ADAR300X_IIO_EXAMPLE
	bool "IIO example"
	help
	  Exposes the beamformer as an IIO device over UART, for use with
	  libiio clients such as iio_info and IIO Oscilloscope.

endchoice

endmenu
```

## projects/adf4368/Kconfig
```kconfig
menu "ADF4368 Configuration"

choice ADF4368_EXAMPLE
	prompt "Example variant"
	default ADF4368_BASIC_EXAMPLE

config ADF4368_BASIC_EXAMPLE
	bool "Basic example"
	help
	  Simple example that configures the ADF4368 microwave wideband
	  synthesizer and prints the resulting register state over UART.

config ADF4368_IIO_EXAMPLE
	bool "IIO example"
	depends on IIO
	help
	  IIO framework example. Launches an IIOD server for remote
	  data acquisition using IIO Oscilloscope or libiio clients.

config ADF4368_SWEEP_EXAMPLE
	bool "Sweep example"
	help
	  Builds the VCO calibration table with an on-device auto-cal sweep,
	  replays it with the fast FRAC1WORD/N_INT sweep, then launches the
	  IIOD server. Running the sweep in firmware avoids libiio timeouts.

endchoice

endmenu
```

## projects/adin1110/Kconfig
```kconfig
menu "adin1110 Configuration"

choice ADIN1110_EXAMPLE
	prompt "Example variant"
	default ADIN1110_FRAME_RX_TX_EXAMPLE

config ADIN1110_FRAME_RX_TX_EXAMPLE
	bool "Frame RX/TX example"

config ADIN1110_OA_TC6_PERF_EXAMPLE
	bool "ADIN1110 OA TC6 full duplex performance example"
	depends on NET && ADIN1110
	help
	  Benchmarks full duplex throughput of the ADIN1110 MAC/PHY.
	  Continuously transmits frames while receiving frames from a
	  companion PC script, printing periodic throughput stats over
	  UART. The SPI protocol/protection combination is selected below.

config ADIN1110_LWIP_UDP_PERF_EXAMPLE
	bool "ADIN1110 lwIP UDP throughput example"
	depends on NET && ADIN1110 && OA_TC6 && LWIP
	help
	  Benchmarks UDP throughput over lwIP on the ADIN1110 in OPEN
	  Alliance mode. Streams UDP datagrams to a companion PC script
	  while counting the datagrams it sends back, and prints the UDP
	  payload throughput and the CPU load over UART.

endchoice

config ADIN1110_UDP_PERF_HOST_IP
	string "IP address of the PC running the UDP perf script"
	depends on ADIN1110_LWIP_UDP_PERF_EXAMPLE
	default "192.168.80.50"

config ADIN1110_UDP_PERF_PORT
	int "UDP port used in both directions"
	depends on ADIN1110_LWIP_UDP_PERF_EXAMPLE
	default 5001

choice ADIN1110_OA_TC6_PERF_SPI_MODE
	prompt "SPI protocol mode"
	depends on ADIN1110_OA_TC6_PERF_EXAMPLE
	default ADIN1110_OA_TC6_PERF_OA_TC6_UNPROTECTED

config ADIN1110_OA_TC6_PERF_GENERIC_UNPROTECTED
	bool "Generic SPI, unprotected"
	help
	  Classic ADIN1110 register-based SPI transactions, without the
	  8-bit CRC header protection.

config ADIN1110_OA_TC6_PERF_GENERIC_PROTECTED
	bool "Generic SPI, protected"
	help
	  Classic ADIN1110 register-based SPI transactions, with the 8-bit
	  CRC header protection enabled.

config ADIN1110_OA_TC6_PERF_OA_TC6_UNPROTECTED
	bool "OA TC6 native chunk SPI, unprotected control transactions"
	help
	  Open Alliance TC6 chunk-based SPI protocol, with control
	  (register access) transactions left unprotected.

config ADIN1110_OA_TC6_PERF_OA_TC6_PROTECTED
	bool "OA TC6 native chunk SPI, protected control transactions"
	help
	  Open Alliance TC6 chunk-based SPI protocol, with control
	  (register access) transactions protected (Protected SPI).

endchoice

endmenu
```

## projects/adin1140/Kconfig
```kconfig
menu "ADIN1140 Configuration"

choice ADIN1140_EXAMPLE
	prompt "Example variant"
	default ADIN1140_FRAME_RX_TX_EXAMPLE

config ADIN1140_FRAME_RX_TX_EXAMPLE
	bool "Frame RX/TX example"
	depends on NET && ADIN1140
	help
	  Raw Ethernet frame transmit/receive loop that exercises the
	  ADIN1140 MAC/PHY driver directly (driver-level smoke test).

config ADIN1140_FRAME_BLAST_EXAMPLE
	bool "Raw L2 throughput (frame blast) example"
	depends on NET && ADIN1140
	help
	  Raw Ethernet (layer-2) throughput test: blasts or counts max-size
	  frames back-to-back with no IP/TCP/UDP overhead, to measure the true
	  MAC-layer throughput of the 10BASE-T1S link. Pairs with the host-side
	  l2_send/l2_recv tools under projects/adin1140/host.

config ADIN1140_IPERF_LWIP_EXAMPLE
	bool "iperf over lwIP example"
	depends on LWIP && NET && ADIN1140
	help
	  TCP/UDP throughput measurement using lwIP + lwiperf on top of
	  the ADIN1140 MAC/PHY over Ethernet.

config ADIN1140_IPERF_LWIP_FREERTOS_EXAMPLE
	bool "iperf over lwIP on FreeRTOS example"
	depends on LWIP && NET && ADIN1140 && FREERTOS
	help
	  TCP/UDP throughput measurement using lwIP + lwiperf running
	  on FreeRTOS on top of the ADIN1140 MAC/PHY over Ethernet.

endchoice

config ADIN1140_IPERF_UDP_CLIENT_IP
	string "iperf UDP client target IP (empty = server only)"
	depends on ADIN1140_IPERF_LWIP_FREERTOS_EXAMPLE
	help
	  When set to a peer's IPv4 address (e.g. "192.168.97.41"), the board
	  also runs an iperf UDP client that streams to that peer running
	  "iperf -s -u", in addition to the always-on TCP/UDP servers. Leave
	  empty to keep server-only behaviour.

config ADIN1140_IPERF_UDP_CLIENT_RATE
	int "iperf UDP client target rate (bits/s)"
	default 5000000
	depends on ADIN1140_IPERF_LWIP_FREERTOS_EXAMPLE
	help
	  Target send rate for the UDP client, in bits per second. The
	  10BASE-T1S link tops out around 10 Mbit/s.

config ADIN1140_IPERF_UDP_CLIENT_TIME
	int "iperf UDP client test duration (seconds)"
	default 10
	depends on ADIN1140_IPERF_LWIP_FREERTOS_EXAMPLE
	help
	  Duration of the UDP client test, in seconds.

endmenu
```

## projects/adiol100/Kconfig
```kconfig
menu "ADIOL100 Configuration"

config ADIOL100_BASIC_EXAMPLE
	bool "Basic example"
	default y

endmenu
```

## projects/adp20086/Kconfig
```kconfig
menu "ADP20086 Configuration"

choice ADP20086_EXAMPLE
    prompt "Example variant"
    default ADP20086_BASIC_EXAMPLE

config ADP20086_BASIC_EXAMPLE
    bool "Basic example"

config ADP20086_IIO_EXAMPLE
    bool "IIO example"
	depends on IIO

endchoice

endmenu
```

## projects/adv7511/Kconfig
```kconfig
menu "adv7511 Configuration"

choice ADV7511_EXAMPLE
	prompt "Example variant"
	default ADV7511_DEMO_EXAMPLE

config ADV7511_DEMO_EXAMPLE
	bool "Demo"
	help
	  ADV7511 HDMI transmitter demo for the ZedBoard platform.

endchoice

endmenu
```

## projects/apardpfwd/Kconfig
```kconfig
menu "apardpfwd Configuration"

choice APARDPFWD_EXAMPLE
	prompt "Example variant"
	default APARDPFWD_APARD_COMMUNICATION_EXAMPLE

config APARDPFWD_APARD_COMMUNICATION_EXAMPLE
	bool "APARD communication example"
	depends on LWIP && NET && ADIN1110
	help
	  TCP communication example using LWIP and the ADIN1110
	  MAC/PHY over Ethernet.

config APARDPFWD_FORWARD_PACKETS_EXAMPLE
	bool "Forward packets example"
	depends on NET && ADIN1110
	help
	  Example that forwards packets using the ADIN1110 MAC/PHY driver.

config APARDPFWD_COMMUNICATION_AND_FORWARD_EXAMPLE
	bool "Communication and forward example"
	depends on LWIP && NET && ADIN1110
	help
	  TCP communication example combined with packet forwarding using
	  LWIP and the ADIN1110 MAC/PHY over Ethernet.

config APARDPFWD_SERVO_CONTROL_EXAMPLE
	bool "Servo control example"
	depends on LWIP && NET && ADIN1110 && PWM
	help
	  Drives hobby servos via PWM (50 Hz) and exposes SERVO1_ON /
	  SERVO1_OFF / SERVO2_ON / SERVO2_OFF / SERVO_STATUS commands over
	  a TCP socket on the ADIN1110 link.

endchoice

endmenu
```

## projects/apardspoe/Kconfig
```kconfig
menu "apardspoe Configuration"

choice APARDSPOE_EXAMPLE
	prompt "Example variant"
	default APARDSPOE_APARD_COMMUNICATION_EXAMPLE

config APARDSPOE_APARD_COMMUNICATION_EXAMPLE
	bool "APARD communication example"
	depends on LWIP && NET && ADIN1110
	help
	  TCP communication example using LWIP and the ADIN1110
	  MAC/PHY over Ethernet.

config APARDSPOE_COLOR_SENSOR_EXAMPLE
	bool "Color sensor example"
	depends on LWIP && NET && ADIN1110 && COLOR_TCS34725 && I2C
	help
	  Reads RGBC data from a TCS34725 color sensor and exposes it
	  over a TCP command server on the ADIN1110 link.

endchoice

endmenu
```

## projects/capi_coprocessor_max78000/Kconfig
```kconfig
menu "capi_coprocessor_max78000 Configuration"

choice CAPI_COPROCESSOR_MAX78000_EXAMPLE
	prompt "Example variant"
	default CAPI_COPROCESSOR_DEMO_EXAMPLE

config CAPI_COPROCESSOR_DEMO_EXAMPLE
	bool "QVGA camera coprocessor example"
	help
	  Runs OVM7692 QVGA capture and streaming statistics on the MAX78000
	  RV32 core (CPU1), transports RGB565 tiles through shared SRAM and a
	  CAPI mailbox, and displays the video with a text overlay on the EVKIT
	  TFT. PB1 provides a debugger-safe pause and PB2 demonstrates CAPI
	  PARKED/RUN lifecycle control.

endchoice

endmenu
```

## projects/capi_selftest/Kconfig
```kconfig
menu "capi_selftest Configuration"

choice CAPI_SELFTEST_EXAMPLE
	prompt "Example variant"
	default CAPI_SELFTEST_BASIC_EXAMPLE

config CAPI_SELFTEST_BASIC_EXAMPLE
	bool "Basic example"
	help
	  Basic CAPI self-test example.

config CAPI_SELFTEST_LOOPBACK_EXAMPLE
	bool "Loopback example"
	help
	  CAPI loopback test example (SPI, I2C, GPIO, IRQ, DMA, timer tests).

endchoice

endmenu
```

## projects/eval-ad5933ardz/Kconfig
```kconfig
menu "eval-ad5933ardz Configuration"

choice EVAL_AD5933ARDZ_EXAMPLE
	prompt "Example variant"
	default EVAL_AD5933ARDZ_BASIC_EXAMPLE

config EVAL_AD5933ARDZ_BASIC_EXAMPLE
	bool "Basic example"

config EVAL_AD5933ARDZ_IIO_EXAMPLE
	bool "IIO example"
	depends on IIO

endchoice

endmenu
```

## projects/eval-ad7191/Kconfig
```kconfig
menu "eval-ad7191 Configuration"

choice EVAL_AD7191_EXAMPLE
	prompt "Example variant"
	default EVAL_AD7191_BASIC_EXAMPLE

config EVAL_AD7191_BASIC_EXAMPLE
	bool "Basic example"
	select ADC_AD7191

config EVAL_AD7191_IIO_EXAMPLE
	bool "IIO example"
	depends on IIO
	select ADC_IIO_AD7191

endchoice

endmenu
```

## projects/eval-ade9039/Kconfig
```kconfig
menu "eval-ade9039 Configuration"

choice EVAL_ADE9039_EXAMPLE
	prompt "Example variant"
	default EVAL_ADE9039_ADE9039_EXAMPLE

config EVAL_ADE9039_ADE9039_EXAMPLE
	bool "ADE9039 example"

endchoice

endmenu
```

## projects/eval-adhv4710/Kconfig
```kconfig
menu "eval-adhv4710 Configuration"

choice EVAL_ADHV4710_EXAMPLE
	prompt "Example variant"
	default EVAL_ADHV4710_ADHV4710_EXAMPLE

config EVAL_ADHV4710_ADHV4710_EXAMPLE
	bool "ADHV4710 example"

endchoice

choice EVAL_ADHV4710_VARIANT
	prompt "Device variant"
	default EVAL_ADHV4710_VARIANT_ADHV4710
	help
	  Select the amplifier variant on the evaluation board. The driver
	  validates CTRL_REG_26 against the expected product-version at init.

config EVAL_ADHV4710_VARIANT_ADHV4710
	bool "ADHV4710"

config EVAL_ADHV4710_VARIANT_ADHV4711
	bool "ADHV4711"

endchoice

endmenu
```

## projects/eval-adis16607/Kconfig
```kconfig
menu "eval-adis16607 Configuration"

choice EVAL_ADIS16607_EXAMPLE
	prompt "Example variant"
	default EVAL_ADIS16607_IIO_TRIGGER_EXAMPLE

config EVAL_ADIS16607_IIO_TRIGGER_EXAMPLE
	bool "IIO trigger example"
	depends on IIO

config EVAL_ADIS16607_BASIC_EXAMPLE
	bool "Basic example"

endchoice

endmenu
```

## projects/eval-adxl37x/Kconfig
```kconfig
menu "eval-adxl37x Configuration"

choice EVAL_ADXL37X_EXAMPLE
	prompt "Example variant"
	default EVAL_ADXL37X_BASIC_EXAMPLE

config EVAL_ADXL37X_BASIC_EXAMPLE
	bool "Basic example"
	help
	  Simple example that configures the FIFO in streamed mode, reads
	  acceleration data from it and prints the samples over UART.

config EVAL_ADXL37X_IIO_EXAMPLE
	bool "IIO example"
	depends on IIO
	help
	  IIO framework example. Launches an IIOD server over UART so the
	  device can be accessed with IIO Oscilloscope or libiio clients.

endchoice

endmenu
```

## projects/eval-powrms/Kconfig
```kconfig
menu "eval-powrms Configuration"

choice EVAL_POWRMS_EXAMPLE
	prompt "Example variant"
	default EVAL_POWRMS_EXAMPLE_EXAMPLE

config EVAL_POWRMS_EXAMPLE_EXAMPLE
	bool "Basic example"
	depends on IIO

endchoice

endmenu
```

## projects/eval-pqmon/Kconfig
```kconfig
menu "eval-pqmon Configuration"

choice EVAL_PQMON_EXAMPLE
	prompt "Example variant"
	default EVAL_PQMON_BASIC_EXAMPLE

config EVAL_PQMON_BASIC_EXAMPLE
	bool "Basic example"
	depends on IIO

endchoice

choice EVAL_PQMON_INTERFACE
	prompt "IIO transport interface"
	default EVAL_PQMON_CONN_USB

config EVAL_PQMON_CONN_USB
	bool "USB CDC-ACM"

config EVAL_PQMON_CONN_SERIAL
	bool "UART / RS-485"

config EVAL_PQMON_CONN_ETH
	bool "Ethernet (W5500)"

config EVAL_PQMON_CONN_T1L
	bool "Ethernet 10BASE-T1L (ADIN1110)"

endchoice

config EVAL_PQMON_UART_EXPORT
	bool "CSV data export over UART2"
	default y
	help
	  Stream harmonics and metrology data as CSV frames on UART2 on every
	  pqlib 10/12-cycle update. Defines UART_EXPORT_ENABLED.

endmenu
```

## projects/hello_world/Kconfig
```kconfig
menu "hello_world Configuration"

config HELLO_WORLD_BASIC_EXAMPLE
	bool "Basic example"
	default y
	help
	  Minimal UART hello-world example.

endmenu
```

## projects/iio_demo/Kconfig
```kconfig
menu "IIO Demo Configuration"

choice IIO_DEMO_EXAMPLE
	prompt "Example variant"
	default IIO_DEMO_IIO_EXAMPLE

config IIO_DEMO_IIO_EXAMPLE
	bool "Basic IIO example"

config IIO_DEMO_IIO_TIMER_TRIGGER_EXAMPLE
	bool "IIO timer trigger example"

config IIO_DEMO_IIO_SW_TRIGGER_EXAMPLE
	bool "IIO software trigger example"

config IIO_DEMO_LIBIIO_EXAMPLE
	bool "Basic example served by libiio"
	depends on LIBIIO
	help
	  adc_demo and dac_demo (and the part's own ADC with IIO_ADC_MAXIM)
	  served by libiio's iiod instead of iio_app, over the transport
	  picked in LIBIIO_TRANSPORT.

endchoice

config IIO_DEMO_NETWORKING
	bool "Enable ESP8266 Wi-Fi networking"
	default n
	select WIFI_NETWORKING
	help
	  Route IIO transport over an ESP8266 Wi-Fi module (UART AT commands)
	  instead of the serial backend. aducm3029/eval-adicup3029 only.

endmenu
```
