## projects/ftc_workshop/boards/apard32690_normal.conf
```kconfig
BOARD_NAME=apard32690
PLATFORM=maxim
TARGET=max32690
DESCRIPTION="APARD32690 board support for FTC Workshop - Normal UART"

# Override USB UART from board default
# CONFIG_USB_UART_MAXIM is not set
```

## projects/ftc_workshop/boards/apard32690_usb.conf
```kconfig
BOARD_NAME=apard32690
PLATFORM=maxim
TARGET=max32690
DESCRIPTION="APARD32690 board support for FTC Workshop - USB UART"

# Keep USB UART enabled (from board default)
CONFIG_USB_UART_MAXIM=y
```

## projects/ftc_workshop_capi/Kconfig
```kconfig
menu "FTC Workshop BLE Configuration"

config USE_USB_UART
	bool
	default y if UART_TYPE_USB
	default n

choice PROJECT_VERSION

	prompt "Project version"
	default EXERCISE_1
	help
	  Select which project version to compile.

config EXERCISE_1
	bool "Enable exercise 1"
	help
		Enable exercise 1.

config EXERCISE_2
	bool "Enable exercise 2"
	help
		Enable exercise 2.

config EXERCISE_3
	bool "Enable exercise 3"
	help
		Enable exercise 3.

config EXERCISE_4
	bool "Enable exercise 4"
	help
		Enable exercise 4.

endchoice

endmenu
```

## projects/ftc_workshop_capi/boards/max32655_fthr.conf
```kconfig
CONFIG_MAXIM_CAPI=y
CONFIG_CAPI_UART_MAXIM=y
CONFIG_CAPI_UART_STDIO_MAXIM=y
CONFIG_CAPI_GPIO_MAXIM=y
CONFIG_CAPI_I2C_MAXIM=y
CONFIG_CAPI_SPI_MAXIM=y
CONFIG_CAPI_DMA_MAXIM=y
CONFIG_CAPI_PINCTRL_MAXIM=y
CONFIG_PLATFORM_I2C_BITBANG=y
CONFIG_PLATFORM_I2C_BITBANG_CAPI=y
```

## projects/iio_adpd1080/Kconfig
```kconfig
menu "IIO ADPD1080 Configuration"

choice IIO_ADPD1080_EXAMPLE
	prompt "Example variant"
	default IIO_ADPD1080_IIO_EXAMPLE

config IIO_ADPD1080_IIO_EXAMPLE
	bool "IIO example"
	depends on IIO
	help
	  IIO example that exposes the ADPD1080/ADPD188 photometric front-end
	  over an IIO interface on top of a UART transport.

endchoice

config IIO_ADPD1080_NETWORKING
	bool "Enable ESP8266 Wi-Fi networking"
	default n
	select WIFI_NETWORKING
	help
	  Route IIO transport over an ESP8266 Wi-Fi module (UART AT commands)
	  instead of the serial backend. aducm3029/eval-adicup3029 only.

endmenu
```

## projects/iio_demo_freeRTOS/Kconfig
```kconfig
menu "iio_demo_freeRTOS Configuration"

choice IIO_DEMO_FREERTOS_EXAMPLE
	prompt "Example variant"
	default IIO_DEMO_FREERTOS_IIO_EXAMPLE

config IIO_DEMO_FREERTOS_IIO_EXAMPLE
	bool "IIO example"
	depends on IIO

endchoice

endmenu
```

## projects/lt3074/Kconfig
```kconfig
menu "LT3074 Configuration"

choice LT3074_EXAMPLE
	prompt "Example variant"
	default LT3074_BASIC_EXAMPLE

config LT3074_BASIC_EXAMPLE
	bool "Basic example"

config LT3074_IIO_EXAMPLE
	bool "IIO example"
	depends on IIO

endchoice

endmenu
```

## projects/lt7170/Kconfig
```kconfig
menu "LT7170 Configuration"

choice LT7170_EXAMPLE
	prompt "Example variant"
	default LT7170_BASIC_EXAMPLE

config LT7170_BASIC_EXAMPLE
	bool "Basic example"

config LT7170_IIO_EXAMPLE
	bool "IIO example"
	depends on IIO

endchoice

endmenu
```

## projects/lt7182s/Kconfig
```kconfig
menu "LT7182S Configuration"

choice LT7182S_EXAMPLE
	prompt "Example variant"
	default LT7182S_BASIC_EXAMPLE

config LT7182S_BASIC_EXAMPLE
	bool "Basic example"

config LT7182S_IIO_EXAMPLE
	bool "IIO example"
	depends on IIO

endchoice

endmenu
```

## projects/lt8722/Kconfig
```kconfig
menu "LT8722 Configuration"

choice LT8722_EXAMPLE
	prompt "Example variant"
	default LT8722_BASIC_EXAMPLE

config LT8722_BASIC_EXAMPLE
	bool "Basic example"

config LT8722_IIO_EXAMPLE
	bool "IIO example"
	depends on IIO

endchoice

endmenu
```

## projects/ltc2378/Kconfig
```kconfig
menu "LTC2378 Configuration"

choice LTC2378_EXAMPLE
	prompt "Example variant"
	default LTC2378_BASIC_EXAMPLE

config LTC2378_BASIC_EXAMPLE
	bool "Basic example"

config LTC2378_IIO_EXAMPLE
	bool "IIO example"
	depends on IIO

endchoice

endmenu
```

## projects/ltc2983/Kconfig
```kconfig
menu "ltc2983 Configuration"

choice LTC2983_EXAMPLE
	prompt "Example variant"
	default LTC2983_BASIC_EXAMPLE

config LTC2983_BASIC_EXAMPLE
	bool "Basic example"

config LTC2983_IIO_EXAMPLE
	bool "IIO example"
	depends on IIO

config LTC2983_ADT7604_BASIC_EXAMPLE
	bool "ADT7604 Basic example"

config LTC2983_ADT7604_IIO_EXAMPLE
	bool "ADT7604 IIO example"
	depends on IIO

endchoice

endmenu
```

## projects/ltc3208/Kconfig
```kconfig
menu "LTC3208 Configuration"

choice LTC3208_EXAMPLE
	prompt "Example variant"
	default LTC3208_BASIC_EXAMPLE

config LTC3208_BASIC_EXAMPLE
	bool "Basic example"

endchoice

endmenu
```

## projects/ltc3220/Kconfig
```kconfig
menu "ltc3220 Configuration"

choice LTC3220_EXAMPLE
	prompt "Example variant"
	default LTC3220_BASIC_EXAMPLE

config LTC3220_BASIC_EXAMPLE
	bool "Basic example"

endchoice

endmenu
```

## projects/ltc3337/Kconfig
```kconfig
menu "LTC3337 Configuration"

choice LTC3337_EXAMPLE
	prompt "Example variant"
	default LTC3337_BASIC_EXAMPLE

config LTC3337_BASIC_EXAMPLE
	bool "Basic example"

endchoice

endmenu
```

## projects/ltc4162l/Kconfig
```kconfig
menu "LTC4162L Configuration"

choice LTC4162L_EXAMPLE
	prompt "Example variant"
	default LTC4162L_BASIC_EXAMPLE

config LTC4162L_BASIC_EXAMPLE
	bool "Basic example"

config LTC4162L_IIO_EXAMPLE
	bool "IIO example"
	depends on IIO

endchoice

endmenu
```

## projects/ltc4296/Kconfig
```kconfig
menu "ltc4296 Configuration"

choice LTC4296_EXAMPLE
	prompt "Example variant"
	default LTC4296_BASIC_EXAMPLE

config LTC4296_BASIC_EXAMPLE
	bool "Basic example"

endchoice

endmenu
```

## projects/ltc7841/Kconfig
```kconfig
menu "LTC7841 Configuration"

choice LTC7841_EXAMPLE
	prompt "Example variant"
	default LTC7841_BASIC_EXAMPLE

config LTC7841_BASIC_EXAMPLE
	bool "Basic example"

config LTC7841_IIO_EXAMPLE
	bool "IIO example"
	depends on IIO

endchoice

endmenu
```

## projects/ltc7871/Kconfig
```kconfig
menu "LTC7871 Configuration"

choice LTC7871_EXAMPLE
	prompt "Example variant"
	default LTC7871_BASIC_EXAMPLE

config LTC7871_BASIC_EXAMPLE
	bool "Basic example"

config LTC7871_IIO_EXAMPLE
	bool "IIO example"
	depends on IIO

endchoice

endmenu
```

## projects/ltm3360b/Kconfig
```kconfig
menu "LTM3360B Configuration"

choice LTM3360B_EXAMPLE
	prompt "Example variant"
	default LTM3360B_BASIC_EXAMPLE

config LTM3360B_BASIC_EXAMPLE
	bool "Basic example"
	help
	  Basic example that configures the LTM3360B power module and reads
	  the ADC values over UART.

endchoice

endmenu
```

## projects/ltm4686/Kconfig
```kconfig
menu "LTM4686 Configuration"

choice LTM4686_EXAMPLE
	prompt "Example variant"
	default LTM4686_BASIC_EXAMPLE

config LTM4686_BASIC_EXAMPLE
	bool "Basic example"

config LTM4686_IIO_EXAMPLE
	bool "IIO example"
	depends on IIO

endchoice

endmenu
```
