## projects/adaq7980_sdz/Kconfig
```kconfig
menu "adaq7980_sdz Configuration"

choice ADAQ7980_SDZ_EXAMPLE
	prompt "Example variant"
	default ADAQ7980_SDZ_DEMO_EXAMPLE

config ADAQ7980_SDZ_DEMO_EXAMPLE
	bool "Demo"
	help
	  Basic demo that initializes the ADAQ7980 ADC using SPI Engine offload
	  and reads ADC samples using AXI DMA.

endchoice

endmenu
```

## projects/adaq8092_fmc/Kconfig
```kconfig
menu "adaq8092_fmc Configuration"

choice ADAQ8092_FMC_EXAMPLE
	prompt "Example variant"
	default ADAQ8092_FMC_DEMO_EXAMPLE

config ADAQ8092_FMC_DEMO_EXAMPLE
	bool "Demo example"
	help
	  Demo example that initializes the ADAQ8092 ADC via AXI ADC core and
	  AXI DMA, runs a checkerboard pattern test, and captures data to DDR.

config ADAQ8092_FMC_IIO_EXAMPLE
	bool "IIO example"
	depends on IIO
	help
	  IIO example that exposes the ADAQ8092 ADC through the IIO framework
	  via iio_axi_adc, enabling host-side data capture over UART.

endchoice

endmenu
```

## projects/ade7816/Kconfig
```kconfig
menu "ADE7816 Configuration"

choice ADE7816_EXAMPLE
	prompt "Example variant"
	default ADE7816_BASIC_EXAMPLE

config ADE7816_BASIC_EXAMPLE
	bool "Basic example"

endchoice

endmenu
```

## projects/ades1754/Kconfig
```kconfig
menu "ADES1754 Configuration"

choice ADES1754_EXAMPLE
	prompt "Example variant"
	default ADES1754_BASIC_EXAMPLE

config ADES1754_BASIC_EXAMPLE
	bool "Basic example"

config ADES1754_SPI_UART_BRIDGE_EXAMPLE
	bool "SPI UART bridge example"

endchoice

endmenu
```

## projects/adf4030/Kconfig
```kconfig
menu "ADF4030 Configuration"

choice ADF4030_EXAMPLE
	prompt "Example variant"
	default ADF4030_BASIC_EXAMPLE

config ADF4030_BASIC_EXAMPLE
	bool "Basic example"
	help
	  Simple example that configures the ADF4030 precision synchronizer
	  and prints the resulting register state over UART.

config ADF4030_IIO_EXAMPLE
	bool "IIO example"
	depends on IIO
	help
	  IIO framework example. Launches an IIOD server for remote
	  data acquisition using IIO Oscilloscope or libiio clients.

endchoice

endmenu
```

## projects/adf4371/Kconfig
```kconfig
menu "ADF4371 Configuration"

choice ADF4371_EXAMPLE
	prompt "Example variant"
	default ADF4371_BASIC_EXAMPLE

config ADF4371_BASIC_EXAMPLE
	bool "Basic example"
	help
	  Simple example that configures the ADF4371 PLL and prints
	  the resulting register state over UART.

endchoice

endmenu
```

## projects/adf4377_sdz/Kconfig
```kconfig
menu "ADF4377 Configuration"

choice ADF4377_EXAMPLE
	prompt "Example variant"
	default ADF4377_BASIC_EXAMPLE

config ADF4377_BASIC_EXAMPLE
	bool "Basic example"
	help
	  Simple example that configures the ADF4377 wideband synthesizer
	  and generates a fixed RF output frequency.

config ADF4377_IIO_EXAMPLE
	bool "IIO example"
	depends on IIO
	help
	  IIO framework example. Launches an IIOD server for remote
	  configuration using IIO Oscilloscope or libiio clients.

endchoice

endmenu
```

## projects/adf4382/Kconfig
```kconfig
menu "ADF4382 Configuration"

choice ADF4382_EXAMPLE
	prompt "Example variant"
	default ADF4382_BASIC_EXAMPLE

config ADF4382_BASIC_EXAMPLE
	bool "Basic example"
	help
	  Simple example that configures the ADF4382 PLL and prints
	  the resulting register state over UART.

config ADF4382_IIO_EXAMPLE
	bool "IIO example"
	depends on IIO
	help
	  IIO framework example. Launches an IIOD server for remote
	  data acquisition using IIO Oscilloscope or libiio clients.

endchoice

endmenu
```

## projects/adf5611/Kconfig
```kconfig
menu "ADF5611 Configuration"

choice ADF5611_EXAMPLE
	prompt "Example variant"
	default ADF5611_BASIC_EXAMPLE

config ADF5611_BASIC_EXAMPLE
	bool "Basic example"
	help
	  Simple example that configures the ADF5611 microwave wideband
	  synthesizer and generates a fixed RF output frequency.

config ADF5611_IIO_EXAMPLE
	bool "IIO example"
	depends on IIO
	help
	  IIO framework example. Launches an IIOD server for remote
	  configuration using IIO Oscilloscope or libiio clients.

endchoice

endmenu
```

## projects/adf5902_sdz/Kconfig
```kconfig
menu "adf5902_sdz Configuration"

choice ADF5902_SDZ_EXAMPLE
	prompt "Example variant"
	default ADF5902_SDZ_DEMO_EXAMPLE

config ADF5902_SDZ_DEMO_EXAMPLE
	bool "Demo example"
	help
	  Basic demo that initializes the ADF5902 FMCW radar synthesizer,
	  performs recalibration, reads the locked output frequency, and
	  reads the device temperature.

config ADF5902_SDZ_IIO_EXAMPLE
	bool "IIO example"
	depends on IIO
	help
	  IIO example that exposes the ADF5902 through the IIO framework,
	  enabling host-side control and monitoring over UART.

endchoice

endmenu
```

## projects/adin1320/Kconfig
```kconfig
menu "ADIN1320 Configuration"

choice ADIN1320_EXAMPLE
	prompt "Example variant"
	default ADIN1320_BASIC_INIT_EXAMPLE

config ADIN1320_BASIC_INIT_EXAMPLE
	bool "Basic init"
	help
	  Initialize a single ADIN1320 PHY and bring the link up.

config ADIN1320_BASIC_INIT_2DEVICES_EXAMPLE
	bool "Basic init (2 devices)"
	help
	  Initialize two ADIN1320 PHYs and bring both links up.

config ADIN1320_CMD_EXAMPLE
	bool "Command interface"
	help
	  Interactive command interface for reading/writing PHY registers
	  and switching operating modes over the console.

config ADIN1320_WAKE_ON_LAN_EXAMPLE
	bool "Wake on LAN"
	help
	  Configure the ADIN1320 for Wake-on-LAN and react to the wake event.

endchoice

config ADIN1320_FORCE_SPEED
	bool "Force a fixed link speed"
	default n
	depends on ADIN1320_BASIC_INIT_EXAMPLE || ADIN1320_BASIC_INIT_2DEVICES_EXAMPLE
	help
	  Force the PHY to a fixed link speed instead of auto-negotiating.
	  Applies to the basic_init examples.

endmenu
```

## projects/admt4000/Kconfig
```kconfig
menu "ADMT4000 Configuration"

choice ADMT4000_EXAMPLE
	prompt "Example variant"
	default ADMT4000_BASIC_EXAMPLE

config ADMT4000_BASIC_EXAMPLE
	bool "Basic example"

config ADMT4000_IIO_TRIGGER_EXAMPLE
	bool "IIO Trigger example"
	depends on IIO && IRQ

endchoice

config PCL_VERSION
	string "precision-converters-library version tag/commit"
	default "7af7d492b075538d11534f0db11e005c930b804c"
	depends on ADMT4000_IIO_TRIGGER_EXAMPLE
	help
	  Git tag, branch or commit for precision-converters-library.
	  Checked against the submodule, then the shared cache, then fetched.

config ADMT4000_TMC5240
	bool "Enable TMC5240 motor driver support"
	depends on ADMT4000_IIO_TRIGGER_EXAMPLE
	default n
	help
	  Enable Trinamic TMC5240 stepper motor driver support in IIO trigger example.

endmenu
```

## projects/adp1050/Kconfig
```kconfig
menu "ADP1050 Configuration"

choice ADP1050_EXAMPLE
	prompt "Example variant"
	default ADP1050_BASIC_EXAMPLE

config ADP1050_BASIC_EXAMPLE
	bool "Basic example"

config ADP1050_IIO_EXAMPLE
	bool "IIO example"
	depends on IIO

endchoice

endmenu
```

## projects/adp1055/Kconfig
```kconfig
menu "ADP1055 Configuration"

choice ADP1055_EXAMPLE
	prompt "Example variant"
	default ADP1055_BASIC_EXAMPLE

config ADP1055_BASIC_EXAMPLE
	bool "Basic example"

config ADP1055_IIO_EXAMPLE_EXAMPLE
	bool "IIO example"
	depends on IIO

endchoice

endmenu
```

## projects/adp5055/Kconfig
```kconfig
menu "ADP5055 Configuration"

choice ADP5055_EXAMPLE
	prompt "Example variant"
	default ADP5055_BASIC_EXAMPLE

config ADP5055_BASIC_EXAMPLE
	bool "Basic example"

config ADP5055_IIO_EXAMPLE
	bool "IIO example"
	depends on IIO

endchoice

endmenu
```

## projects/adrv9001/Kconfig
```kconfig
menu "adrv9001 Configuration"

choice ADRV9001_EXAMPLE
	prompt "Example variant"
	default ADRV9001_DEMO_EXAMPLE

config ADRV9001_DEMO_EXAMPLE
	bool "Demo example"
	help
	  Basic initialization and bring-up example for the ADRV9001/ADRV9002
	  transceiver (2-channel mode) via AXI ADC/DAC cores and DMA.

config ADRV9001_DEMO_ADRV9002_EXAMPLE
	bool "Demo ADRV9002 RX2TX2 example"
	help
	  Basic initialization and bring-up example with ADRV9002 in RX2TX2
	  mode (4-channel), enabling both TX/RX channel pairs simultaneously.

config ADRV9001_DMA_EXAMPLE
	bool "DMA example"
	help
	  DMA-based data capture and playback example for the ADRV9001/ADRV9002
	  transceiver (2-channel mode).

config ADRV9001_IIO_EXAMPLE
	bool "IIO example"
	depends on IIO
	help
	  IIO example that exposes the ADRV9001/ADRV9002 transceiver (2-channel
	  mode) through the IIO framework via iio_axi_adc and iio_axi_dac,
	  enabling host-side data capture and playback over UART.

config ADRV9001_IIO_ADRV9002_EXAMPLE
	bool "IIO ADRV9002 RX2TX2 example"
	depends on IIO
	help
	  IIO example with ADRV9002 in RX2TX2 mode (4-channel). Exposes both
	  TX/RX channel pairs through the IIO framework over UART.

endchoice

endmenu
```

## projects/adrv9009/Kconfig
```kconfig
menu "adrv9009 Configuration"

choice ADRV9009_EXAMPLE
	prompt "Example variant"
	default ADRV9009_DEMO_EXAMPLE

config ADRV9009_DEMO_EXAMPLE
	bool "Demo example"
	help
	  Basic initialization and bring-up example for the ADRV9009 transceiver
	  via AXI ADC/DAC cores, JESD204 and DMA, targeting zc706 or zcu102.

config ADRV9009_ADRV9008_1_EXAMPLE
	bool "ADRV9008-1 example"
	help
	  Build for ADRV9008-1 (TX-only sub-variant of the ADRV9009 family).
	  Enables -DADRV9008_1 which gates the TX-only code paths in headless_arm.c.

config ADRV9009_ADRV9008_2_EXAMPLE
	bool "ADRV9008-2 example"
	help
	  Build for ADRV9008-2 (RX-only sub-variant of the ADRV9009 family).
	  Enables -DADRV9008_2 which gates the RX-only code paths in headless_arm.c.

config ADRV9009_DMA_EXAMPLE
	bool "DMA example"
	help
	  DMA-based data capture and playback example for the ADRV9009 transceiver.
	  Enables -DDMA_EXAMPLE to activate the DMA transfer code paths.

config ADRV9009_IIO_EXAMPLE
	bool "IIO example"
	depends on IIO
	help
	  IIO example that exposes the ADRV9009 transceiver through the IIO
	  framework via iio_axi_adc and iio_axi_dac, enabling host-side data
	  capture and playback over UART (IIOD).  Enables -DIIO_SUPPORT.

endchoice

endmenu
```

## projects/adrv902x/Kconfig
```kconfig
menu "adrv902x Configuration"

choice ADRV902X_EXAMPLE
	prompt "Example variant"
	default ADRV902X_BASIC_EXAMPLE

config ADRV902X_BASIC_EXAMPLE
	bool "Basic example"
	help
	  Basic initialization and bring-up example for the ADRV9025
	  transceiver via JESD204 RX/TX, AXI ADC/DAC cores, and DMA.

config ADRV902X_DMA_EXAMPLE
	bool "DMA example"
	help
	  DMA-based data capture and playback example for the ADRV9025
	  transceiver.

config ADRV902X_IIO_EXAMPLE
	bool "IIO example"
	depends on IIO
	help
	  IIO example that exposes the ADRV9025 transceiver through the IIO
	  framework via iio_axi_adc and iio_axi_dac, enabling host-side data
	  capture and playback over UART.

endchoice

endmenu
```

## projects/adrv903x/Kconfig
```kconfig
menu "adrv903x Configuration"

choice ADRV903X_EXAMPLE
	prompt "Example variant"
	default ADRV903X_BASIC_EXAMPLE

config ADRV903X_BASIC_EXAMPLE
	bool "Basic example"
	help
	  Basic initialization and bring-up example for the ADRV903X
	  transceiver via JESD204 RX/TX, AXI ADC/DAC cores, and DMA.

config ADRV903X_DMA_EXAMPLE
	bool "DMA example"
	help
	  DMA-based data capture and playback example for the ADRV903X
	  transceiver.

config ADRV903X_IIO_EXAMPLE
	bool "IIO example"
	depends on IIO
	help
	  IIO example that exposes the ADRV903X transceiver through the IIO
	  framework via iio_axi_adc and iio_axi_dac, enabling host-side data
	  capture and playback over UART.

endchoice

endmenu
```

## projects/adrv904x/Kconfig
```kconfig
menu "adrv904x Configuration"

choice ADRV904X_EXAMPLE
	prompt "Example variant"
	default ADRV904X_BASIC_EXAMPLE

config ADRV904X_BASIC_EXAMPLE
	bool "Basic example"
	help
	  Basic initialization and bring-up example for the ADRV904X
	  transceiver via JESD204 RX/TX, AXI ADC/DAC cores, and DMA.

config ADRV904X_DMA_EXAMPLE
	bool "DMA example"
	help
	  DMA-based data capture and playback example for the ADRV904X
	  transceiver.

config ADRV904X_IIO_EXAMPLE
	bool "IIO example"
	depends on IIO
	help
	  IIO example that exposes the ADRV904X transceiver through the IIO
	  framework via iio_axi_adc and iio_axi_dac, enabling host-side data
	  capture and playback over UART.

endchoice

endmenu
```

## projects/adt7420-pmdz/Kconfig
```kconfig
menu "adt7420-pmdz Configuration"

choice ADT7420_PMDZ_EXAMPLE
	prompt "Example variant"
	default ADT7420_PMDZ_DUMMY_EXAMPLE

config ADT7420_PMDZ_DUMMY_EXAMPLE
	bool "Dummy example"

config ADT7420_PMDZ_IIO_EXAMPLE
	bool "IIO example"
	depends on IIO

endchoice

endmenu
```

## projects/adt75/Kconfig
```kconfig
menu "ADT75 Configuration"

choice ADT75_EXAMPLE
	prompt "Example variant"
	default ADT75_BASIC_EXAMPLE

config ADT75_BASIC_EXAMPLE
	bool "Basic example"

config ADT75_IIO_EXAMPLE
	bool "IIO example"
	depends on IIO

endchoice

endmenu
```

## projects/aducm3029_flash_demo/Kconfig
```kconfig
menu "ADuCM3029 Flash Demo Configuration"

choice ADUCM_FLASH_DEMO_VARIANT
	prompt "Example variant"
	default ADUCM_FLASH_DEMO_EXAMPLE

config ADUCM_FLASH_DEMO_EXAMPLE
	bool "Flash example"
	help
	  Example that exercises the ADuCM3029 on-chip flash controller
	  (erase/write/read) and reports the result over UART.

endchoice

endmenu
```

## projects/aducm_blinky_example/Kconfig
```kconfig
menu "ADuCM Blinky Example Configuration"

choice ADUCM_BLINKY_EXAMPLE
	prompt "Example variant"
	default ADUCM_BLINKY_BASIC_EXAMPLE

config ADUCM_BLINKY_BASIC_EXAMPLE
	bool "Basic blinky example"
	help
	  Basic example that blinks the on-board LEDs of the EVAL-ADICUP3029.

endchoice

endmenu
```

## projects/adxrs290-pmdz/Kconfig
```kconfig
menu "ADXRS290 PMDZ Configuration"

choice ADXRS290_PMDZ_EXAMPLE
	prompt "Example variant"
	default ADXRS290_PMDZ_IIO_EXAMPLE

config ADXRS290_PMDZ_IIO_EXAMPLE
	bool "IIO example"
	depends on IIO
	help
	  IIO framework example. Launches an IIOD server for remote
	  data acquisition using IIO Oscilloscope or libiio clients.

config ADXRS290_PMDZ_IIO_TRIGGER_EXAMPLE
	bool "IIO trigger example"
	depends on IIO && IRQ && GPIO
	help
	  Interrupt-driven IIO example using the ADXRS290 sync pin as a
	  hardware trigger.

config ADXRS290_PMDZ_IIO_TIMER_TRIGGER_EXAMPLE
	bool "IIO timer trigger example"
	depends on IIO && IRQ && TIMER
	help
	  IIO example using a hardware timer as the acquisition trigger.

endchoice

endmenu
```
