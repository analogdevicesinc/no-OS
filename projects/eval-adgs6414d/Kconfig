## projects/eval-adgs6414d/Kconfig
```kconfig
menu "eval-adgs6414d Configuration"

choice EVAL_ADGS6414D_EXAMPLE
	prompt "Example variant"
	default EVAL_ADGS6414D_BASIC_EXAMPLE

config EVAL_ADGS6414D_BASIC_EXAMPLE
	bool "Basic example"

endchoice

endmenu
```

## projects/eval-adis1646x/Kconfig
```kconfig
menu "EVAL-ADIS1646X Configuration"

choice EVAL_ADIS1646X_EXAMPLE
	prompt "Example variant"
	default EVAL_ADIS1646X_BASIC_EXAMPLE

config EVAL_ADIS1646X_BASIC_EXAMPLE
	bool "Basic example"

config EVAL_ADIS1646X_IIO_TRIGGER_EXAMPLE
	bool "IIO Trigger example"
	depends on IIO && IRQ && GPIO

endchoice

endmenu
```

## projects/eval-adis1647x/Kconfig
```kconfig
menu "EVAL-ADIS1647X Configuration"

choice EVAL_ADIS1647X_EXAMPLE
	prompt "Example variant"
	default EVAL_ADIS1647X_BASIC_EXAMPLE

config EVAL_ADIS1647X_BASIC_EXAMPLE
	bool "Basic example"

config EVAL_ADIS1647X_IIO_TRIGGER_EXAMPLE
	bool "IIO trigger example"
	depends on IIO && IRQ && GPIO

endchoice

endmenu
```

## projects/eval-adis1650x/Kconfig
```kconfig
menu "ADIS1650X Configuration"

choice ADIS1650X_EXAMPLE
	prompt "Example variant"
	default ADIS1650X_BASIC_EXAMPLE

config ADIS1650X_BASIC_EXAMPLE
	bool "Basic example"
	help
	  Simple example that initializes the ADIS1650X IMU and prints
	  measurements over UART.

config ADIS1650X_IIO_TRIGGER_EXAMPLE
	bool "IIO trigger example"
	depends on IIO && IRQ && GPIO
	help
	  Interrupt-driven IIO example using the ADIS1650X data-ready pin
	  as a hardware trigger.

endchoice

endmenu
```

## projects/eval-adis1654x/Kconfig
```kconfig
menu "ADIS1654X Configuration"

choice ADIS1654X_EXAMPLE
	prompt "Example variant"
	default ADIS1654X_BASIC_EXAMPLE

config ADIS1654X_BASIC_EXAMPLE
	bool "Basic example"
	help
	  Simple example that initializes the ADIS1654X IMU and prints
	  measurements over UART.

config ADIS1654X_IIO_TRIGGER_EXAMPLE
	bool "IIO trigger example"
	depends on IIO && IRQ && GPIO
	help
	  Interrupt-driven IIO example using the ADIS1654X data-ready pin
	  as a hardware trigger.

endchoice

endmenu
```

## projects/eval-adis1655x/Kconfig
```kconfig
menu "ADIS1655X Configuration"

choice ADIS1655X_EXAMPLE
	prompt "Example variant"
	default ADIS1655X_BASIC_EXAMPLE

config ADIS1655X_BASIC_EXAMPLE
	bool "Basic example"
	help
	  Simple example that initializes the ADIS1655X IMU and prints
	  measurements over UART.

config ADIS1655X_IIO_TRIGGER_EXAMPLE
	bool "IIO trigger example"
	depends on IIO && IRQ && GPIO
	help
	  Interrupt-driven IIO example using the ADIS1655X data-ready pin
	  as a hardware trigger.

endchoice

endmenu
```

## projects/eval-adis1657x/Kconfig
```kconfig
menu "ADIS1657X Configuration"

choice ADIS1657X_EXAMPLE
	prompt "Example variant"
	default ADIS1657X_BASIC_EXAMPLE

config ADIS1657X_BASIC_EXAMPLE
	bool "Basic example"
	help
	  Simple example that initializes the ADIS1657X IMU and prints
	  measurements over UART.

config ADIS1657X_IIO_TRIGGER_EXAMPLE
	bool "IIO trigger example"
	depends on IIO && IRQ && GPIO
	help
	  Interrupt-driven IIO example using the ADIS1657X data-ready pin
	  as a hardware trigger.

endchoice

endmenu
```

## projects/eval-adl8113/Kconfig
```kconfig
menu "eval-adl8113 Configuration"

choice EVAL_ADL8113_EXAMPLE
	prompt "Example variant"
	default EVAL_ADL8113_BASIC_EXAMPLE

config EVAL_ADL8113_BASIC_EXAMPLE
	bool "Basic example"

config EVAL_ADL8113_IIO_EXAMPLE
	bool "IIO example"
	depends on IIO

endchoice

endmenu
```

## projects/eval-adxl313z/Kconfig
```kconfig
menu "EVAL-ADXL313Z Configuration"

choice EVAL_ADXL313Z_EXAMPLE
	prompt "Example variant"
	default EVAL_ADXL313Z_BASIC_EXAMPLE

config EVAL_ADXL313Z_BASIC_EXAMPLE
	bool "Basic example"

config EVAL_ADXL313Z_IIO_EXAMPLE
	bool "IIO example"
	depends on IIO

endchoice

endmenu
```

## projects/eval-adxl355-pmdz/Kconfig
```kconfig
menu "ADXL355 PMDZ Configuration"

choice ADXL355_PMDZ_EXAMPLE
	prompt "Example variant"
	default ADXL355_PMDZ_DUMMY_EXAMPLE

config ADXL355_PMDZ_DUMMY_EXAMPLE
	bool "Basic dummy example"
	help
	  Simple example that reads acceleration data from the ADXL355
	  and prints it over UART.

config ADXL355_PMDZ_IIO_EXAMPLE
	bool "IIO example"
	depends on IIO
	help
	  IIO framework example. Launches an IIOD server for remote
	  data acquisition using IIO Oscilloscope or libiio clients.

config ADXL355_PMDZ_IIO_TRIGGER_EXAMPLE
	bool "IIO trigger example"
	depends on IIO && IRQ && GPIO
	help
	  Interrupt-driven IIO example using the ADXL355 data-ready
	  pin as a hardware trigger.

config ADXL355_PMDZ_IIO_LWIP_EXAMPLE
	bool "IIO LWIP example"
	depends on IIO && LWIP
	help
	  IIO server over Ethernet using the LWIP stack and an
	  ADIN1110 MAC/PHY. Requires the adin1110ebz board overlay.

endchoice

choice ADXL355_PMDZ_DEVICE
	prompt "Accelerometer device"
	default ADXL355_PMDZ_DEV_ADXL355
	help
	  Selects which device on the PMDZ board to target. All three
	  parts are handled by the same adxl355 driver via dev_type.

config ADXL355_PMDZ_DEV_ADXL355
	bool "ADXL355"

config ADXL355_PMDZ_DEV_ADXL357
	bool "ADXL357"

config ADXL355_PMDZ_DEV_ADXL359
	bool "ADXL359"

endchoice

endmenu
```

## projects/eval-adxl367z/Kconfig
```kconfig
menu "eval-adxl367z Configuration"

choice EVAL_ADXL367Z_EXAMPLE
	prompt "Example variant"
	default EVAL_ADXL367Z_DUMMY_EXAMPLE

config EVAL_ADXL367Z_DUMMY_EXAMPLE
	bool "Dummy example"
	help
	  Basic example that initializes the ADXL367 accelerometer, reads
	  acceleration and temperature data from the FIFO, and prints the results.

config EVAL_ADXL367Z_IIO_EXAMPLE
	bool "IIO example"
	depends on IIO
	help
	  IIO example that exposes the ADXL367 accelerometer through the IIO
	  framework, enabling host-side data capture over UART.

endchoice

endmenu
```

## projects/eval-adxl38x/Kconfig
```kconfig
menu "ADXL38x Configuration"

choice EVAL_ADXL38X_EXAMPLE
	prompt "Example variant"
	default EVAL_ADXL38X_BASIC_EXAMPLE

config EVAL_ADXL38X_BASIC_EXAMPLE
	bool "Basic example"
	help
	  Simple example that reads acceleration data from the ADXL38x
	  and prints it over UART.

config EVAL_ADXL38X_SELFTEST_EXAMPLE
	bool "Selftest example"
	help
	  Self-test example that validates accelerometer functionality.

config EVAL_ADXL38X_FIFO_EXAMPLE
	bool "FIFO example"
	help
	  FIFO example that demonstrates data buffering and retrieval.

endchoice

endmenu
```

## projects/eval-cn0391-ardz/Kconfig
```kconfig
menu "EVAL-CN0391-ARDZ Configuration"

choice EVAL_CN0391_ARDZ_EXAMPLE
	prompt "Example variant"
	default EVAL_CN0391_ARDZ_BASIC_EXAMPLE

config EVAL_CN0391_ARDZ_BASIC_EXAMPLE
	bool "Basic example"
	help
	  Read the four thermocouple channels and the cold-junction RTD over
	  UART.

config EVAL_CN0391_ARDZ_IIO_LWIP_EXAMPLE
	bool "IIO LWIP example"
	depends on IIO && LWIP && NET
	help
	  Expose the CN0391 as an IIO device over an lwIP network link using
	  the ADIN1110 Ethernet controller.

endchoice

config EVAL_CN0391_ARDZ_IIO_CN0391_SUPPORT
	bool "Expose the dedicated cn0391 IIO device"
	default n
	depends on EVAL_CN0391_ARDZ_IIO_LWIP_EXAMPLE
	help
	  In addition to the ad7124-8 IIO device, expose a dedicated cn0391 IIO
	  device (temp0..temp3 channels with hot/cold junction temperature,
	  thermocouple voltage and RTD resistance attributes). Sets the
	  CN0391_IIO_SUPPORT compile definition.

endmenu
```

## projects/eval-ltc4306/Kconfig
```kconfig
menu "eval-ltc4306 Configuration"

choice EVAL_LTC4306_EXAMPLE
	prompt "Example variant"
	default EVAL_LTC4306_BASIC_EXAMPLE

config EVAL_LTC4306_BASIC_EXAMPLE
	bool "Basic example"
	help
	  Basic example that configures the LTC4306 I2C multiplexer and a
	  MAX538X DAC behind it, reporting progress over UART.

endchoice

endmenu
```

## projects/eval-pqmon-zephyr-iio-t1l/patches/board_ad_pqmon_sl/ad_pqmon_sl_defconfig
```kconfig
# Copyright (c) 2025 Analog Devices, Inc.
# SPDX-License-Identifier: Apache-2.0

# Enable GPIO
CONFIG_GPIO=y

# Console
CONFIG_CONSOLE=y
CONFIG_UART_CONSOLE=y
CONFIG_SERIAL=y

# Enable clock control
CONFIG_CLOCK_CONTROL=y
```

## projects/eval-pqmon-zephyr-iio-t1l/patches/board_ad_pqmon_sl/board.yml
```yaml
board:
  name: ad_pqmon_sl
  full_name: AD-PQMON-SL
  vendor: adi
  socs:
    - name: max32650
```

## projects/eval-ublox-gnss/Kconfig
```kconfig
menu "eval-ublox-gnss Configuration"

choice EVAL_UBLOX_GNSS_EXAMPLE
	prompt "Example variant"
	default EVAL_UBLOX_GNSS_BASIC_EXAMPLE

config EVAL_UBLOX_GNSS_BASIC_EXAMPLE
	bool "Basic example"

endchoice

endmenu
```

## projects/fmcdaq2/Kconfig
```kconfig
menu "fmcdaq2 Configuration"

choice FMCDAQ2_EXAMPLE
	prompt "Example variant"
	default FMCDAQ2_DEMO_EXAMPLE

config FMCDAQ2_DEMO_EXAMPLE
	bool "Demo example"
	help
	  Demo example that initializes the AD9144 DAC + AD9680 ADC via JESD204
	  (TX and RX), AXI DAC/ADC cores, AD9523 clock, and AXI DMAC. Runs
	  pattern and PN tests. No DMA capture, no IIO.

config FMCDAQ2_DMA_EXAMPLE
	bool "DMA example"
	help
	  DMA-based data capture/playback example. Loads a sine LUT into the
	  DAC via DMA and captures ADC samples into DDR via DMA.

config FMCDAQ2_IIO_EXAMPLE
	bool "IIO example"
	depends on IIO
	help
	  IIO example that exposes the AD9144 DAC and AD9680 ADC through the IIO
	  framework via iio_axi_dac and iio_axi_adc, enabling host-side data
	  transfer over UART.

endchoice

endmenu
```

## projects/fmcdaq3/Kconfig
```kconfig
menu "fmcdaq3 Configuration"

choice FMCDAQ3_EXAMPLE
	prompt "Example variant"
	default FMCDAQ3_DEMO_EXAMPLE

config FMCDAQ3_DEMO_EXAMPLE
	bool "Demo example"
	help
	  Demo example that initializes the AD9152 DAC + AD9680 ADC via JESD204
	  (TX and RX), AXI DAC/ADC cores, AD9528 clock, and AXI DMAC. Runs
	  pattern tests and a DMA capture. No IIO.

config FMCDAQ3_IIO_EXAMPLE
	bool "IIO example"
	depends on IIO
	help
	  IIO example that exposes the AD9152 DAC and AD9680 ADC through the IIO
	  framework via iio_axi_dac and iio_axi_adc, enabling host-side data
	  transfer over UART.

endchoice

endmenu
```

## projects/ftc_workshop/Kconfig
```kconfig
menu "FTC Workshop BLE Configuration"
	depends on CORDIO

choice BLE_MODE
	prompt "BLE Operation Mode"
	default BLE_MODE_PERIPHERAL
	help
	  Select the Bluetooth Low Energy operation mode for the FTC Workshop project.

config BLE_MODE_PERIPHERAL
	bool "Peripheral Mode"
	help
	  Run as a BLE peripheral device that advertises and accepts connections.
	  This mode implements a full BLE stack with GATT services and can be
	  discovered and connected to by central devices.

config BLE_MODE_HCI_UART
	bool "HCI-UART Mode"
	help
	  Run as an HCI controller accessible via UART interface.
	  This mode exposes the Bluetooth controller through HCI commands over UART,
	  allowing external host applications to control the BLE functionality.
	  Useful for sending custom BLE data and implementing host applications.

endchoice

config BLE_MODE_HCI_UART_ENABLED
	bool
	default y if BLE_MODE_HCI_UART
	default n

endmenu

menu "UART Configuration"

choice UART_TYPE
	prompt "UART Type for printf"
	default UART_TYPE_NORMAL
	help
	  Select which UART type to use for printf output.

config UART_TYPE_NORMAL
	bool "Normal UART"
	select UART_MAXIM
	help
	  Use standard UART for printf output.

config UART_TYPE_USB
	bool "USB UART"
	select USB_UART_MAXIM
	help
	  Use USB UART for printf output.

endchoice

config USE_USB_UART
	bool
	default y if UART_TYPE_USB
	default n

endmenu
```
