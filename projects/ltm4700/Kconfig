## projects/ltm4700/Kconfig
```kconfig
menu "LTM4700 Configuration"

choice LTM4700_EXAMPLE
	prompt "Example variant"
	default LTM4700_BASIC_EXAMPLE

config LTM4700_BASIC_EXAMPLE
	bool "Basic example"

config LTM4700_IIO_EXAMPLE
	bool "IIO example"
	depends on IIO

endchoice

endmenu
```

## projects/ltp8800/Kconfig
```kconfig
menu "LTP8800 Configuration"

choice LTP8800_EXAMPLE
	prompt "Example variant"
	default LTP8800_BASIC_EXAMPLE

config LTP8800_BASIC_EXAMPLE
	bool "Basic example"

config LTP8800_IIO_EXAMPLE
	bool "IIO example"
	depends on IIO

endchoice

endmenu
```

## projects/max11205pmb1/Kconfig
```kconfig
menu "max11205pmb1 Configuration"

choice MAX11205PMB1_EXAMPLE
	prompt "Example variant"
	default MAX11205PMB1_BASIC_EXAMPLE

config MAX11205PMB1_BASIC_EXAMPLE
	bool "Basic example"

config MAX11205PMB1_IIO_EXAMPLE
	bool "IIO example"
	depends on IIO

endchoice

endmenu
```

## projects/max14906/Kconfig
```kconfig
menu "MAX14906 Configuration"

choice MAX14906_EXAMPLE
	prompt "Example variant"
	default MAX14906_BASIC_EXAMPLE

config MAX14906_BASIC_EXAMPLE
	bool "Basic example"
	help
	  Basic example demonstrating MAX14906 digital I/O operations.

config MAX14906_IIO_EXAMPLE
	bool "IIO example"
	depends on IIO
	help
	  IIO example demonstrating MAX14906 as an IIO device.

endchoice

endmenu
```

## projects/max14914/Kconfig
```kconfig
menu "max14914 Configuration"

choice MAX14914_EXAMPLE
	prompt "Example variant"
	default MAX14914_BASIC_EXAMPLE

config MAX14914_BASIC_EXAMPLE
	bool "Basic example"

endchoice

endmenu
```

## projects/max14916/Kconfig
```kconfig
menu "max14916 Configuration"

choice MAX14916_EXAMPLE
	prompt "Example variant"
	default MAX14916_BASIC_EXAMPLE

config MAX14916_BASIC_EXAMPLE
	bool "Basic example"
	help
	  Basic example demonstrating MAX14916 digital I/O operations.

config MAX14916_IIO_EXAMPLE
	bool "IIO example"
	depends on IIO
	help
	  IIO example demonstrating MAX14916 as an IIO device.

endchoice

endmenu
```

## projects/max14919/Kconfig
```kconfig
menu "max14919 Configuration"

choice MAX14919_EXAMPLE
	prompt "Example variant"
	default MAX14919_BASIC_EXAMPLE

config MAX14919_BASIC_EXAMPLE
	bool "Basic example"

endchoice

endmenu
```

## projects/max17616/Kconfig
```kconfig
menu "MAX17616 Configuration"

choice MAX17616_EXAMPLE
	prompt "Example variant"
	default MAX17616_BASIC_EXAMPLE

config MAX17616_BASIC_EXAMPLE
	bool "Basic example"

config MAX17616_IIO_EXAMPLE
	bool "IIO example"
	depends on IIO

endchoice

endmenu
```

## projects/max22007/Kconfig
```kconfig
menu "MAX22007 Configuration"

choice MAX22007_EXAMPLE
	prompt "Example variant"
	default MAX22007_BASIC_EXAMPLE

config MAX22007_BASIC_EXAMPLE
	bool "Basic example"
	help
	  Basic example for the MAX22007 DAC.

endchoice

endmenu
```

## projects/max22017/Kconfig
```kconfig
menu "MAX22017 Configuration"

choice MAX22017_EXAMPLE
	prompt "Example variant"
	default MAX22017_BASIC_EXAMPLE

config MAX22017_BASIC_EXAMPLE
	bool "Basic example"

config MAX22017_IIO_EXAMPLE
	bool "IIO example"
	depends on IIO

endchoice

endmenu
```

## projects/max22190/Kconfig
```kconfig
menu "MAX22190 Configuration"

choice MAX22190_EXAMPLE
	prompt "Example variant"
	default MAX22190_BASIC_EXAMPLE

config MAX22190_BASIC_EXAMPLE
	bool "Basic example"

config MAX22190_IIO_EXAMPLE
	bool "IIO example"
	depends on IIO

endchoice

endmenu
```

## projects/max22196/Kconfig
```kconfig
menu "MAX22196 Configuration"

choice MAX22196_EXAMPLE
	prompt "Example variant"
	default MAX22196_BASIC_EXAMPLE

config MAX22196_BASIC_EXAMPLE
	bool "Basic example"

config MAX22196_IIO_EXAMPLE
	bool "IIO example"
	depends on IIO

endchoice

endmenu
```

## projects/max22200/Kconfig
```kconfig
menu "MAX22200 Configuration"

choice MAX22200_EXAMPLE
	prompt "Example variant"
	default MAX22200_BASIC_EXAMPLE

config MAX22200_BASIC_EXAMPLE
	bool "Basic example"

config MAX22200_IIO_EXAMPLE
	bool "IIO example"
	depends on IIO

endchoice

endmenu
```

## projects/max22915/Kconfig
```kconfig
menu "MAX22915 Configuration"

choice MAX22915_EXAMPLE
	prompt "Example variant"
	default MAX22915_BASIC_EXAMPLE

config MAX22915_BASIC_EXAMPLE
	bool "Basic example"
	help
	  Basic example for MAX22915 with diagnostics.

endchoice

endmenu
```

## projects/max25603/Kconfig
```kconfig
menu "MAX25603 Configuration"

choice MAX25603_EXAMPLE
	prompt "Example variant"
	default MAX25603_BASIC_EXAMPLE

config MAX25603_BASIC_EXAMPLE
	bool "Basic example"

endchoice

endmenu
```

## projects/max30009/Kconfig
```kconfig
menu "max30009 Configuration"

choice MAX30009
	prompt "Example variant"
	default MAX30009_BASIC_EXAMPLE

config MAX30009_BASIC_EXAMPLE
	bool "Basic example"

endchoice

endmenu
```

## projects/max31827-evkit/Kconfig
```kconfig
menu "max31827-evkit Configuration"

choice MAX31827_EVKIT_EXAMPLE
	prompt "Example variant"
	default MAX31827_EVKIT_BASIC_EXAMPLE

config MAX31827_EVKIT_BASIC_EXAMPLE
	bool "Basic example"

config MAX31827_EVKIT_IIO_EXAMPLE
	bool "IIO example"
	depends on IIO

endchoice

endmenu
```

## projects/max31855/Kconfig
```kconfig
menu "MAX31855 Configuration"

choice MAX31855_EXAMPLE
	prompt "Example variant"
	default MAX31855_BASIC_EXAMPLE

config MAX31855_BASIC_EXAMPLE
	bool "Basic example"

config MAX31855_IIO_EXAMPLE
	bool "IIO example"
	depends on IIO

endchoice

endmenu
```

## projects/max42500/Kconfig
```kconfig
menu "max42500 Configuration"

choice MAX42500_EXAMPLE
	prompt "Example variant"
	default MAX42500_BASIC_EXAMPLE

config MAX42500_BASIC_EXAMPLE
	bool "Basic example"

endchoice

endmenu
```

## projects/max78000/Kconfig
```kconfig
menu "max78000 Configuration"

choice MAX78000_EXAMPLE
	prompt "Example variant"
	default MAX78000_BASIC_EXAMPLE

config MAX78000_BASIC_EXAMPLE
	bool "Basic UART example"
	help
	  Simple example that prints a message over UART.

config MAX78000_DUAL_CORE_EXAMPLE
	bool "Dual-core example (ARM + RISC-V)"
	depends on COPROCESSOR && IPC_MAXIM
	help
	  Demonstrates the coprocessor lifecycle API (boot, halt) and inter-core
	  communication via the no_os_ipc doorbell/mailbox API and shared memory.
	  ARM (CPU0) boots RISC-V (CPU1), publishes a callback address,
	  and waits for RISC-V to ring the doorbell periodically.
	  Requires CONFIG_COPROCESSOR=y and CONFIG_IPC_MAXIM=y.

config MAX78000_IMU_DUAL_CORE_EXAMPLE
	bool "Dual-core IMU example (ADIS16577 + ADXL345)"
	depends on COPROCESSOR && IPC_MAXIM && ACCEL_ADXL345 && IMU_ADIS1657X
	help
	  Dual-sensor workload on shared SPI pins. The RISC-V (CPU1) polls an
	  ADIS16577-2 IMU via the no-OS driver and publishes raw gyro/accel
	  samples over no_os_ipc. The ARM (CPU0) reads an ADXL345 on the same
	  bus, integrates gyro rate into roll/pitch/yaw angles, and logs both
	  sensors. SPI0 access is serialized across cores with a MAX78000 hardware
	  semaphore. Requires CONFIG_COPROCESSOR=y, CONFIG_IPC_MAXIM=y,
	  CONFIG_ACCEL_ADXL345=y and CONFIG_IMU_ADIS1657X=y.


config MAX78000_IMU_SINGLE_CORE_EXAMPLE
	bool "Single-core dual-IMU example (ADIS + ADXL345 on ARM)"
	depends on ACCEL_ADXL345 && (IMU_ADIS1647X || IMU_ADIS1657X)
	help
	  Both IMUs share SPI0, driven entirely from the ARM Cortex-M4F.
	  ADXL345 accelerometer on CS=P0.19 (GPIO); ADIS 6-axis IMU on
	  CS=P0.11 (GPIO). The ARM integrates gyro rate into roll/pitch/yaw
	  angles and logs both sensors at ~10 Hz. No RISC-V or IPC required.
	  Requires CONFIG_ACCEL_ADXL345=y and either CONFIG_IMU_ADIS1647X=y or
	  CONFIG_IMU_ADIS1657X=y.


endchoice

endmenu
```

## projects/pulsar-adc/Kconfig
```kconfig
menu "Pulsar ADC Configuration"

choice PULSAR_ADC_EXAMPLE
	prompt "Example variant"
	default PULSAR_ADC_BASIC_EXAMPLE

config PULSAR_ADC_BASIC_EXAMPLE
	bool "Basic example"
	help
	  Basic example for the Pulsar ADC.

config PULSAR_ADC_IIO_EXAMPLE
	bool "IIO example"
	depends on IIO
	help
	  IIO example for the Pulsar ADC.

endchoice

endmenu
```

## projects/ssd1306/Kconfig
```kconfig
menu "ssd1306 Configuration"

choice SSD1306_EXAMPLE
	prompt "Example variant"
	default SSD1306_EXAMPLE_EXAMPLE

config SSD1306_EXAMPLE_EXAMPLE
	bool "Basic example"

endchoice

endmenu
```
