## projects/max34451/Kconfig
```kconfig
menu "MAX34451 Configuration"

choice MAX34451_EXAMPLE
	prompt "Example variant"
	default MAX34451_BASIC_EXAMPLE

config MAX34451_BASIC_EXAMPLE
	bool "Basic example"

config MAX34451_IIO_EXAMPLE
	bool "IIO example"
	depends on IIO

endchoice

endmenu
```

## projects/maxm86161/Kconfig
```kconfig
menu "maxm86161 Configuration"

choice MAXM86161_EXAMPLE
prompt "Example variant"
default MAXM86161_BASIC_EXAMPLE

config MAXM86161_BASIC_EXAMPLE
bool "Basic example"

config MAXM86161_IIO_EXAMPLE
bool "IIO example"
depends on IIO

config MAXM86161_ATTRIBUTE_TEST_EXAMPLE
bool "Attribute test example"

endchoice

endmenu
```
