## projects/apard32690/Kconfig
```kconfig
menu "APARD32690 Configuration"

choice APARD32690_EXAMPLE
	prompt "Example variant"
	default APARD32690_ECHO_SERVER_EXAMPLE

config APARD32690_BASIC_EXAMPLE
	bool "Basic UART example"
	help
	  Simple example that prints a message over UART.

config APARD32690_ECHO_SERVER_EXAMPLE
	bool "TCP echo server example"
	depends on LWIP && NET && ADIN1110
	help
	  TCP echo server on port 10000 using LWIP and the ADIN1110
	  MAC/PHY over Ethernet.

config APARD32690_ESH_EXAMPLE
	bool "Embedded shell (esh) example"
	depends on FREERTOS && ESH
	help
	  Interactive shell over UART using the esh library
	  running on FreeRTOS.

config APARD32690_ADIN1110_STANDALONE_EXAMPLE
	bool "ADIN1110 standalone example"
	depends on NET && ADIN1110
	help
	  Standalone test for the ADIN1110 MAC/PHY driver.
	  Reads the device ID register over SPI.

endchoice

endmenu
```

## projects/cn0531/Kconfig
```kconfig
menu "CN0531 Configuration"

choice CN0531_EXAMPLE
	prompt "Example variant"
	default CN0531_IIO_EXAMPLE

config CN0531_IIO_EXAMPLE
	bool "IIO example"
	depends on IIO
	help
	  IIO example that exposes the CN0531 (AD5791 20-bit DAC) over an
	  IIO interface on top of a UART transport.

endchoice

config CN0531_NETWORKING
	bool "Enable ESP8266 Wi-Fi networking"
	default n
	select WIFI_NETWORKING
	help
	  Route IIO transport over an ESP8266 Wi-Fi module (UART AT commands)
	  instead of the serial backend. aducm3029/eval-adicup3029 only.

endmenu
```

## projects/cn0561/Kconfig
```kconfig
menu "cn0561 Configuration"

choice CN0561_EXAMPLE
	prompt "Example variant"
	default CN0561_UART_EXAMPLE

config CN0561_UART_EXAMPLE
	bool "UART (basic) example"
	help
	  Basic example that initializes the CN0561 (AD4134 quad-channel ADC)
	  via the AXI SPI Engine offload with DMA, captures samples and prints
	  results over UART.

config CN0561_IIO_EXAMPLE
	bool "IIO example"
	depends on IIO
	help
	  IIO example that exposes the CN0561 through the IIO framework,
	  enabling host-side data capture over UART.

endchoice

config CN0561_ZED_CARRIER
	bool "ZedBoard carrier"
	default n
	help
	  Select when targeting the ZedBoard carrier. Enables the extra GPIO
	  lines (MODE, RESETN) present on the ZedBoard FMC connector and
	  sets the higher SPI clock frequency for that board.

config CN0561_CORAZ7S_CARRIER
	bool "Cora Z7-07S carrier"
	default n
	help
	  Select when targeting the Cora Z7-07S carrier. Uses the lower SPI
	  clock frequency suited for that board.

endmenu
```

## projects/cn0565/Kconfig
```kconfig
menu "CN0565 Configuration"

choice CN0565_EXAMPLE
	prompt "Example variant"
	default CN0565_EIT_EXAMPLE

config CN0565_EIT_EXAMPLE
	bool "Basic EIT example"

config CN0565_EIT_IIO_EXAMPLE
	bool "IIO EIT example"
	depends on IIO

endchoice

endmenu
```

## projects/dc2703a/Kconfig
```kconfig
menu "DC2703A Configuration"

choice DC2703A_EXAMPLE
	prompt "Example variant"
	default DC2703A_BASIC_EXAMPLE

config DC2703A_BASIC_EXAMPLE
	bool "Basic example"

config DC2703A_IIO_EXAMPLE
	bool "IIO example"
	depends on IIO

endchoice

endmenu
```

## projects/dc2903a/Kconfig
```kconfig
menu "DC2903A Configuration"

choice DC2903A_EXAMPLE
	prompt "Example variant"
	default DC2903A_BASIC_EXAMPLE

config DC2903A_BASIC_EXAMPLE
	bool "Basic example"

endchoice

endmenu
```

## projects/demo_esp/Kconfig
```kconfig
menu "demo_esp Configuration"

choice DEMO_ESP_EXAMPLE
	prompt "Example variant"
	default DEMO_ESP_BASIC_EXAMPLE

config DEMO_ESP_BASIC_EXAMPLE
	bool "Basic example"
	help
	  Connects to an ESP8266 Wi-Fi module via UART AT commands, establishes
	  a TCP connection to an MQTT broker, and continuously publishes and
	  receives messages.

endchoice

endmenu
```

## projects/display_demo/Kconfig
```kconfig
menu "display_demo Configuration"

choice DISPLAY_DEMO_EXAMPLE
	prompt "Example variant"
	default DISPLAY_DEMO_DEMO_EXAMPLE

config DISPLAY_DEMO_DEMO_EXAMPLE
	bool "Demo"
	help
	  Demo that initializes the SSD1306 OLED display over SPI and prints
	  a message to the screen on the ZedBoard platform.

endchoice

endmenu
```

## projects/eval-ad7490sdz/Kconfig
```kconfig
menu "eval-ad7490sdz Configuration"

choice EVAL_AD7490SDZ_EXAMPLE
	prompt "Example variant"
	default EVAL_AD7490SDZ_BASIC_EXAMPLE

config EVAL_AD7490SDZ_BASIC_EXAMPLE
	bool "Basic example"

config EVAL_AD7490SDZ_IIO_EXAMPLE
	bool "IIO example"
	depends on IIO

endchoice

endmenu
```

## projects/eval-ad8460/Kconfig
```kconfig
menu "eval-ad8460 Configuration"

choice EVAL_AD8460_EXAMPLE
	prompt "Example variant"
	default EVAL_AD8460_BASIC_EXAMPLE

config EVAL_AD8460_BASIC_EXAMPLE
	bool "Basic example"

config EVAL_AD8460_IIO_EXAMPLE
	bool "IIO example"
	depends on IIO

endchoice

endmenu
```

## projects/eval-ade7753/Kconfig
```kconfig
menu "eval-ade7753 Configuration"

choice EVAL_ADE7753_EXAMPLE
	prompt "Example variant"
	default EVAL_ADE7753_ADE7753_EXAMPLE

config EVAL_ADE7753_ADE7753_EXAMPLE
	bool "ADE7753 example"

endchoice

endmenu
```

## projects/eval-ade7754/Kconfig
```kconfig
menu "EVAL-ADE7754 Configuration"

choice ADE7754_EXAMPLE
    prompt "ADE7754 example selection"
    default ADE7754_EXAMPLE

config ADE7754_EXAMPLE
    bool "ADE7754 example"

endchoice

endmenu
```

## projects/eval-ade7758/Kconfig
```kconfig
menu "eval-ade7758 Configuration"

choice EVAL_ADE7758_EXAMPLE
	prompt "Example variant"
	default EVAL_ADE7758_BASIC_EXAMPLE

config EVAL_ADE7758_BASIC_EXAMPLE
	bool "Basic example"

endchoice

endmenu
```

## projects/eval-ade7880/Kconfig
```kconfig
menu "EVAL-ADE7880 Configuration"

choice EVAL_ADE7880_EXAMPLE
	prompt "EVAL-ADE7880 example selection"
	default EVAL_ADE7880_ADE7880_EXAMPLE

config EVAL_ADE7880_ADE7880_EXAMPLE
	bool "ADE7880 example"

endchoice

endmenu
```

## projects/eval-ade7913/Kconfig
```kconfig
menu "eval-ade7913 Configuration"

choice EVAL_ADE7913_EXAMPLE
	prompt "Example variant"
	default EVAL_ADE7913_ADE7913_EXAMPLE

config EVAL_ADE7913_ADE7913_EXAMPLE
	bool "ADE7913 example"

endchoice

endmenu
```

## projects/eval-ade7953/Kconfig
```kconfig
menu "eval-ade7953 Configuration"

choice EVAL_ADE7953_EXAMPLE
	prompt "Example variant"
	default EVAL_ADE7953_BASIC_EXAMPLE

config EVAL_ADE7953_BASIC_EXAMPLE
	bool "Basic example"

endchoice

endmenu
```

## projects/eval-ade7978/Kconfig
```kconfig
menu "eval-ade7978 Configuration"

choice EVAL_ADE7978_EXAMPLE
	prompt "Example variant"
	default EVAL_ADE7978_ADE7978_EXAMPLE

config EVAL_ADE7978_ADE7978_EXAMPLE
	bool "ADE7978 example"

endchoice

endmenu
```

## projects/eval-ade9000/Kconfig
```kconfig
menu "eval-ade9000 Configuration"

choice EVAL_ADE9000_EXAMPLE
	prompt "Example variant"
	default EVAL_ADE9000_ADE9000_EXAMPLE

config EVAL_ADE9000_ADE9000_EXAMPLE
	bool "ADE9000 example"

endchoice

endmenu
```

## projects/eval-ade9078/Kconfig
```kconfig
menu "eval-ade9078 Configuration"

choice EVAL_ADE9078_EXAMPLE
	prompt "Example variant"
	default EVAL_ADE9078_ADE9078_EXAMPLE

config EVAL_ADE9078_ADE9078_EXAMPLE
	bool "ADE9078 example"

endchoice

endmenu
```

## projects/eval-ade9153a/Kconfig
```kconfig
menu "eval-ade9153a Configuration"

choice EVAL_ADE9153A_EXAMPLE
	prompt "Example variant"
	default EVAL_ADE9153A_ADE9153A_EXAMPLE_EXAMPLE

config EVAL_ADE9153A_ADE9153A_EXAMPLE_EXAMPLE
	bool "ADE9153A example"

endchoice

endmenu
```

## projects/eval-ade9430/Kconfig
```kconfig
menu "eval-ade9430 Configuration"

choice EVAL_ADE9430_EXAMPLE
	prompt "Example variant"
	default EVAL_ADE9430_BASIC_EXAMPLE

config EVAL_ADE9430_BASIC_EXAMPLE
	bool "Basic example"

config EVAL_ADE9430_IOT_EXAMPLE
	bool "IoT (MQTT/Azure) example"

endchoice

config EVAL_ADE9430_HW_RESET
	bool "Enable hardware reset pin sequence on startup"
	default n
	depends on EVAL_ADE9430_BASIC_EXAMPLE
	help
	  Drive the ADE9430 reset pin before SPI access. Required on
	  EVAL-PQMON boards where the reset line is wired to the MCU.

config EVAL_ADE9430_IOT_AZURE
	bool "Use Azure IoT Hub (mbedTLS + azure-sdk-for-c)"
	default n
	depends on EVAL_ADE9430_IOT_EXAMPLE
	select MBEDTLS
	select AZURE

config EVAL_ADE9430_IOT_RTC
	bool "Set RTC to default date/time on boot"
	default n
	depends on EVAL_ADE9430_IOT_EXAMPLE

config EVAL_ADE9430_IOT_DPS
	bool "Use Azure Device Provisioning Service"
	default n
	depends on EVAL_ADE9430_IOT_AZURE

endmenu
```

## projects/eval-adg1712/Kconfig
```kconfig
menu "eval-adg1712 Configuration"

choice EVAL_ADG1712_EXAMPLE
	prompt "Example variant"
	default EVAL_ADG1712_BASIC_EXAMPLE

config EVAL_ADG1712_BASIC_EXAMPLE
	bool "Basic example"

endchoice

endmenu
```

## projects/eval-adg1736/Kconfig
```kconfig
menu "eval-adg1736 Configuration"

choice EVAL_ADG1736_EXAMPLE
	prompt "Example variant"
	default EVAL_ADG1736_BASIC_EXAMPLE

config EVAL_ADG1736_BASIC_EXAMPLE
	bool "Basic example"

endchoice

endmenu
```

## projects/eval-adg2404/Kconfig
```kconfig
menu "eval-adg2404 Configuration"

choice EVAL_ADG2404_EXAMPLE
	prompt "Example variant"
	default EVAL_ADG2404_BASIC_EXAMPLE

config EVAL_ADG2404_BASIC_EXAMPLE
	bool "Basic example"

endchoice

endmenu
```

## projects/eval-adgm3121/Kconfig
```kconfig
menu "eval-adgm3121 Configuration"

choice EVAL_ADGM3121_EXAMPLE
	prompt "Example variant"
	default EVAL_ADGM3121_BASIC_EXAMPLE

config EVAL_ADGM3121_BASIC_EXAMPLE
	bool "Basic example"

endchoice

endmenu
```
