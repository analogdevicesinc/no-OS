## drivers/gmsl/Kconfig
```kconfig
menuconfig GMSL
	bool "GMSL Drivers"
	default n
	help
	  Enable support for Gigabit Multimedia Serial Link (GMSL) drivers.

if GMSL

config GMSL_REG_ACCESS
	depends on I2C
	bool "Enable GMSL register access driver"
	default n

endif # GMSL
```

## drivers/gnss-gps/Kconfig
```kconfig
menuconfig GNSS_GPS
    bool "GNSS/GPS Drivers"
    default n
    help
      Enable support for GNSS/GPS drivers.

if GNSS_GPS

config GNSS_GPS_NMEA_UBX
    depends on UART
    select GPIO
    select IRQ
    bool "Enable NMEA UBX GNSS driver"
    default n

endif
```

## drivers/gyro/Kconfig
```kconfig
menuconfig GYRO
	bool "Gyroscope Drivers"
	default n
	help
	  Enable support for gyroscope drivers.

if GYRO

config GYRO_ADXRS290
	depends on SPI
	select GPIO
	bool "Enable ADXRS290 gyroscope driver"
	default n

config GYRO_IIO_ADXRS290
	select GYRO_ADXRS290
	bool "Enable ADXRS290 IIO driver"
	default n

config GYRO_ADXRS453
	depends on SPI
	bool "Enable ADXRS453 gyroscope driver"
	default n

endif # GYRO
```

## drivers/impedance-analyzer/Kconfig
```kconfig
menuconfig IMPEDANCE_ANALYZER
	bool "Impedance Analyzer Drivers"
	default n
	help
	  Enable support for impedance analyzer drivers.

if IMPEDANCE_ANALYZER

config IMPEDANCE_ANALYZER_AD5933
	depends on I2C
	bool "Enable AD5933 impedance analyzer driver"
	default n

endif # IMPEDANCE_ANALYZER
```

## drivers/imu/Kconfig
```kconfig
menuconfig IMU
    bool "IMU Drivers"
    default n
    help
      Enable support for Inertial Measurement Unit (IMU) drivers.

      This section contains drivers for various ADIS family IMU devices
      from Analog Devices, providing 6-axis and 10-axis motion sensing.

if IMU

config IMU_ADIS
    bool "Enable ADIS core driver"
    default n
    help
      Core driver for ADIS family IMU devices. Required by all ADIS variants.

config IMU_ADIS1646X
    select IMU_ADIS
    bool "Enable ADIS1646X IMU driver"
    default n

config IMU_IIO_ADIS1646X
    select IMU_ADIS1646X
    bool "Enable ADIS1646X IIO driver"
    default n

config IMU_ADIS1647X
    select IMU_ADIS
    bool "Enable ADIS1647X IMU driver"
    default n

config IMU_IIO_ADIS1647X
    select IMU_ADIS1647X
    bool "Enable ADIS1647X IIO driver"
    default n

config IMU_ADIS1650X
    select IMU_ADIS
    bool "Enable ADIS1650X IMU driver"
    default n

config IMU_IIO_ADIS1650X
    select IMU_ADIS1650X
    bool "Enable ADIS1650X IIO driver"
    default n

config IMU_ADIS1654X
    select IMU_ADIS
    bool "Enable ADIS1654X IMU driver"
    default n

config IMU_IIO_ADIS1654X
    select IMU_ADIS1654X
    bool "Enable ADIS1654X IIO driver"
    default n

config IMU_ADIS1655X
    select IMU_ADIS
    bool "Enable ADIS1655X IMU driver"
    default n

config IMU_IIO_ADIS1655X
    select IMU_ADIS1655X
    bool "Enable ADIS1655X IIO driver"
    default n

config IMU_ADIS1657X
    select IMU_ADIS
    bool "Enable ADIS1657X IMU driver"
    default n

config IMU_IIO_ADIS1657X
    select IMU_ADIS1657X
    bool "Enable ADIS1657X IIO driver"
    default n

config IMU_IIO_ADIS_COMMON
    bool "Enable ADIS common IIO functionality"
    default n
    help
      Common IIO functionality shared across ADIS IIO drivers.
      Automatically enabled when any ADIS IIO driver is selected.

endif # IMU
```

## drivers/io-expander/Kconfig
```kconfig
menuconfig IO_EXPANDER
	bool "I/O Expander Drivers"
	default n
	help
	  Enable support for I/O expander drivers.

if IO_EXPANDER

config IO_EXPANDER_ADP5589
	depends on I2C
	bool "Enable ADP5589 I/O expander driver"
	default n

config IO_EXPANDER_DEMUX_SPI
	depends on SPI
	bool "Enable SPI demultiplexer driver"
	default n

config IO_EXPANDER_LTC4306
	depends on I2C
	bool "Enable LTC4306 I/O expander driver"
	default n

config IO_EXPANDER_LTC4332
	depends on SPI
	bool "Enable LTC4332 I/O expander driver"
	default n

endif # IO_EXPANDER
```

## drivers/io-link/Kconfig
```kconfig
menuconfig IO_LINK
	bool "IO-Link Drivers"
	default n
	help
	  Enable support for IO-Link device drivers.

if IO_LINK

config IO_LINK_MAX22516
	depends on SPI
	select GPIO
	bool "Enable MAX22516 IO-Link driver"
	default n

config IO_LINK_ADIOL100
	depends on SPI
	bool "Enable ADIOL100/ADIOL101 IO-Link driver"
	default n

endif # IO_LINK
```

## drivers/led/Kconfig
```kconfig
menuconfig LED
	bool "LED Drivers"
	default n
	help
	  Enable support for LED drivers.

if LED

config LED_LTC3208
	depends on I2C
	select GPIO
	bool "Enable LTC3208 LED driver"
	default n

config LED_LTC3220
	depends on I2C
	select GPIO
	bool "Enable LTC3220 LED driver"
	default n

config LED_MAX25603
	depends on GPIO
	select PWM
	bool "Enable MAX25603 LED driver"
	default n

endif # LED
```

## drivers/meter/Kconfig
```kconfig
menuconfig METER
	bool "Energy Meter Drivers"
	default n
	help
	  Enable support for energy metering drivers.

if METER

config METER_ADE7753
	depends on SPI
	select GPIO
	bool "Enable ADE7753 energy meter driver"
	default n

config METER_ADE7754
	depends on SPI
	select GPIO
	bool "Enable ADE7754 energy meter driver"
	default n

config METER_ADE7758
	depends on SPI
	select GPIO
	bool "Enable ADE7758 energy meter driver"
	default n

config METER_ADE7816
	depends on SPI || I2C
	select GPIO
	bool "Enable ADE7816 energy meter driver"
	default n

config METER_ADE7880
	depends on SPI
	select GPIO
	bool "Enable ADE7880 energy meter driver"
	default n

config METER_ADE7913
	depends on SPI
	select GPIO
	bool "Enable ADE7913 energy meter driver"
	default n

config METER_ADE7953
	depends on SPI
	select GPIO
	bool "Enable ADE7953 energy meter driver"
	default n

config METER_ADE7978
	depends on SPI
	select GPIO
	bool "Enable ADE7978 energy meter driver"
	default n

config METER_ADE9000
	depends on SPI
	bool "Enable ADE9000 energy meter driver"
	default n

config METER_ADE9078
	depends on SPI
	select GPIO
	bool "Enable ADE9078 energy meter driver"
	default n

config METER_ADE9113
	depends on SPI
	select GPIO
	bool "Enable ADE9113 energy meter driver"
	default n

config METER_ADE9153A
	depends on SPI
	select GPIO
	bool "Enable ADE9153A energy meter driver"
	default n

config METER_ADE9430
	depends on SPI
	bool "Enable ADE9430 energy meter driver"
	default n

endif # METER
```

## drivers/mux/Kconfig
```kconfig
menuconfig MUX
	bool "Multiplexer Drivers"
	default n
	help
	  Enable support for multiplexer/demultiplexer drivers.

if MUX

config MUX_ADG2404
	depends on GPIO
	bool "Enable ADG2404 multiplexer driver"
	default n

config MUX_ADGS1408
	depends on SPI
	bool "Enable ADGS1408 multiplexer driver"
	default n

config MUX_ADGS5412
	depends on SPI
	bool "Enable ADGS5412 multiplexer driver"
	default n

endif # MUX
```

## drivers/net/Kconfig
```kconfig
menuconfig NET
    bool "Networking Drivers"
    default n
    help
      Enable support for networking drivers.

if NET

config ADIN1110
    depends on SPI
    select GPIO
    select OA_TC6
    bool "Enable the ADIN1110 driver"
    default n

config ADIN1320
    select MDIO_SPI
    bool "Enable the ADIN1320 driver"
    default n
    help
      Enable the ADIN1320 Ethernet PHY driver. Communicates with the PHY
      over MDIO carried on a SPI bus (MDIO_SPI).

config NET_ADIN1300
    depends on GPIO
    bool "Enable the ADIN1300 driver"
    default n

config NET_IIO_ADIN1300
    select NET_ADIN1300
    bool "Enable the ADIN1300 IIO driver"
    default n

config NET_MAX24287
    depends on GPIO
    bool "Enable the MAX24287 driver"
    default n

config NET_IIO_MAX24287
    select NET_MAX24287
    bool "Enable the MAX24287 IIO driver"
    default n

config NET_MDIO_BITBANG
    depends on GPIO
    bool "Enable the MDIO bit-bang driver"
    default n

config MDIO_SPI
    depends on SPI
    select MDIO
    bool "Enable the MDIO over SPI driver"
    default n
    help
      Enable the MDIO-over-SPI transport driver, which implements the
      no_os_mdio API on top of a SPI bus.

config ADIN1140
    depends on SPI
    select GPIO
    select OA_TC6
    bool "Enable the ADIN1140 10BASE-T1S MACPHY driver"
    default n

config OA_TC6
    depends on SPI
    bool "Enable the Open Alliance TC6 protocol library"
    default n

source "drivers/net/oa_tc6/Kconfig"

endif
```

## drivers/photo-electronic/Kconfig
```kconfig
menuconfig PHOTO_ELECTRONIC
	bool "Photo-Electronic Drivers"
	default n
	help
	  Enable support for photo-electronic sensor drivers.

if PHOTO_ELECTRONIC

config PHOTO_ELECTRONIC_ADPD188
	depends on SPI || I2C
	select GPIO
	bool "Enable ADPD188 photo-electronic driver"
	default n

config PHOTO_ELECTRONIC_IIO_ADPD188
	select PHOTO_ELECTRONIC_ADPD188
	bool "Enable ADPD188 IIO driver"
	default n

config PHOTO_ELECTRONIC_ADPD410X
	depends on SPI || I2C
	select GPIO
	bool "Enable ADPD410x photo-electronic driver"
	default n

config PHOTO_ELECTRONIC_IIO_ADPD410X
	select PHOTO_ELECTRONIC_ADPD410X
	bool "Enable ADPD410x IIO driver"
	default n

endif # PHOTO_ELECTRONIC
```

## drivers/platform/Kconfig
```kconfig
menuconfig PLATFORM_DRIVERS
	bool "Platform Drivers"
	default n
	help
	  Enable support for platform-specific drivers.

	  This section contains low-level platform drivers for various
	  microcontrollers and processors including STM32, Maxim, and
	  other hardware platforms. These drivers provide hardware
	  abstraction for peripherals like GPIO, SPI, I2C, UART, etc.

if PLATFORM_DRIVERS

source "drivers/platform/stm32/Kconfig"
source "drivers/platform/maxim/Kconfig"

config PLATFORM_I2C_BITBANG
	default n
	bool "Enable the I2C bitbang driver"

config PLATFORM_I2C_BITBANG_CAPI
	default n
	bool "Enable the CAPI I2C bitbang driver"
	help
	  Enable the CAPI-based I2C bitbang driver that uses CAPI GPIO.

	  This driver provides software I2C functionality using GPIO pins
	  controlled through the CAPI GPIO interface. It supports standard
	  I2C features including clock stretching, configurable speed, and
	  both open-drain and push-pull modes.

endif # PLATFORM_DRIVERS
```

## drivers/platform/aducm3029/Kconfig
```kconfig
menuconfig ADUCM3029
	bool "ADuCM3029 Platform Drivers"
	default n
	help
	  Enable support for Analog Devices ADuCM3029 platform drivers.

	  This section contains low-level platform drivers for the ADuCM3029
	  microcontroller including GPIO, SPI, I2C, UART, PWM, ADC, RTC, Timer,
	  TRNG, flash and interrupt handling. Building this platform requires
	  Analog Devices CrossCore Embedded Studio (CCES).

if ADUCM3029

config UART_ADUCM3029
	bool "Enable ADuCM3029 UART driver"
	depends on UART
	default n
	help
	  Enable ADuCM3029-specific UART driver implementation.

config UART_STDIO_ADUCM3029
	bool "Enable ADuCM3029 UART STDIO driver"
	depends on UART
	default n
	help
	  Enable ADuCM3029-specific UART STDIO driver implementation.

config IRQ_ADUCM3029
	bool "Enable ADuCM3029 IRQ driver"
	depends on IRQ
	default n
	help
	  Enable ADuCM3029-specific interrupt handling driver.

config GPIO_ADUCM3029
	bool "Enable ADuCM3029 GPIO driver"
	depends on GPIO
	default n
	help
	  Enable ADuCM3029-specific GPIO driver implementation.

config GPIO_IRQ_ADUCM3029
	bool "Enable ADuCM3029 GPIO IRQ driver"
	depends on GPIO && IRQ
	default n
	help
	  Enable ADuCM3029-specific GPIO interrupt driver implementation.

config I2C_ADUCM3029
	bool "Enable ADuCM3029 I2C driver"
	depends on I2C
	default n
	help
	  Enable ADuCM3029-specific I2C driver implementation.

config SPI_ADUCM3029
	bool "Enable ADuCM3029 SPI driver"
	depends on SPI
	default n
	help
	  Enable ADuCM3029-specific SPI driver implementation.

config TIMER_ADUCM3029
	bool "Enable ADuCM3029 Timer driver"
	depends on TIMER
	default n
	help
	  Enable ADuCM3029-specific Timer driver implementation.

config RTC_ADUCM3029
	bool "Enable ADuCM3029 RTC driver"
	depends on RTC
	default n
	help
	  Enable ADuCM3029-specific RTC driver implementation.

config PWM_ADUCM3029
	bool "Enable ADuCM3029 PWM driver"
	depends on PWM
	default n
	help
	  Enable ADuCM3029-specific PWM driver implementation.

config ADC_ADUCM3029
	bool "Enable ADuCM3029 ADC driver"
	depends on ADC
	default n
	help
	  Enable ADuCM3029-specific ADC driver implementation.

config FLASH_ADUCM3029
	bool "Enable ADuCM3029 flash driver"
	default n
	help
	  Enable ADuCM3029-specific flash controller driver implementation.

config TRNG_ADUCM3029
	bool "Enable ADuCM3029 TRNG driver"
	depends on TRNG
	default n
	help
	  Enable ADuCM3029-specific True Random Number Generator driver.

config ADUCM_PINMUX_PATH
	string "ADuCM3029 pinmux_config.c path"
	default ""
	help
	  Path to the pinmux_config.c "hardware" file used by CCES to generate
	  the ADuCM3029 pin multiplexing sources. Relative paths are resolved
	  from the project directory. When empty, defaults to
	  projects/<project>/pinmux_config.c.

endif # ADUCM3029
```
