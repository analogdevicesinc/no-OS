## drivers/platform/maxim/Kconfig
```kconfig
menuconfig MAXIM
	bool "Maxim Platform Drivers"
	default n
	help
	  Enable support for Maxim platform drivers.

	  This section contains low-level platform drivers for Maxim
	  microcontrollers including GPIO, SPI, I2C, UART, PWM, DMA,
	  interrupt handling, USB UART, RTC, Timer, and other peripheral
	  drivers across multiple Maxim chip families.

if MAXIM

config GPIO_MAXIM
	bool "Enable Maxim GPIO driver"
	depends on GPIO
	default n
	help
	  Enable Maxim-specific GPIO driver implementation.

config GPIO_IRQ_MAXIM
	bool "Enable Maxim GPIO IRQ driver"
	depends on GPIO && IRQ
	default n
	help
	  Enable Maxim-specific GPIO interrupt driver implementation.

config I2C_MAXIM
	bool "Enable Maxim I2C driver"
	depends on I2C
	default n
	help
	  Enable Maxim-specific I2C driver implementation.

config SPI_MAXIM
	bool "Enable Maxim SPI driver"
	depends on SPI
	default n
	help
	  Enable Maxim-specific SPI driver implementation.

config SPI_GPIO_MAXIM
	bool "Enable Maxim bit-banged (GPIO) SPI driver"
	depends on SPI && GPIO_MAXIM
	default n
	help
	  Enable a software SPI master implemented with direct GPIO register
	  toggling (no_os_spi platform ops). Pin-parameterized and safe to share a
	  bus between two cores: it drives SCLK/MOSI only while a transfer is in
	  flight and leaves them high-Z otherwise, so an idle core does not fight
	  the active one. Used by the MAX78000 dual-core IMU example.

config SYS_MAXIM
	bool "Enable Maxim system-level helpers"
	default n
	help
	  Enable shared MAX78000 system helpers (maxim_sys.c), including the
	  read-modify-write __wrap_MXC_SYS_Reset_Periph() replacement for the SDK's
	  destructive peripheral-reset store. Requires the corresponding
	  "-Wl,--wrap=MXC_SYS_Reset_Periph" link option.

config UART_MAXIM
	bool "Enable Maxim UART driver"
	depends on UART
	default n
	help
	  Enable Maxim-specific UART driver implementation.

config UART_STDIO_MAXIM
	bool "Enable Maxim UART STDIO driver"
	depends on UART
	default n
	help
	  Enable Maxim-specific UART STDIO driver implementation.

config USB_UART_MAXIM
	bool "Enable Maxim USB UART driver"
	default n
	help
	  Enable Maxim-specific USB UART driver implementation.
	  Platform-specific USB UART functionality.

config IRQ_MAXIM
	bool "Enable Maxim IRQ driver"
	depends on IRQ
	default n
	help
	  Enable Maxim-specific interrupt handling driver.

config PWM_MAXIM
	bool "Enable Maxim PWM driver"
	depends on PWM
	default n
	help
	  Enable Maxim-specific PWM driver implementation.
	  Requires CONFIG_PWM=y to be enabled.

config TIMER_MAXIM
	bool "Enable Maxim Timer driver"
	depends on TIMER
	default n
	help
	  Enable Maxim-specific Timer driver implementation.
	  Requires CONFIG_TIMER=y to be enabled.

config RTC_MAXIM
	bool "Enable Maxim RTC driver"
	depends on RTC
	default n
	help
	  Enable Maxim-specific RTC driver implementation.
	  Requires CONFIG_RTC=y to be enabled.

config TRNG_MAXIM
	bool "Enable Maxim TRNG driver"
	depends on TRNG
	default n
	help
	  Enable Maxim-specific TRNG (True Random Number Generator) driver.
	  Requires CONFIG_TRNG=y to be enabled.

config DMA_MAXIM
	bool "Enable Maxim DMA driver"
	depends on DMA
	default n
	help
	  Enable Maxim-specific DMA driver implementation.

config IPC_MAXIM
	bool "Enable Maxim inter-processor communication (IPC) driver"
	select IPC
	default n
	help
	  Enable the SEMA-backed inter-processor communication driver: core-to-core
	  doorbell interrupts (irq0/irq1) and hardware mailbox registers for
	  notifications between CPU0 (Arm) and CPU1 (RISC-V). Implements the generic
	  no_os_ipc API (include/no_os_ipc.h).

config COPROCESSOR_MAXIM
	bool "Enable Maxim coprocessor (CPU1) lifecycle driver"
	depends on IPC_MAXIM
	default n
	help
	  Enable boot/halt lifecycle control for the auxiliary processor core
	  (e.g., RISC-V RV32 CPU1 on MAX78000). Also provides access to the
	  cross-core IPC shared memory interface (maxim_ipc_shared.h).

endif # MAXIM
```

## drivers/platform/maxim/Kconfig.maxim
```kconfig
config SPI_MAXIM
        bool "Enable Maxim SPI driver"
        default n

config I2C_MAXIM
        bool "Enable Maxim I2C driver"
        default n

config UART_MAXIM
        bool "Enable Maxim UART driver"
        default n

config UART_STDIO_MAXIM
        bool "Enable Maxim UART STDIO driver"
        default n

config IRQ_MAXIM
        bool "Enable Maxim interrupt controller driver"
        default n
```

## drivers/platform/pico/Kconfig
```kconfig
menuconfig PICO
	bool "Pico Platform Drivers"
	default n
	help
	  Enable support for Raspberry Pi Pico (RP2040) platform drivers.

	  This section contains low-level platform drivers for the RP2040
	  microcontroller including GPIO, SPI, I2C, UART, interrupt handling
	  and Timer drivers, built on top of the vendored pico-sdk.

if PICO

config GPIO_PICO
	bool "Enable Pico GPIO driver"
	depends on GPIO
	default n
	help
	  Enable Pico-specific GPIO driver implementation.

config GPIO_IRQ_PICO
	bool "Enable Pico GPIO IRQ driver"
	depends on GPIO && IRQ
	default n
	help
	  Enable Pico-specific GPIO interrupt driver implementation.

config I2C_PICO
	bool "Enable Pico I2C driver"
	depends on I2C
	default n
	help
	  Enable Pico-specific I2C driver implementation.

config SPI_PICO
	bool "Enable Pico SPI driver"
	depends on SPI
	default n
	help
	  Enable Pico-specific SPI driver implementation.

config UART_PICO
	bool "Enable Pico UART driver"
	depends on UART
	default n
	help
	  Enable Pico-specific UART driver implementation.

config IRQ_PICO
	bool "Enable Pico IRQ driver"
	depends on IRQ
	default n
	help
	  Enable Pico-specific IRQ driver implementation.

config TIMER_PICO
	bool "Enable Pico Timer driver"
	depends on TIMER
	default n
	help
	  Enable Pico-specific Timer driver implementation.
	  Requires CONFIG_TIMER=y to be enabled.

endif # PICO
```

## drivers/platform/stm32/Kconfig
```kconfig
menuconfig STM32
	bool "STM32 Platform Drivers"
	default n
	help
	  Enable support for STM32 platform drivers.

	  This section contains low-level platform drivers for STM32
	  microcontrollers including GPIO, SPI, I2C, UART, PWM, DMA,
	  interrupt handling, and other peripheral drivers.

if STM32

config GPIO_STM32
	bool "Enable STM32 GPIO driver"
	depends on GPIO
	default n
	help
	  Enable STM32-specific GPIO driver implementation.
	  Requires CONFIG_GPIO=y to be enabled.

config GPIO_IRQ_STM32
	bool "Enable STM32 GPIO IRQ driver"
	depends on GPIO && IRQ
	default n
	help
	  Enable STM32-specific GPIO interrupt driver implementation.
	  Requires CONFIG_GPIO=y and CONFIG_IRQ=y to be enabled.

config I2C_STM32
	bool "Enable STM32 I2C driver"
	depends on I2C
	default n
	help
	  Enable STM32-specific I2C driver implementation.
	  Requires CONFIG_I2C=y to be enabled.

config I3C_STM32
	bool "Enable STM32 I3C driver"
	depends on I3C
	default n
	help
	  Enable STM32-specific I3C driver implementation.
	  Requires CONFIG_I3C=y to be enabled.

config SPI_STM32
	bool "Enable STM32 SPI driver"
	depends on SPI
	default n
	help
	  Enable STM32-specific SPI driver implementation.
	  Requires CONFIG_SPI=y to be enabled.

config XSPI_STM32
	bool "Enable STM32 XSPI driver"
	depends on SPI
	default n
	help
	  Enable STM32-specific XSPI (Extended SPI) driver implementation.
	  Requires CONFIG_SPI=y to be enabled.

config UART_STM32
	bool "Enable STM32 UART driver"
	depends on UART
	default n
	help
	  Enable STM32-specific UART driver implementation.
	  Requires CONFIG_UART=y to be enabled.

config UART_STDIO_STM32
	bool "Enable STM32 UART STDIO driver"
	depends on UART
	default n
	help
	  Enable STM32-specific UART STDIO driver implementation.
	  Requires CONFIG_UART=y to be enabled.

config USB_UART_STM32
	bool "Enable STM32 USB UART driver"
	default n
	help
	  Enable STM32-specific USB UART driver implementation.
	  Platform-specific USB UART functionality.

config IRQ_STM32
	bool "Enable STM32 IRQ driver"
	depends on IRQ
	default n
	help
	  Enable STM32-specific interrupt handling driver.
	  Requires CONFIG_IRQ=y to be enabled.

config PWM_STM32
	bool "Enable STM32 PWM driver"
	depends on PWM
	default n
	help
	  Enable STM32-specific PWM driver implementation.
	  Requires CONFIG_PWM=y to be enabled.

config TIMER_STM32
	bool "Enable STM32 Timer driver"
	depends on TIMER
	default n
	help
	  Enable STM32-specific Timer driver implementation.
	  Requires CONFIG_TIMER=y to be enabled.

config DMA_STM32
	bool "Enable STM32 DMA driver"
	depends on DMA
	default n
	help
	  Enable STM32-specific DMA driver implementation.
	  Requires CONFIG_DMA=y to be enabled.

config GPDMA_STM32
	bool "Enable STM32 GPDMA driver"
	depends on DMA
	default n
	help
	  Enable STM32-specific GPDMA (General Purpose DMA) driver implementation.
	  Requires CONFIG_DMA=y to be enabled.

config TDM_STM32
	bool "Enable STM32 TDM driver"
	depends on TDM
	default n
	help
	  Enable STM32-specific TDM (Time Division Multiplexing) driver implementation.
	  Requires CONFIG_TDM=y to be enabled.

endif # STM32
```

## drivers/platform/stm32/Kconfig.stm32
```kconfig
config SPI_STM32
        depends on SPI
        default n
        bool "Enable the STM32 SPI driver"

config I2C_STM32
        depends on I2C
        default n
        bool "Enable the STM32 I2C driver"

config UART_STM32
        depends on UART
        default n
        bool "Enable the STM32 UART driver"

config UART_STDIO_STM32
        bool "Enable the STM32 UART STDIO driver"
        default n

config IRQ_STM32
        depends on IRQ
        bool "Enable the STM32 interrupt controller driver"
        default n

config GPIO_STM32
        bool "Enable the STM32 GPIO driver"
        default n

config GPIO_IRQ_STM32
        bool "Enable the STM32 GPIO IRQ driver"
        default n

config STM32_IOC_PATH
        string "Path to a STM32 CubeMX configuration file that will be used to generate the HAL drivers"
```

## drivers/platform/xilinx/Kconfig
```kconfig
menuconfig XILINX
	bool "Xilinx Platform Drivers"
	default n
	help
	  Enable support for Xilinx platform drivers.

	  Low-level platform drivers for Xilinx Zynq-7000, ZynqMP, Versal
	  and MicroBlaze targets (GPIO, SPI, I2C, UART, IRQ, Timer),
	  built on top of a Vitis-generated standalone BSP.

if XILINX

config XILINX_HDL_DESIGN
	string "HDL design name for the CI .xsa download"
	default ""
	help
	  Name of the HDL design whose exported system_top.xsa this project
	  builds against (e.g. "adv7511", "pulsar_adc", "adrv9009"). The build
	  tooling composes the artifact server folder name as
	  <this>_<board> (e.g. adv7511_zed) and downloads system_top.xsa from
	  the sdg-hdl Cloudsmith repo for CI builds. The board suffix comes from
	  the CMake board/preset, so only the design prefix belongs here. This
	  symbol is read by the build scripts only; it does not affect compiled
	  sources.

config UART_XILINX
	bool "Enable Xilinx UART driver"
	depends on UART
	select IRQ
	select IRQ_XILINX
	default n
	help
	  The Xilinx PS UART driver is interrupt-driven (it calls
	  no_os_irq_ctrl_init and references xil_irq_ops unconditionally on
	  Zynq/ZynqMP), so it requires the IRQ subsystem and the Xilinx IRQ
	  platform driver. Select them here so a project enabling UART_XILINX
	  does not have to remember the dependency.

config SPI_XILINX
	bool "Enable Xilinx SPI driver"
	depends on SPI
	default n

config I2C_XILINX
	bool "Enable Xilinx I2C driver"
	depends on I2C
	default n

config GPIO_XILINX
	bool "Enable Xilinx GPIO driver"
	depends on GPIO
	default n

config GPIO_IRQ_XILINX
	bool "Enable Xilinx GPIO IRQ driver"
	depends on GPIO && IRQ
	default n

config IRQ_XILINX
	bool "Enable Xilinx IRQ driver"
	depends on IRQ
	default n

config TIMER_XILINX
	bool "Enable Xilinx Timer driver"
	depends on TIMER
	default n

endif
```

## drivers/position/Kconfig
```kconfig
menuconfig POSITION
	bool "Position Drivers"
	default n
	help
	  Enable support for position drivers.

if POSITION

config POSITION_ADMT4000
	depends on SPI
	select GPIO
	bool "Enable ADMT4000 driver"
	default n

config POSITION_IIO_ADMT4000
	select POSITION_ADMT4000
	bool "Enable ADMT4000 IIO driver"
	default n

config POSITION_IIO_ADMT4000_TRIG
	select POSITION_IIO_ADMT4000
	bool "Enable ADMT4000 IIO trigger driver"
	default n

endif
```

## drivers/potentiometer/Kconfig
```kconfig
menuconfig POTENTIOMETER
	bool "Digital Potentiometer Drivers"
	default n
	help
	  Enable support for digital potentiometer drivers.

if POTENTIOMETER

config POTENTIOMETER_AD5110
	depends on I2C
	bool "Enable AD5110 digital potentiometer driver"
	default n

config POTENTIOMETER_AD514X
	depends on SPI || I2C
	select GPIO
	bool "Enable AD514x digital potentiometer driver (AD5141/AD5142/AD5143/AD5144)"
	default n

config POTENTIOMETER_AD5161
	depends on SPI || I2C
	select GPIO
	bool "Enable AD5161 digital potentiometer driver"
	default n

config POTENTIOMETER_AD5165
	depends on SPI || I2C
	select GPIO
	bool "Enable AD5165 digital potentiometer driver"
	default n

config POTENTIOMETER_AD5171
	depends on SPI || I2C
	select GPIO
	bool "Enable AD5171 digital potentiometer driver"
	default n

config POTENTIOMETER_AD5242
	depends on SPI || I2C
	select GPIO
	bool "Enable AD5242 digital potentiometer driver"
	default n

config POTENTIOMETER_AD5246
	depends on SPI || I2C
	select GPIO
	bool "Enable AD5246 digital potentiometer driver"
	default n

config POTENTIOMETER_AD5259
	depends on SPI || I2C
	select GPIO
	bool "Enable AD5259 digital potentiometer driver"
	default n

config POTENTIOMETER_AD525X
	depends on SPI || I2C
	select GPIO
	bool "Enable AD525x digital potentiometer driver"
	default n

config POTENTIOMETER_AD5293
	depends on SPI
	select GPIO
	bool "Enable AD5293 digital potentiometer driver"
	default n

endif # POTENTIOMETER
```
