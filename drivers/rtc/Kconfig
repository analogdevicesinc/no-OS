## drivers/rtc/Kconfig
```kconfig
menuconfig RTC_DRIVERS
	bool "RTC Device Drivers"
	default n
	help
	  Enable support for Real-Time Clock (RTC) device drivers.

if RTC_DRIVERS

config RTC_DRIVERS_MAX31343
	depends on I2C
	bool "Enable MAX31343 RTC driver"
	default n

config RTC_DRIVERS_PCF85263
	depends on I2C
	bool "Enable PCF85263 RTC driver"
	default n

endif # RTC_DRIVERS
```

## drivers/sd-card/Kconfig
```kconfig
menuconfig SD_CARD
	bool "SD Card Drivers"
	default n
	help
	  Enable support for SD card drivers.

if SD_CARD

config SD_CARD_SD
	depends on SPI
	bool "Enable SD card driver"
	default n

endif # SD_CARD
```

## drivers/switch/Kconfig
```kconfig
menuconfig SWITCH
	bool "Switch/Crosspoint Drivers"
	default n
	help
	  Enable support for analog switch and crosspoint switch drivers.

if SWITCH

config SWITCH_ADG1712
	depends on GPIO
	bool "Enable ADG1712 switch driver"
	default n

config SWITCH_ADG1736
	depends on GPIO
	bool "Enable ADG1736 switch driver"
	default n

config SWITCH_IIO_ADG2128
	depends on I2C
	bool "Enable ADG2128 IIO switch driver"
	default n

config SWITCH_ADGM3121
	depends on SPI
	select GPIO
	bool "Enable ADGM3121 switch driver"
	default n

config SWITCH_ADGS6414D
	depends on SPI
	bool "Enable ADGS6414D switch driver"
	default n

endif # SWITCH
```

## drivers/temperature/Kconfig
```kconfig
menuconfig TEMPERATURE
    bool "Temperature Drivers"
    default n
    help
      Enable support for temperature sensor drivers.

if TEMPERATURE

config TEMPERATURE_ADT7420
    depends on I2C
    bool "Enable ADT7420 driver"
    default n

config TEMPERATURE_IIO_ADT7420
    select TEMPERATURE_ADT7420
    bool "Enable ADT7420 IIO driver"
    default n

config TEMPERATURE_ADT75
    depends on I2C
    bool "Enable ADT75 driver"
    default n

config TEMPERATURE_IIO_ADT75
    select TEMPERATURE_ADT75
    bool "Enable ADT75 IIO driver"
    default n

config TEMPERATURE_LM75
    depends on I2C
    bool "Enable LM75 driver"
    default n

config TEMPERATURE_IIO_LM75
    select TEMPERATURE_LM75
    bool "Enable LM75 IIO driver"
    default n

config TEMPERATURE_LTC2983
    depends on SPI
    bool "Enable LTC2983 driver"
    default n

config TEMPERATURE_IIO_LTC2983
    select TEMPERATURE_LTC2983
    bool "Enable LTC2983 IIO driver"
    default n

config TEMPERATURE_MAX31827
    depends on I2C
    bool "Enable MAX31827 driver"
    default n

config TEMPERATURE_IIO_MAX31827
    select TEMPERATURE_MAX31827
    bool "Enable MAX31827 IIO driver"
    default n

config TEMPERATURE_MAX31855
    depends on SPI
    bool "Enable MAX31855 driver"
    default n

config TEMPERATURE_IIO_MAX31855
    select TEMPERATURE_MAX31855
    bool "Enable MAX31855 IIO driver"
    default n

endif
```

## network/Kconfig
```kconfig
menu "Network Configuration"
	depends on LWIP || W5500 || WIFI

config NO_OS_NET
	bool "Use the new no_os_net / no_os_socket interfaces"
	default n
	depends on LWIP || W5500 || WIFI
	help
	  Select the new networking HAL (no_os_net + no_os_socket) instead of
	  the legacy network_interface / tcp_socket stack. Mutually exclusive
	  with the legacy path: when enabled, the matching adapter (network/lwip,
	  network/w5500 or network/wifi) is compiled and the legacy
	  NO_OS_*_NETWORKING macro is left undefined.

config NO_OS_STATIC_IP
	bool "Use static IP address"
	default n
	help
	  Use a static IP address instead of DHCP. When enabled,
	  NO_OS_IP, NO_OS_NETMASK and NO_OS_GATEWAY must be configured.

config NO_OS_IP
	string "IP address"
	depends on NO_OS_STATIC_IP

config NO_OS_NETMASK
	string "Netmask"
	depends on NO_OS_STATIC_IP

config NO_OS_GATEWAY
	string "Gateway"
	depends on NO_OS_STATIC_IP

config NO_OS_DOMAIN_NAME
	string "mDNS host name"
	default "analog"
	depends on LWIP
	help
	  Host name advertised by the lwIP mDNS responder (the board is
	  reachable as <name>.local). Defaults to "analog".

config NO_OS_LWIP_INIT_ONETIME
	bool "Initialize LWIP only once"
	default n
	depends on LWIP
	help
	  When enabled, the LWIP network stack is initialized only
	  once and subsequent calls reuse the existing descriptor.

endmenu

# ESP8266 Wi-Fi credentials. Kept outside the LWIP/W5500 menu above because the
# AT-command Wi-Fi transport does not use those stacks. Selected by a project's
# own networking option (e.g. IIO_DEMO_NETWORKING) so the WIFI_SSID / WIFI_PWD
# strings are only emitted for Wi-Fi builds, the same way NO_OS_IP is gated by
# NO_OS_STATIC_IP.
config WIFI_NETWORKING
	bool

config WIFI_SSID
	string "Wi-Fi SSID"
	depends on WIFI_NETWORKING
	default "RouterSSID"
	help
	  SSID of the access point the ESP8266 Wi-Fi module connects to.

config WIFI_PWD
	string "Wi-Fi password"
	depends on WIFI_NETWORKING
	default "******"
	help
	  Password for the WIFI_SSID access point.
```

## projects/Kconfig
```kconfig
menu "Project-Specific Configuration"

source "projects/apard32690/Kconfig"
source "projects/cn0565/Kconfig"
source "projects/adxrs290-pmdz/Kconfig"
source "projects/eval-adis1647x/Kconfig"
source "projects/eval-adis1650x/Kconfig"
source "projects/eval-adis1654x/Kconfig"
source "projects/eval-adis1655x/Kconfig"
source "projects/eval-adis1657x/Kconfig"
source "projects/eval-adxl313z/Kconfig"
source "projects/eval-adxl38x/Kconfig"
source "projects/eval-adxl355-pmdz/Kconfig"
source "projects/eval-cn0391-ardz/Kconfig"
source "projects/eval-adis1646x/Kconfig"
source "projects/iio_demo/Kconfig"
source "projects/ltm3360b/Kconfig"
source "projects/max14906/Kconfig"
source "projects/max22007/Kconfig"
source "projects/max22915/Kconfig"
source "projects/swiot1l/Kconfig"
source "projects/ad405x/Kconfig"
source "projects/ad463x_fmcz/Kconfig"
source "projects/ad4692_ardz/Kconfig"
source "projects/adf4371/Kconfig"
source "projects/ad74413r/Kconfig"
source "projects/ad74416h/Kconfig"
source "projects/adin1320/Kconfig"
source "projects/adf4382/Kconfig"
source "projects/ad7616-st/Kconfig"
source "projects/pulsar-adc/Kconfig"
source "projects/ad738x_fmcz/Kconfig"
source "projects/admt4000/Kconfig"
source "projects/ade7816/Kconfig"
source "projects/dc2903a/Kconfig"
source "projects/eval-ade7754/Kconfig"
source "projects/adalm-mmsc/Kconfig"
source "projects/aducm_blinky_example/Kconfig"
source "projects/aducm3029_flash_demo/Kconfig"
source "projects/ada4250_ardz/Kconfig"
source "projects/cn0531/Kconfig"
source "projects/iio_adpd1080/Kconfig"
source "projects/eval-ltc4306/Kconfig"

source "projects/ad7091r8-sdz/Kconfig"
source "projects/adalm-lsmspg/Kconfig"
source "projects/ades1754/Kconfig"
source "projects/adin1110/Kconfig"
source "projects/adp1050/Kconfig"
source "projects/adp1055/Kconfig"
source "projects/adp5055/Kconfig"
source "projects/adt75/Kconfig"
source "projects/apardpfwd/Kconfig"
source "projects/dc2703a/Kconfig"
source "projects/eval-ad7490sdz/Kconfig"
source "projects/eval-ad8460/Kconfig"
source "projects/eval-ade7753/Kconfig"
source "projects/eval-ade7758/Kconfig"
source "projects/eval-ade7880/Kconfig"
source "projects/eval-ade7913/Kconfig"
source "projects/eval-ade7953/Kconfig"
source "projects/eval-ade7978/Kconfig"
source "projects/eval-ade9000/Kconfig"
source "projects/eval-ade9078/Kconfig"
source "projects/eval-ade9153a/Kconfig"
source "projects/eval-adg1712/Kconfig"
source "projects/eval-adg1736/Kconfig"
source "projects/eval-adg2404/Kconfig"
source "projects/eval-adgm3121/Kconfig"
source "projects/eval-adgs6414d/Kconfig"
source "projects/eval-adhv4710/Kconfig"
source "projects/eval-adl8113/Kconfig"
source "projects/eval-ublox-gnss/Kconfig"
source "projects/lt3074/Kconfig"
source "projects/lt7170/Kconfig"
source "projects/lt7182s/Kconfig"
source "projects/lt8722/Kconfig"
source "projects/ltc2378/Kconfig"
source "projects/ltc2983/Kconfig"
source "projects/ltc3208/Kconfig"
source "projects/ltc3220/Kconfig"
source "projects/ltc3337/Kconfig"
source "projects/ltc4162l/Kconfig"
source "projects/ltc4296/Kconfig"
source "projects/ltc7841/Kconfig"
source "projects/ltc7871/Kconfig"
source "projects/ltm4686/Kconfig"
source "projects/ltp8800/Kconfig"
source "projects/max11205pmb1/Kconfig"
source "projects/max14914/Kconfig"
source "projects/max14919/Kconfig"
source "projects/max17616/Kconfig"
source "projects/max22017/Kconfig"
source "projects/max22190/Kconfig"
source "projects/max22196/Kconfig"
source "projects/max22200/Kconfig"
source "projects/max25603/Kconfig"
source "projects/max31855/Kconfig"
source "projects/max42500/Kconfig"
source "projects/adt7420-pmdz/Kconfig"
source "projects/demo_esp/Kconfig"
source "projects/eval-ltc4306/Kconfig"
source "projects/max14916/Kconfig"
source "projects/max31827-evkit/Kconfig"
source "projects/ad-acevsecrdset-sl/Kconfig"
source "projects/iio_demo_freeRTOS/Kconfig"
source "projects/ssd1306/Kconfig"
source "projects/wethlink/Kconfig"
source "projects/eval-ade9430/Kconfig"
source "projects/eval-pqmon/Kconfig"
endmenu
```

## projects/ad-acevsecrdset-sl/Kconfig
```kconfig
menu "ad-acevsecrdset-sl Configuration"

choice AD_ACEVSECRDSET_SL_EXAMPLE
	prompt "Example variant"
	default AD_ACEVSECRDSET_SL_STOUT_APPLICATION_EXAMPLE

config AD_ACEVSECRDSET_SL_STOUT_APPLICATION_EXAMPLE
	bool "Stout application example"

endchoice

choice AD_ACEVSECRDSET_SL_BOARD_REVISION
	prompt "Board revision"
	default AD_ACEVSECRDSET_SL_REV_D

config AD_ACEVSECRDSET_SL_REV_A
	bool "Revision A"

config AD_ACEVSECRDSET_SL_REV_D
	bool "Revision D"

endchoice

endmenu
```

## projects/ad3552r_fmcz/Kconfig
```kconfig
menu "ad3552r_fmcz Configuration"

choice AD3552R_FMCZ_EXAMPLE
	prompt "Example variant"
	default AD3552R_FMCZ_AXI_QSPI_EXAMPLE

config AD3552R_FMCZ_AXI_QSPI_EXAMPLE
	bool "AXI QSPI example"
	help
	  Example that uses the AXI DAC core with QSPI offload, AXI DMA, and
	  AXI clock generator IP to drive the AD3552R DAC at high speed via
	  the HDL QSPI controller.

config AD3552R_FMCZ_AXI_QSPI_IIO_EXAMPLE
	bool "AXI QSPI IIO example"
	depends on IIO
	help
	  IIO-enabled variant of the AXI QSPI example. Exposes the AD3552R
	  DAC through the IIO framework using iio_ad3552r and iio_axi_dac,
	  enabling host-side control via libiio over UART.

config AD3552R_FMCZ_GENERIC_SPI_EXAMPLE
	bool "Generic SPI example"
	help
	  Example that drives the AD3552R DAC using the generic PS SPI
	  controller (no AXI offload), streaming a sine wave to both
	  channels.

config AD3552R_FMCZ_GENERIC_SPI_IIO_EXAMPLE
	bool "Generic SPI IIO example"
	depends on IIO
	help
	  IIO-enabled variant of the generic SPI example. Exposes the
	  AD3552R DAC through the IIO framework using iio_ad3552r, enabling
	  host-side control via libiio over UART.

endchoice

endmenu
```

## projects/ad405x/Kconfig
```kconfig
menu "AD405X Configuration"

choice AD405X_EXAMPLE
	prompt "Example variant"
	default AD405X_BASIC_EXAMPLE

config AD405X_BASIC_EXAMPLE
	bool "Basic example"
	help
	  Basic SPI example for the AD4050.

config AD405X_BASIC_I3C_EXAMPLE
	bool "Basic I3C example"
	help
	  Basic I3C example for the AD4060.

config AD405X_I3C_DMA_EXAMPLE
	bool "I3C DMA example"
	help
	  I3C example using GPDMA for the AD4062.

config AD405X_IIO_EXAMPLE
	bool "IIO example"
	depends on IIO
	help
	  IIO example for the AD4058.

endchoice

endmenu
```

## projects/ad4110/Kconfig
```kconfig
menu "ad4110 Configuration"

choice AD4110_EXAMPLE
	prompt "Example variant"
	default AD4110_UART_EXAMPLE

config AD4110_UART_EXAMPLE
	bool "UART example"
	help
	  Basic UART example that initializes the AD4110 AFE/ADC, configures
	  it for continuous data capture and prints the results over UART.

endchoice

endmenu
```

## projects/ad463x_fmcz/Kconfig
```kconfig
menu "AD463X_FMCZ Configuration"

choice AD463X_FMCZ_EXAMPLE
	prompt "Example variant"
	default AD463X_FMCZ_BASIC_EXAMPLE

config AD463X_FMCZ_BASIC_EXAMPLE
	bool "Basic example"
	help
	  Basic example demonstrating the AD463X ADC.

config AD463X_FMCZ_IIO_EXAMPLE
	bool "IIO example"
	depends on IIO
	help
	  IIO example demonstrating the AD463X ADC with libiio support.

endchoice

config AD463X_FMCZ_USE_STANDARD_SPI
	bool
	default y if STM32
	help
	  Use the standard SPI driver instead of the Xilinx SPI engine
	  offload path. Selected automatically on STM32.

choice AD463X_FMCZ_DEV
	prompt "Device variant"
	default AD463X_FMCZ_DEV_AD4630_24

config AD463X_FMCZ_DEV_AD4630_24
	bool "AD4630-24"
	help
	  Default AD4630-24 device (no extra compile define needed).

config AD463X_FMCZ_DEV_AD4630_20
	bool "AD4630-20"

config AD463X_FMCZ_DEV_AD4030
	bool "AD4030"

config AD463X_FMCZ_DEV_ADAQ4224
	bool "ADAQ4224"

config AD463X_FMCZ_DEV_ADAQ4216
	bool "ADAQ4216"

endchoice

endmenu
```

## projects/ad4692_ardz/Kconfig
```kconfig
menu "AD4692 ARDZ Configuration"

choice AD4692_ARDZ_EXAMPLE
	prompt "Example variant"
	default AD4692_ARDZ_IIO_EXAMPLE

config AD4692_ARDZ_BASIC_EXAMPLE
	bool "Basic example"
	help
	  Simple example that initialises the AD4692 and reads samples
	  over SPI, printing results over UART.

config AD4692_ARDZ_IIO_EXAMPLE
	bool "IIO example"
	depends on IIO
	help
	  IIO framework example. Launches an IIOD server for remote
	  data acquisition using IIO Oscilloscope or libiio clients.

config AD4692_ARDZ_IIO_TRIGGER_EXAMPLE
	bool "IIO trigger example"
	depends on IIO && IRQ && GPIO
	help
	  Interrupt-driven IIO example using the AD4692 data-ready
	  pin as a hardware trigger.

endchoice

endmenu
```

## projects/ad469x_evb/Kconfig
```kconfig
menu "ad469x_evb Configuration"

choice AD469X_EVB_EXAMPLE
	prompt "Example variant"
	default AD469X_EVB_BASIC_EXAMPLE

config AD469X_EVB_BASIC_EXAMPLE
	bool "Basic example"
	help
	  Basic example that initializes the AD469X ADC in single-cycle
	  conversion mode, captures samples via AXI DMA, and prints the
	  results over UART.

config AD469X_EVB_IIO_EXAMPLE
	bool "IIO example"
	depends on IIO
	help
	  IIO example that exposes the AD469X ADC through the IIO framework,
	  enabling host-side data capture via libiio over UART. Uses standard
	  sequence conversion mode.

config AD469X_EVB_STANDARD_SEQ_EXAMPLE
	bool "Standard sequence example"
	help
	  Basic example that uses the AD469X ADC in standard sequence
	  conversion mode (AD469X_SEQ_STANDARD), capturing samples via
	  AXI DMA and printing results over UART.

config AD469X_EVB_ADVANCE_SEQ_EXAMPLE
	bool "Advanced sequence example"
	help
	  Basic example that uses the AD469X ADC in advanced sequence
	  conversion mode (AD469X_SEQ_ADVANCED), capturing samples via
	  AXI DMA and printing results over UART.

endchoice

endmenu
```

## projects/ad5460/Kconfig
```kconfig
menu "AD5460 Configuration"

choice AD5460_EXAMPLE
	prompt "Example variant"
	default AD5460_BASIC_EXAMPLE

config AD5460_BASIC_EXAMPLE
	bool "Basic example"
	help
	  Basic example that initializes the AD5460 quad-channel
	  software-configurable output device and drives its GPIOs.

config AD5460_CHANNEL_OUTPUT_EXAMPLE
	bool "Channel output example"
	help
	  Configures the AD5460 output channels and updates their values.

config AD5460_CURRENT_OUTPUT_EXAMPLE
	bool "Current output example"
	help
	  Configures an AD5460 channel as a current output (source) DAC.

config AD5460_VOLTAGE_OUTPUT_EXAMPLE
	bool "Voltage output example"
	help
	  Configures an AD5460 channel as a voltage output (source) DAC.

endchoice

endmenu
```

## projects/ad5758-sdz/Kconfig
```kconfig
menu "ad5758-sdz Configuration"

choice AD5758_SDZ_EXAMPLE
	prompt "Example variant"
	default AD5758_SDZ_EXAMPLE_EXAMPLE

config AD5758_SDZ_EXAMPLE_EXAMPLE
	bool "Example"
	help
	  Basic example that initializes the AD5758 DAC and writes a
	  mid-scale output code.

endchoice

endmenu
```

## projects/ad5766-sdz/Kconfig
```kconfig
menu "ad5766-sdz Configuration"

choice AD5766_SDZ_EXAMPLE
	prompt "Example variant"
	default AD5766_SDZ_EXAMPLE_EXAMPLE

config AD5766_SDZ_EXAMPLE_EXAMPLE
	bool "Example"
	help
	  Basic example that initializes the AD5766 DAC, configures the
	  SPI Engine offload and AXI DMAC, and drives the DAC outputs.

endchoice

endmenu
```
