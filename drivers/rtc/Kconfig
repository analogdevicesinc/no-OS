## projects/ad6676-ebz/Kconfig
```kconfig
menu "ad6676-ebz Configuration"

choice AD6676_EBZ_EXAMPLE
	prompt "Example variant"
	default AD6676_EBZ_DEMO_EXAMPLE

config AD6676_EBZ_DEMO_EXAMPLE
	bool "Demo example"
	help
	  Demo example that initializes the AD6676 RF ADC via AXI ADC core and
	  JESD204 interface, runs pattern tests, and captures data to DDR via DMA.

config AD6676_EBZ_IIO_EXAMPLE
	bool "IIO example"
	depends on IIO
	help
	  IIO example that exposes the AD6676 ADC through the IIO framework via
	  iio_axi_adc, enabling host-side data capture over UART.

endchoice

endmenu
```

## projects/ad7091r8-sdz/Kconfig
```kconfig
menu "AD7091R8-SDZ Configuration"

choice AD7091R8_SDZ_EXAMPLE
	prompt "Example variant"
	default AD7091R8_SDZ_BASIC_EXAMPLE

config AD7091R8_SDZ_BASIC_EXAMPLE
	bool "Basic example"

config AD7091R8_SDZ_IIO_EXAMPLE
	bool "IIO example"
	depends on IIO

config AD7091R8_SDZ_IIO_TIMER_TRIGGER_EXAMPLE
	bool "IIO timer trigger example"
	depends on IIO

endchoice

choice AD7091R8_SDZ_DEV
	prompt "Device variant"
	default AD7091R8_SDZ_DEV_R8

config AD7091R8_SDZ_DEV_R2
	bool "AD7091R-2 (2-channel)"

config AD7091R8_SDZ_DEV_R4
	bool "AD7091R-4 (4-channel)"

config AD7091R8_SDZ_DEV_R8
	bool "AD7091R-8 (8-channel)"

endchoice

endmenu
```

## projects/ad7124-4sdz/Kconfig
```kconfig
menu "ad7124-4sdz Configuration"

choice AD7124_4SDZ_EXAMPLE
	prompt "Example variant"
	default AD7124_4SDZ_DEMO_EXAMPLE

config AD7124_4SDZ_DEMO_EXAMPLE
	bool "Demo example"
	help
	  Basic demo example that initializes the AD7124 ADC over SPI,
	  reads all registers, then continuously reads and prints ADC
	  conversion results.

endchoice

endmenu
```

## projects/ad7124-8pmdz/Kconfig
```kconfig
menu "ad7124-8pmdz Configuration"

choice AD7124_8PMDZ_EXAMPLE
	prompt "Example variant"
	default AD7124_8PMDZ_IIO_EXAMPLE

config AD7124_8PMDZ_IIO_EXAMPLE
	bool "IIO example"
	depends on IIO

endchoice

config AD7124_8PMDZ_NETWORKING
	bool "Enable ESP8266 Wi-Fi networking"
	default n
	select WIFI_NETWORKING
	help
	  Route IIO transport over an ESP8266 Wi-Fi module (UART AT commands)
	  instead of the serial backend. aducm3029/eval-adicup3029 only.

endmenu
```

## projects/ad713x_fmcz/Kconfig
```kconfig
menu "ad713x_fmcz Configuration"

choice AD713X_FMCZ_EXAMPLE
	prompt "Example variant"
	default AD713X_FMCZ_UART_EXAMPLE

config AD713X_FMCZ_UART_EXAMPLE
	bool "UART example"
	help
	  Basic example that initializes two AD7134 ADCs via SPI Engine offload
	  with AXI DMA, captures samples, and prints conversion results over UART.

config AD713X_FMCZ_IIO_EXAMPLE
	bool "IIO example"
	depends on IIO
	help
	  IIO example that exposes the dual AD7134 ADC through the IIO framework,
	  enabling host-side data capture over UART.

endchoice

endmenu
```

## projects/ad719x/Kconfig
```kconfig
menu "ad719x Configuration"

choice AD719X_EXAMPLE
	prompt "Example variant"
	default AD719X_DUMMY_EXAMPLE

config AD719X_DUMMY_EXAMPLE
	bool "Dummy example"
	help
	  Basic dummy example that initializes the AD719X ADC, reads temperature
	  and a channel average over 100 samples, and prints the results.

endchoice

endmenu
```

## projects/ad738x_fmcz/Kconfig
```kconfig
menu "AD738X_FMCZ Configuration"

choice AD738X_FMCZ_EXAMPLE
	prompt "Example variant"
	default AD738X_FMCZ_BASIC_EXAMPLE

config AD738X_FMCZ_BASIC_EXAMPLE
	bool "Basic example"
	help
	  Basic example demonstrating the AD738X ADC.

config AD738X_FMCZ_IIO_EXAMPLE
	bool "IIO example"
	depends on IIO
	help
	  IIO example demonstrating the AD738X ADC with libiio support.

endchoice

config AD738X_FMCZ_USE_STANDARD_SPI
	bool
	default y if STM32
	help
	  Use standard SPI driver instead of SPI engine (Xilinx).

endmenu
```

## projects/ad74413r/Kconfig
```kconfig
menu "AD74413R Configuration"

choice AD74413R_EXAMPLE
	prompt "Example variant"
	default AD74413R_DUMMY_EXAMPLE

config AD74413R_DUMMY_EXAMPLE
	bool "Dummy example"
	help
	  Dummy example that initializes the AD74413R ADC-DAC device
	  and performs basic operations.

config AD74413R_IIO_EXAMPLE
	bool "IIO example"
	depends on IIO
	help
	  IIO example that initializes the AD74413R ADC-DAC device
	  and interfaces using the IIO subsystem.

config AD74413R_IIO_TRIGGER_EXAMPLE
	bool "IIO Trigger example"
	depends on IIO && IRQ && GPIO
	help
	  IIO trigger example that initializes the AD74413R ADC-DAC device
	  and interfaces using the IIO subsystem with hardware trigger support.

endchoice

endmenu
```
