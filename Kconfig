## Kconfig
```kconfig
menu "Hardware Interface Drivers"

comment "Communication Interfaces"

config SPI
	bool "Enable SPI"
	default n
	help
	  Enable Serial Peripheral Interface (SPI) support.
	  API: drivers/api/no_os_spi.c, include/no_os_spi.h

config I2C
	bool "Enable I2C"
	default n
	help
	  Enable Inter-Integrated Circuit (I2C) bus support.
	  API: drivers/api/no_os_i2c.c, include/no_os_i2c.h

config I3C
	bool "Enable I3C"
	default n
	help
	  Enable MIPI I3C (Improved Inter-Integrated Circuit) bus support.
	  API: drivers/api/no_os_i3c.c, include/no_os_i3c.h

config UART
	bool "Enable UART"
	default n
	help
	  Enable Universal Asynchronous Receiver-Transmitter (UART) support.
	  API: drivers/api/no_os_uart.c, include/no_os_uart.h

config TDM
	bool "Enable TDM"
	default n
	help
	  Enable Time Division Multiplexing (TDM) interface support.
	  API: drivers/api/no_os_tdm.c, include/no_os_tdm.h

config GPIO
	bool "Enable GPIO"
	default n
	help
	  Enable General Purpose Input/Output (GPIO) support.
	  API: drivers/api/no_os_gpio.c, include/no_os_gpio.h

config IRQ
	bool "Enable IRQ"
	default n
	help
	  Enable interrupt request (IRQ) handling support.
	  API: drivers/api/no_os_irq.c, include/no_os_irq.h

config PWM
	bool "Enable PWM"
	default n
	help
	  Enable Pulse Width Modulation (PWM) support.
	  API: drivers/api/no_os_pwm.c, include/no_os_pwm.h
	  Used for motor control, LED dimming, and analog signal generation.

config TIMER
	bool "Enable Timer"
	default n
	help
	  Enable hardware timer support.
	  API: drivers/api/no_os_timer.c, include/no_os_timer.h
	  Used for timing operations, delays, and periodic tasks.

config CLK
	bool "Enable Clock"
	default n
	help
	  Enable clock management support.
	  API: include/no_os_clk.h
	  Used for clock tree configuration and frequency management.

config MDIO
	bool "Enable MDIO"
	default n
	help
	  Enable Management Data Input/Output (MDIO) support.
	  API: drivers/api/no_os_mdio.c, include/no_os_mdio.h
	  Serial management interface used to configure Ethernet PHYs.

config DMA
	bool "Enable DMA"
	default n
	help
	  Enable Direct Memory Access (DMA) support.
	  API: drivers/api/no_os_dma.c, include/no_os_dma.h
	  Allows peripherals to transfer data directly to/from memory without CPU.

config EEPROM
	bool "Enable EEPROM"
	default n
	help
	  Enable EEPROM interface support.
	  API: drivers/api/no_os_eeprom.c, include/no_os_eeprom.h
	  For Electrically Erasable Programmable Read-Only Memory devices.

config RTC
	bool "Enable RTC"
	default n
	help
	  Enable Real-Time Clock (RTC) support.
	  API: include/no_os_rtc.h
	  Provides time and date keeping with battery backup capability.

config TRNG
	bool "Enable TRNG"
	default n
	help
	  Enable True Random Number Generator (TRNG) support.
	  API: drivers/api/no_os_trng.c, include/no_os_trng.h
	  Hardware-based random number generation for cryptographic applications.

endmenu

source "iio/Kconfig"
source "drivers/Kconfig"
source "libraries/Kconfig"
source "network/Kconfig"
source "projects/Kconfig"
```

## board_configs/aducm3029/eval-adicup3029_defconfig
```kconfig
CONFIG_PLATFORM_DRIVERS=y
CONFIG_ADUCM3029=y

CONFIG_UART_ADUCM3029=y
CONFIG_UART_STDIO_ADUCM3029=y
CONFIG_IRQ_ADUCM3029=y
CONFIG_GPIO_ADUCM3029=y
CONFIG_GPIO_IRQ_ADUCM3029=y
CONFIG_SPI_ADUCM3029=y
CONFIG_I2C_ADUCM3029=y
CONFIG_TIMER_ADUCM3029=y
CONFIG_RTC_ADUCM3029=y
CONFIG_PWM_ADUCM3029=y
CONFIG_ADC_ADUCM3029=y
CONFIG_FLASH_ADUCM3029=y
CONFIG_TRNG_ADUCM3029=y
```

## board_configs/maxim/apard32690_defconfig
```kconfig
CONFIG_UART_MAXIM=y
CONFIG_UART_STDIO_MAXIM=y
CONFIG_USB_UART_MAXIM=y
CONFIG_SPI_MAXIM=y
CONFIG_I2C_MAXIM=y
CONFIG_IRQ_MAXIM=y
CONFIG_GPIO_MAXIM=y
CONFIG_GPIO_IRQ_MAXIM=y
```

## board_configs/maxim/max78000evkit_defconfig
```kconfig
CONFIG_PLATFORM_DRIVERS=y
CONFIG_MAXIM=y

CONFIG_UART_MAXIM=y
CONFIG_UART_STDIO_MAXIM=y
CONFIG_SPI_MAXIM=y
CONFIG_I2C_MAXIM=y
CONFIG_IRQ_MAXIM=y
CONFIG_GPIO_MAXIM=y
CONFIG_GPIO_IRQ_MAXIM=y
CONFIG_TIMER_MAXIM=y
CONFIG_DMA_MAXIM=y
CONFIG_PWM_MAXIM=y
CONFIG_RTC_MAXIM=y
CONFIG_TRNG_MAXIM=y
```

## board_configs/pico/pico_defconfig
```kconfig
CONFIG_PLATFORM_DRIVERS=y
CONFIG_PICO=y

CONFIG_UART_PICO=y
CONFIG_SPI_PICO=y
CONFIG_I2C_PICO=y
CONFIG_IRQ_PICO=y
CONFIG_GPIO_PICO=y
CONFIG_GPIO_IRQ_PICO=y
CONFIG_TIMER_PICO=y
```

## board_configs/stm32/stm32f756_nucleo_defconfig
```kconfig
CONFIG_PLATFORM_DRIVERS=y
CONFIG_STM32=y

CONFIG_UART_STM32=y
CONFIG_UART_STDIO_STM32=y
CONFIG_SPI_STM32=y
CONFIG_IRQ_STM32=y
CONFIG_GPIO_STM32=y
CONFIG_GPIO_IRQ_STM32=y
```

## board_configs/xilinx/kcu105_defconfig
```kconfig
CONFIG_PLATFORM_DRIVERS=y
CONFIG_XILINX=y

# Enable every Xilinx platform driver at the board baseline; each is gated by
# `depends on <SUBSYS>` in drivers/platform/xilinx/Kconfig, so an enable here is
# inert unless the project's .conf turns on the matching generic subsystem
# (CONFIG_SPI, CONFIG_GPIO, ...). Mirrors the maxim/stm32 board defconfigs.
#
# GPIO_IRQ_XILINX is omitted (MicroBlaze): xilinx_gpio_irq.h unconditionally
# includes the PS-only xgpiops.h, absent from a MicroBlaze BSP. See vcu118.
CONFIG_UART_XILINX=y
CONFIG_SPI_XILINX=y
CONFIG_I2C_XILINX=y
CONFIG_GPIO_XILINX=y
CONFIG_IRQ_XILINX=y
CONFIG_TIMER_XILINX=y
```

## board_configs/xilinx/vcu118_defconfig
```kconfig
CONFIG_PLATFORM_DRIVERS=y
CONFIG_XILINX=y

# Enable every Xilinx platform driver at the board baseline; each is gated by
# `depends on <SUBSYS>` in drivers/platform/xilinx/Kconfig, so an enable here is
# inert unless the project's .conf turns on the matching generic subsystem
# (CONFIG_SPI, CONFIG_GPIO, ...). Mirrors the maxim/stm32 board defconfigs.
#
# GPIO_IRQ_XILINX is intentionally omitted: xilinx_gpio_irq.h unconditionally
# includes the PS-only xgpiops.h, which is absent from a MicroBlaze BSP. The PS
# GPIO-interrupt controller does not exist on MicroBlaze, so this driver is not
# applicable here (the cortexa9/cortexa53 board defconfigs keep it).
CONFIG_UART_XILINX=y
CONFIG_SPI_XILINX=y
CONFIG_I2C_XILINX=y
CONFIG_GPIO_XILINX=y
CONFIG_IRQ_XILINX=y
CONFIG_TIMER_XILINX=y
```

## board_configs/xilinx/zc706_defconfig
```kconfig
CONFIG_PLATFORM_DRIVERS=y
CONFIG_XILINX=y

# Enable every Xilinx platform driver at the board baseline; each is gated by
# `depends on <SUBSYS>` in drivers/platform/xilinx/Kconfig, so an enable here is
# inert unless the project's .conf turns on the matching generic subsystem
# (CONFIG_SPI, CONFIG_GPIO, ...). Mirrors the maxim/stm32 board defconfigs.
CONFIG_UART_XILINX=y
CONFIG_SPI_XILINX=y
CONFIG_I2C_XILINX=y
CONFIG_GPIO_XILINX=y
CONFIG_GPIO_IRQ_XILINX=y
CONFIG_IRQ_XILINX=y
CONFIG_TIMER_XILINX=y
```

## board_configs/xilinx/zed_defconfig
```kconfig
CONFIG_PLATFORM_DRIVERS=y
CONFIG_XILINX=y

CONFIG_UART=y
CONFIG_UART_XILINX=y
CONFIG_IRQ=y
CONFIG_IRQ_XILINX=y
```

## drivers/Kconfig
```kconfig
menu "Device Drivers"

source "drivers/accel/Kconfig"
source "drivers/adc/Kconfig"
source "drivers/adc-dac/Kconfig"
source "drivers/afe/Kconfig"
source "drivers/amplifiers/Kconfig"
source "drivers/axi_core/Kconfig"
source "drivers/cdc/Kconfig"
source "drivers/charger/Kconfig"
source "drivers/dac/Kconfig"
source "drivers/digital-io/Kconfig"
source "drivers/display/Kconfig"
source "drivers/ecg/Kconfig"
source "drivers/eeprom/Kconfig"
source "drivers/filter/Kconfig"
source "drivers/frequency/Kconfig"
source "drivers/gmsl/Kconfig"
source "drivers/gyro/Kconfig"
source "drivers/impedance-analyzer/Kconfig"
source "drivers/imu/Kconfig"
source "drivers/io-expander/Kconfig"
source "drivers/io-link/Kconfig"
source "drivers/led/Kconfig"
source "drivers/meter/Kconfig"
source "drivers/motor/Kconfig"
source "drivers/mux/Kconfig"
source "drivers/net/Kconfig"
source "drivers/photo-electronic/Kconfig"
source "drivers/position/Kconfig"
source "drivers/potentiometer/Kconfig"
source "drivers/power/Kconfig"
source "drivers/resolver/Kconfig"
source "drivers/rf-transceiver/Kconfig"
source "drivers/rtc/Kconfig"
source "drivers/sd-card/Kconfig"
source "drivers/switch/Kconfig"
source "drivers/temperature/Kconfig"

endmenu

menu "Platform Drivers"

source "drivers/platform/Kconfig"

endmenu
```

## drivers/adc-dac/Kconfig
```kconfig
menuconfig ADC_DAC
    bool "ADC-DAC Drivers"
    default n
    help
      Enable support for combined ADC-DAC converter drivers.

      This section contains drivers for devices that provide both
      ADC and DAC functionality in a single chip.

if ADC_DAC

config ADC_DAC_AD5592R
    depends on SPI
    bool "Enable AD5592R ADC-DAC driver"
    default n

config ADC_DAC_IIO_AD559XR
    select ADC_DAC_AD5592R
    bool "Enable AD559XR IIO driver"
    default n

config ADC_DAC_AD74413R
    depends on SPI
    select GPIO
    bool "Enable AD74413R ADC-DAC driver"
    default n

config ADC_DAC_IIO_AD74413R
    select ADC_DAC_AD74413R
    bool "Enable AD74413R IIO driver"
    default n

config ADC_DAC_AD74416H
    depends on SPI
    bool "Enable AD74416H ADC-DAC driver"
    default n

endif # ADC_DAC
```

## drivers/adc/Kconfig
```kconfig
menuconfig ADC
    bool "ADC Drivers"
    default n
    help
      Enable support for Analog-to-Digital Converter (ADC) drivers.

      This section contains drivers for various ADC devices from
      Analog Devices, Linear Technology, and Maxim Integrated.

if ADC

config ADC_AD405X
    depends on SPI
    select GPIO
    bool "Enable AD405X ADC driver"
    default n

config ADC_AD4080
    depends on SPI
    select GPIO
    bool "Enable AD4080 ADC driver"
    default n

config ADC_AD4170
    depends on SPI
    select GPIO
    bool "Enable AD4170 ADC driver"
    default n

config ADC_AD4692
    depends on SPI
    select GPIO
    bool "Enable AD4692 ADC driver"
    default n

config ADC_IIO_AD4692
    select ADC_AD4692
    bool "Enable AD4692 IIO driver"
    default n

config ADC_AD463X
    depends on SPI
    select GPIO
    bool "Enable AD463X ADC driver"
    default n

config ADC_IIO_AD463X
    select ADC_AD463X
    bool "Enable AD463X IIO driver"
    default n

config ADC_AD469X
    depends on SPI
    bool "Enable AD469X ADC driver"
    default n

config ADC_AD4858
    depends on SPI
    bool "Enable AD4858 ADC driver"
    default n

config ADC_AD6673
    depends on SPI
    bool "Enable AD6673 ADC driver"
    default n

config ADC_AD6676
    depends on SPI
    bool "Enable AD6676 ADC driver"
    default n

config ADC_AD7091R
    depends on SPI
    bool "Enable AD7091R ADC driver"
    default n

config ADC_AD7091R5
    depends on I2C
    bool "Enable AD7091R5 ADC driver"
    default n

config ADC_AD7091R8
    depends on SPI
    bool "Enable AD7091R8 ADC driver"
    default n

config ADC_IIO_AD7091R8
    select ADC_AD7091R8
    bool "Enable AD7091R8 IIO driver"
    default n

config ADC_AD7124
    depends on SPI
    bool "Enable AD7124 ADC driver"
    default n

config ADC_IIO_AD7124
    select ADC_AD7124
    bool "Enable AD7124 IIO driver"
    default n

config ADC_AD713X
    depends on SPI
    bool "Enable AD713X ADC driver"
    default n

config ADC_IIO_AD713X
    select ADC_AD713X
    bool "Enable AD713X IIO driver"
    default n

config ADC_AD717X
    depends on SPI
    bool "Enable AD717X ADC driver"
    default n

config ADC_AD719X
    depends on SPI
    bool "Enable AD719X ADC driver"
    default n

config ADC_AD7280A
    depends on SPI
    bool "Enable AD7280A ADC driver"
    default n

config ADC_AD738X
    depends on SPI
    bool "Enable AD738X ADC driver"
    default n

config ADC_IIO_AD738X
    select ADC_AD738X
    bool "Enable AD738X IIO driver"
    default n

config ADC_AD74XX
    depends on SPI
    bool "Enable AD74XX ADC driver"
    default n

config ADC_AD7606
    depends on SPI
    select GPIO
    bool "Enable AD7606 ADC driver"
    default n

config ADC_IIO_AD7606
    select ADC_AD7606
    bool "Enable AD7606 IIO driver"
    default n

config ADC_AD7616
    depends on SPI
    bool "Enable AD7616 ADC driver"
    default n

config ADC_IIO_AD7616
    select ADC_AD7616
    bool "Enable AD7616 IIO driver"
    default n

config ADC_AD7689
    depends on SPI
    bool "Enable AD7689 ADC driver"
    default n

config ADC_AD7768
    depends on SPI
    select GPIO
    bool "Enable AD7768 ADC driver"
    default n

config ADC_AD7768_1
    depends on SPI
    bool "Enable AD7768-1 ADC driver"
    default n

config ADC_AD7779
    depends on SPI
    bool "Enable AD7779 ADC driver"
    default n

config ADC_AD7780
    depends on SPI
    bool "Enable AD7780 ADC driver"
    default n

config ADC_AD7799
    depends on SPI
    bool "Enable AD7799 ADC driver"
    default n

config ADC_IIO_AD7799
    select ADC_AD7799
    bool "Enable AD7799 IIO driver"
    default n

config ADC_AD796X
    depends on SPI
    bool "Enable AD796X ADC driver"
    default n

config ADC_AD7980
    depends on SPI
    bool "Enable AD7980 ADC driver"
    default n

config ADC_AD799X
    depends on I2C
    bool "Enable AD799X ADC driver"
    default n

config ADC_AD9081
    depends on SPI
    select GPIO
    bool "Enable AD9081 ADC driver"
    default n

config ADC_AD9083
    depends on SPI
    bool "Enable AD9083 ADC driver"
    default n

config ADC_IIO_AD9083
    select ADC_AD9083
    bool "Enable AD9083 IIO driver"
    default n

config ADC_AD9208
    depends on SPI
    bool "Enable AD9208 ADC driver"
    default n

config ADC_AD9250
    depends on SPI
    bool "Enable AD9250 ADC driver"
    default n

config ADC_AD9265
    depends on SPI
    bool "Enable AD9265 ADC driver"
    default n

config ADC_AD9434
    depends on SPI
    bool "Enable AD9434 ADC driver"
    default n

config ADC_AD9467
    depends on SPI
    bool "Enable AD9467 ADC driver"
    default n

config ADC_AD9625
    depends on SPI
    bool "Enable AD9625 ADC driver"
    default n

config ADC_AD9656
    depends on SPI
    bool "Enable AD9656 ADC driver"
    default n

config ADC_AD9680
    depends on SPI
    bool "Enable AD9680 ADC driver"
    default n

config ADC_IIO_AD9680
    select ADC_AD9680
    bool "Enable AD9680 IIO driver"
    default n

config ADC_ADAQ7980
    depends on SPI
    bool "Enable ADAQ7980 ADC driver"
    default n

config ADC_ADAQ8092
    depends on SPI
    bool "Enable ADAQ8092 ADC driver"
    default n

config ADC_DEMO
    bool "Enable ADC demo driver"
    default n

config ADC_IIO_DEMO
    select ADC_DEMO
    bool "Enable ADC demo IIO driver"
    default n

config ADC_ADM1177
    depends on I2C
    bool "Enable ADM1177 ADC driver"
    default n

config ADC_IIO_ADM1177
    select ADC_ADM1177
    bool "Enable ADM1177 IIO driver"
    default n

config ADC_LTC2312
    depends on SPI
    bool "Enable LTC2312 ADC driver"
    default n

config ADC_LTC2358
    depends on SPI
    bool "Enable LTC2358 ADC driver"
    default n

config ADC_MAX11205
    depends on SPI
    bool "Enable MAX11205 ADC driver"
    default n

config ADC_IIO_MAX11205
    select ADC_MAX11205
    bool "Enable MAX11205 IIO driver"
    default n

config ADC_MAX14001
    depends on SPI
    bool "Enable MAX14001 ADC driver"
    default n

config ADC_MAX9611PMB
    depends on I2C
    bool "Enable MAX9611PMB ADC driver"
    default n

config ADC_PULSAR_ADC
    depends on SPI
    bool "Enable Pulsar ADC driver"
    default n

config ADC_IIO_PULSAR_ADC
    select ADC_PULSAR_ADC
    bool "Enable Pulsar ADC IIO driver"
    default n

endif # ADC
```

## drivers/afe/Kconfig
```kconfig
menuconfig AFE
    bool "AFE Drivers"
    default n
    help
      Enable support for Analog Front End (AFE) drivers.

      This section contains drivers for various AFE devices that provide
      analog signal conditioning, amplification, and processing.

if AFE

config AFE_AD4110
    bool "Enable AD4110 AFE driver"
    default n

config AFE_AD413X
    bool "Enable AD413X AFE driver"
    default n

config AFE_IIO_AD413X
    select AFE_AD413X
    bool "Enable AD413X IIO driver"
    default n

config AFE_AD5940
    bool "Enable AD5940 AFE driver"
    default n

config AFE_IIO_AD5940
    select AFE_AD5940
    bool "Enable AD5940 IIO driver"
    default n

endif # AFE
```
