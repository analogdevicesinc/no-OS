## drivers/amplifiers/Kconfig
```kconfig
menuconfig AMPLIFIERS
	bool "Amplifier Drivers"
	default n
	help
	  Enable support for amplifier drivers.

if AMPLIFIERS

config AMPLIFIERS_ADA4250
	depends on SPI
	select GPIO
	bool "Enable ADA4250 amplifier driver"
	default n

config AMPLIFIERS_IIO_ADA4250
	select AMPLIFIERS_ADA4250
	bool "Enable ADA4250 IIO driver"
	default n

config AMPLIFIERS_ADHV4710
	depends on SPI
	select GPIO
	bool "Enable ADHV4710 amplifier driver"
	default n

config AMPLIFIERS_ADL8113
	depends on GPIO
	bool "Enable ADL8113 amplifier driver"
	default n

config AMPLIFIERS_IIO_ADL8113
	select AMPLIFIERS_ADL8113
	bool "Enable ADL8113 IIO driver"
	default n

endif # AMPLIFIERS
```

## drivers/axi_core/Kconfig
```kconfig
menuconfig AXI_CORE
	bool "AXI Core Drivers"
	default n
	help
	  Enable support for AXI core drivers used with FPGA-based platforms.
	  These drivers provide interfaces for AXI-based IP cores commonly
	  found in Xilinx and Altera FPGA designs.

if AXI_CORE

config AXI_CORE_AXI_ADC_CORE
	bool "Enable AXI ADC core driver"
	default n

config AXI_CORE_AXI_DAC_CORE
	bool "Enable AXI DAC core driver"
	default n

config AXI_CORE_AXI_DMAC
	bool "Enable AXI DMA controller driver"
	default n

config AXI_CORE_AXI_PWMGEN
	bool "Enable AXI PWM generator driver"
	default n

config AXI_CORE_AXI_SYSID
	bool "Enable AXI system ID driver"
	default n

config AXI_CORE_CLK_ALTERA_A10_FPLL
	bool "Enable Altera Arria 10 FPLL clock driver"
	default n

config AXI_CORE_CLK_AXI_CLKGEN
	bool "Enable AXI clock generator driver"
	default n

config AXI_CORE_IIO_AXI_ADC
	select AXI_CORE_AXI_ADC_CORE
	bool "Enable AXI ADC IIO driver"
	default n

config AXI_CORE_IIO_AXI_DAC
	select AXI_CORE_AXI_DAC_CORE
	bool "Enable AXI DAC IIO driver"
	default n

config AXI_CORE_JESD204
	bool "Enable JESD204 interface driver"
	default n
	help
	  Enable support for the JESD204 high-speed serial interface.
	  Includes support for both Xilinx and Altera FPGA implementations.

config AXI_CORE_SPI_ENGINE
	depends on SPI
	bool "Enable SPI Engine offload driver"
	default n
	help
	  Enable the SPI Engine driver which offloads SPI transactions
	  to an AXI-based hardware SPI engine IP core.

endif # AXI_CORE
```

## drivers/cdc/Kconfig
```kconfig
menuconfig CDC
	bool "Capacitance-to-Digital Converter Drivers"
	default n
	help
	  Enable support for capacitance-to-digital converter (CDC) drivers.

if CDC

config CDC_AD7156
	depends on I2C
	bool "Enable AD7156 CDC driver"
	default n

config CDC_AD7746
	depends on I2C
	bool "Enable AD7746 CDC driver"
	default n

config CDC_IIO_AD7746
	select CDC_AD7746
	bool "Enable AD7746 IIO driver"
	default n

endif # CDC
```

## drivers/charger/Kconfig
```kconfig
menuconfig CHARGER
    bool "Battery charger Drivers"
    default n
    help
      Enable support for battery charger drivers.

if CHARGER

config CHARGER_MAX20303
    depends on I2C
    bool "Enable MAX20303 battery charger driver"
    default n

endif
```

## drivers/dac/Kconfig
```kconfig
menuconfig DAC
    bool "DAC Drivers"
    default n
    help
      Enable support for Digital-to-Analog Converter (DAC) drivers.

      This section contains drivers for various DAC devices from
      Analog Devices, Linear Technology, and Maxim Integrated.

if DAC

config DAC_AD3530R
    depends on SPI
    bool "Enable AD3530R DAC driver"
    default n

config DAC_AD3552R
    depends on SPI
    select GPIO
    bool "Enable AD3552R DAC driver"
    default n

config DAC_IIO_AD3552R
    select DAC_AD3552R
    bool "Enable AD3552R IIO driver"
    default n

config DAC_AD5421
    depends on SPI
    bool "Enable AD5421 DAC driver"
    default n

config DAC_AD5446
    depends on SPI
    bool "Enable AD5446 DAC driver"
    default n

config DAC_AD5449
    depends on SPI
    bool "Enable AD5449 DAC driver"
    default n

config DAC_AD5460
    depends on SPI
    bool "Enable AD5460 DAC driver"
    default n

config DAC_AD5628
    depends on SPI
    bool "Enable AD5628 DAC driver"
    default n

config DAC_AD5629R
    depends on SPI || I2C
    bool "Enable AD5629R DAC driver"
    default n

config DAC_AD5686
    depends on SPI || I2C
    bool "Enable AD5686 DAC driver"
    default n

config DAC_AD5754R
    depends on SPI
    bool "Enable AD5754R DAC driver"
    default n

config DAC_AD5755
    depends on SPI
    bool "Enable AD5755 DAC driver"
    default n

config DAC_AD5758
    depends on SPI
    bool "Enable AD5758 DAC driver"
    default n

config DAC_AD5761R
    depends on SPI
    bool "Enable AD5761R DAC driver"
    default n

config DAC_AD5766
    depends on SPI
    bool "Enable AD5766 DAC driver"
    default n

config DAC_AD5770R
    depends on SPI
    select GPIO
    bool "Enable AD5770R DAC driver"
    default n

config DAC_AD5791
    depends on SPI
    bool "Enable AD5791 DAC driver"
    default n

config DAC_IIO_AD5791
    select DAC_AD5791
    bool "Enable AD5791 IIO driver"
    default n

config DAC_AD7293
    depends on SPI
    bool "Enable AD7293 DAC driver"
    default n

config DAC_AD7303
    depends on SPI
    bool "Enable AD7303 DAC driver"
    default n

config DAC_AD8460
    depends on SPI
    bool "Enable AD8460 DAC driver"
    default n

config DAC_IIO_AD8460
    select DAC_AD8460
    bool "Enable AD8460 IIO driver"
    default n

config DAC_AD9144
    depends on SPI
    bool "Enable AD9144 DAC driver"
    default n

config DAC_IIO_AD9144
    select DAC_AD9144
    bool "Enable AD9144 IIO driver"
    default n

config DAC_AD9152
    depends on SPI
    bool "Enable AD9152 DAC driver"
    default n

config DAC_IIO_AD9152
    select DAC_AD9152
    bool "Enable AD9152 IIO driver"
    default n

config DAC_AD917X
    depends on SPI
    bool "Enable AD917X DAC driver"
    default n

config DAC_AD9739A
    depends on SPI
    bool "Enable AD9739A DAC driver"
    default n

config DAC_DEMO
    bool "Enable DAC demo driver"
    default n

config DAC_IIO_DEMO
    select DAC_DEMO
    bool "Enable DAC demo IIO driver"
    default n

config DAC_LTC2672
    depends on SPI
    bool "Enable LTC2672 DAC driver"
    default n

config DAC_LTC268X
    depends on SPI
    bool "Enable LTC268X DAC driver"
    default n

config DAC_MAX22007
    depends on SPI
    bool "Enable MAX22007 DAC driver"
    default n

config DAC_MAX22017
    depends on SPI
    bool "Enable MAX22017 DAC driver"
    default n

config DAC_IIO_MAX22017
    select DAC_MAX22017
    bool "Enable MAX22017 IIO driver"
    default n

config DAC_MAX538X
    depends on I2C
    bool "Enable MAX538X DAC driver"
    default n

endif # DAC
```

## drivers/digital-io/Kconfig
```kconfig
menuconfig DIGITAL_IO
    bool "Digital I/O Drivers"
    default n
    help
      Enable support for digital I/O drivers.

if DIGITAL_IO

config DIGITAL_IO_MAX14906
    depends on SPI
    select GPIO
    bool "Enable MAX14906 driver"
    default n

config DIGITAL_IO_IIO_MAX14906
    select DIGITAL_IO_MAX14906
    bool "Enable MAX14906 IIO driver"
    default n

config DIGITAL_IO_MAX14914
    depends on GPIO
    bool "Enable MAX14914 driver"
    default n

config DIGITAL_IO_MAX14919
    depends on GPIO
    bool "Enable MAX14919 driver"
    default n

config DIGITAL_IO_MAX22190
    depends on SPI
    select GPIO
    bool "Enable MAX22190 driver"
    default n

config DIGITAL_IO_IIO_MAX22190
    select DIGITAL_IO_MAX22190
    bool "Enable MAX22190 IIO driver"
    default n

config DIGITAL_IO_MAX22196
    depends on SPI
    select GPIO
    bool "Enable MAX22196 driver"
    default n

config DIGITAL_IO_IIO_MAX22196
    select DIGITAL_IO_MAX22196
    bool "Enable MAX22196 IIO driver"
    default n

config DIGITAL_IO_MAX22200
    depends on SPI
    select GPIO
    bool "Enable MAX22200 driver"
    default n

config DIGITAL_IO_IIO_MAX22200
    select DIGITAL_IO_MAX22200
    bool "Enable MAX22200 IIO driver"
    default n

config DIGITAL_IO_MAX22915
    depends on SPI
    select GPIO
    bool "Enable MAX22915 driver"
    default n

endif
```

## drivers/display/Kconfig
```kconfig
menuconfig DISPLAY
    bool "Display Drivers"
    default n
    help
      Enable support for display drivers.

if DISPLAY

config DISPLAY_NHD_C12832A1Z
    depends on SPI
    select GPIO
    bool "Enable NHD-C12832A1Z display driver"
    default n

config DISPLAY_SSD1306
    depends on I2C || SPI
    select GPIO
    bool "Enable SSD1306 display driver"
    default n

endif
```

## drivers/ecg/Kconfig
```kconfig
menuconfig ECG
	bool "ECG Drivers"
	default n
	help
	  Enable support for electrocardiogram (ECG) drivers.

if ECG

config ECG_ADAS1000
	depends on SPI
	bool "Enable ADAS1000 ECG driver"
	default n

endif # ECG
```

## drivers/eeprom/Kconfig
```kconfig
menuconfig EEPROM_DRIVERS
	bool "EEPROM Device Drivers"
	default n
	help
	  Enable support for EEPROM device drivers.

if EEPROM_DRIVERS

config EEPROM_DRIVERS_24XX32A
	depends on I2C
	bool "Enable 24xx32a EEPROM driver"
	default n

config EEPROM_DRIVERS_M24512
	depends on I2C
	select GPIO
	bool "Enable M24512 EEPROM driver"
	default n

endif # EEPROM_DRIVERS
```

## drivers/filter/Kconfig
```kconfig
menuconfig FILTER
	bool "Filter Drivers"
	default n
	help
	  Enable support for filter drivers.

if FILTER

config FILTER_ADMV8818
	depends on SPI
	bool "Enable ADMV8818 filter driver"
	default n

endif # FILTER
```

## drivers/frequency/Kconfig
```kconfig
menuconfig FREQUENCY
	bool "Frequency/Clock Drivers"
	default n
	help
	  Enable support for frequency synthesizer and clock drivers.

if FREQUENCY

config FREQUENCY_AD9508
	depends on SPI
	bool "Enable AD9508 clock driver"
	default n

config FREQUENCY_AD9517
	depends on SPI
	bool "Enable AD9517 clock driver"
	default n

config FREQUENCY_AD9523
	depends on SPI
	bool "Enable AD9523 clock driver"
	default n

config FREQUENCY_AD9528
	depends on SPI
	select GPIO
	bool "Enable AD9528 clock driver"
	default n

config FREQUENCY_AD9545
	depends on SPI || I2C
	select GPIO
	bool "Enable AD9545 clock driver"
	default n

config FREQUENCY_AD9553
	depends on SPI
	bool "Enable AD9553 clock driver"
	default n

config FREQUENCY_AD9833
	depends on SPI
	select GPIO
	bool "Enable AD9833 waveform generator driver"
	default n

config FREQUENCY_ADF4030
	depends on SPI
	bool "Enable ADF4030 PLL driver"
	default n

config FREQUENCY_IIO_ADF4030
	select FREQUENCY_ADF4030
	bool "Enable ADF4030 IIO driver"
	default n

config FREQUENCY_ADF4106
	depends on SPI
	select GPIO
	bool "Enable ADF4106 PLL driver"
	default n

config FREQUENCY_ADF4153
	depends on SPI
	select GPIO
	bool "Enable ADF4153 PLL driver"
	default n

config FREQUENCY_ADF4156
	depends on SPI
	select GPIO
	bool "Enable ADF4156 PLL driver"
	default n

config FREQUENCY_ADF4157
	depends on SPI
	select GPIO
	bool "Enable ADF4157 PLL driver"
	default n

config FREQUENCY_ADF4350
	depends on SPI
	bool "Enable ADF4350 PLL driver"
	default n

config FREQUENCY_ADF4368
	depends on SPI
	bool "Enable ADF4368 PLL driver"
	default n

config FREQUENCY_IIO_ADF4368
	select FREQUENCY_ADF4368
	bool "Enable ADF4368 IIO driver"
	default n

config FREQUENCY_ADF4371
	depends on SPI
	bool "Enable ADF4371 PLL driver"
	default n

config FREQUENCY_ADF4377
	depends on SPI
	select GPIO
	bool "Enable ADF4377 PLL driver"
	default n

config FREQUENCY_IIO_ADF4377
	select FREQUENCY_ADF4377
	bool "Enable ADF4377 IIO driver"
	default n

config FREQUENCY_ADF4382
	depends on SPI
	bool "Enable ADF4382 PLL driver"
	default n

config FREQUENCY_IIO_ADF4382
	select FREQUENCY_ADF4382
	bool "Enable ADF4382 IIO driver"
	default n

config FREQUENCY_ADF5355
	depends on SPI
	bool "Enable ADF5355 PLL driver"
	default n

config FREQUENCY_ADF5611
	depends on SPI
	bool "Enable ADF5611 PLL driver"
	default n

config FREQUENCY_IIO_ADF5611
	select FREQUENCY_ADF5611
	bool "Enable ADF5611 IIO driver"
	default n

config FREQUENCY_ADF5902
	depends on SPI
	select GPIO
	bool "Enable ADF5902 FMCW radar driver"
	default n

config FREQUENCY_IIO_ADF5902
	select FREQUENCY_ADF5902
	bool "Enable ADF5902 IIO driver"
	default n

config FREQUENCY_ADMFM2000
	depends on GPIO
	bool "Enable ADMFM2000 microwave down converter driver"
	default n

config FREQUENCY_IIO_ADMFM2000
	select FREQUENCY_ADMFM2000
	bool "Enable ADMFM2000 IIO driver"
	default n

config FREQUENCY_ADMV1013
	depends on SPI
	bool "Enable ADMV1013 upconverter driver"
	default n

config FREQUENCY_ADMV1014
	depends on SPI
	bool "Enable ADMV1014 downconverter driver"
	default n

config FREQUENCY_ADRF6780
	depends on SPI
	bool "Enable ADRF6780 upconverter driver"
	default n

config FREQUENCY_HMC7044
	depends on SPI
	bool "Enable HMC7044 clock driver"
	default n

config FREQUENCY_LTC6953
	depends on SPI
	bool "Enable LTC6953 clock driver"
	default n

endif # FREQUENCY
```
